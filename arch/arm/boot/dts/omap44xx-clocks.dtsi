/*
 * Device Tree Source for OMAP4 clock data
 *
 * Copyright (C) 2013 Texas Instruments, Inc.
 *
 * This program is free software; you can redistribute it and/or modify
 * it under the terms of the GNU General Public License version 2 as
 * published by the Free Software Foundation.
 */
&cm1_clocks {
	extalt_clkin_ck: extalt_clkin_ck {
		#clock-cells = <0>;
		compatible = "fixed-clock";
		clock-frequency = <59000000>;
	};

	pad_clks_src_ck: pad_clks_src_ck {
		#clock-cells = <0>;
		compatible = "fixed-clock";
		clock-frequency = <12000000>;
	};

	pad_clks_ck: pad_clks_ck@108 {
		#clock-cells = <0>;
		compatible = "ti,gate-clock";
		clocks = <&pad_clks_src_ck>;
		ti,bit-shift = <8>;
		reg = <0x0108>;
	};

	pad_slimbus_core_clks_ck: pad_slimbus_core_clks_ck {
		#clock-cells = <0>;
		compatible = "fixed-clock";
		clock-frequency = <12000000>;
	};

	secure_32k_clk_src_ck: secure_32k_clk_src_ck {
		#clock-cells = <0>;
		compatible = "fixed-clock";
		clock-frequency = <32768>;
	};

	slimbus_src_clk: slimbus_src_clk {
		#clock-cells = <0>;
		compatible = "fixed-clock";
		clock-frequency = <12000000>;
	};

	slimbus_clk: slimbus_clk@108 {
		#clock-cells = <0>;
		compatible = "ti,gate-clock";
		clocks = <&slimbus_src_clk>;
		ti,bit-shift = <10>;
		reg = <0x0108>;
	};

	sys_32k_ck: sys_32k_ck {
		#clock-cells = <0>;
		compatible = "fixed-clock";
		clock-frequency = <32768>;
	};

	virt_12000000_ck: virt_12000000_ck {
		#clock-cells = <0>;
		compatible = "fixed-clock";
		clock-frequency = <12000000>;
	};

	virt_13000000_ck: virt_13000000_ck {
		#clock-cells = <0>;
		compatible = "fixed-clock";
		clock-frequency = <13000000>;
	};

	virt_16800000_ck: virt_16800000_ck {
		#clock-cells = <0>;
		compatible = "fixed-clock";
		clock-frequency = <16800000>;
	};

	virt_19200000_ck: virt_19200000_ck {
		#clock-cells = <0>;
		compatible = "fixed-clock";
		clock-frequency = <19200000>;
	};

	virt_26000000_ck: virt_26000000_ck {
		#clock-cells = <0>;
		compatible = "fixed-clock";
		clock-frequency = <26000000>;
	};

	virt_27000000_ck: virt_27000000_ck {
		#clock-cells = <0>;
		compatible = "fixed-clock";
		clock-frequency = <27000000>;
	};

	virt_38400000_ck: virt_38400000_ck {
		#clock-cells = <0>;
		compatible = "fixed-clock";
		clock-frequency = <38400000>;
	};

	tie_low_clock_ck: tie_low_clock_ck {
		#clock-cells = <0>;
		compatible = "fixed-clock";
		clock-frequency = <0>;
	};

	utmi_phy_clkout_ck: utmi_phy_clkout_ck {
		#clock-cells = <0>;
		compatible = "fixed-clock";
		clock-frequency = <60000000>;
	};

	xclk60mhsp1_ck: xclk60mhsp1_ck {
		#clock-cells = <0>;
		compatible = "fixed-clock";
		clock-frequency = <60000000>;
	};

	xclk60mhsp2_ck: xclk60mhsp2_ck {
		#clock-cells = <0>;
		compatible = "fixed-clock";
		clock-frequency = <60000000>;
	};

	xclk60motg_ck: xclk60motg_ck {
		#clock-cells = <0>;
		compatible = "fixed-clock";
		clock-frequency = <60000000>;
	};

	dpll_abe_ck: dpll_abe_ck@1e0 {
		#clock-cells = <0>;
		compatible = "ti,omap4-dpll-m4xen-clock";
		clocks = <&abe_dpll_refclk_mux_ck>, <&abe_dpll_bypass_clk_mux_ck>;
		reg = <0x01e0>, <0x01e4>, <0x01ec>, <0x01e8>;
	};

	dpll_abe_x2_ck: dpll_abe_x2_ck@1f0 {
		#clock-cells = <0>;
		compatible = "ti,omap4-dpll-x2-clock";
		clocks = <&dpll_abe_ck>;
		reg = <0x01f0>;
	};

	dpll_abe_m2x2_ck: dpll_abe_m2x2_ck@1f0 {
		#clock-cells = <0>;
		compatible = "ti,divider-clock";
		clocks = <&dpll_abe_x2_ck>;
		ti,max-div = <31>;
		ti,autoidle-shift = <8>;
		reg = <0x01f0>;
		ti,index-starts-at-one;
		ti,invert-autoidle-bit;
	};

	abe_24m_fclk: abe_24m_fclk {
		#clock-cells = <0>;
		compatible = "fixed-factor-clock";
		clocks = <&dpll_abe_m2x2_ck>;
		clock-mult = <1>;
		clock-div = <8>;
	};

	abe_clk: abe_clk@108 {
		#clock-cells = <0>;
		compatible = "ti,divider-clock";
		clocks = <&dpll_abe_m2x2_ck>;
		ti,max-div = <4>;
		reg = <0x0108>;
		ti,index-power-of-two;
	};

	aess_fclk: aess_fclk@528 {
		#clock-cells = <0>;
		compatible = "ti,divider-clock";
		clocks = <&abe_clk>;
		ti,bit-shift = <24>;
		ti,max-div = <2>;
		reg = <0x0528>;
	};

	aess_mod_ck: aess_mod_ck@528 {
		#clock-cells = <0>;
		compatible = "ti,omap4-sw-mod-clock";
		reg = <0x0528>;
		clocks = <&aess_fclk>;
	};

	mcpdm_mod_ck: mcpdm_mod_ck@530 {
		#clock-cells = <0>;
		compatible = "ti,omap4-sw-mod-clock";
		reg = <0x0530>;
		clocks = <&pad_clks_ck>;
	};

	dpll_abe_m3x2_ck: dpll_abe_m3x2_ck@1f4 {
		#clock-cells = <0>;
		compatible = "ti,divider-clock";
		clocks = <&dpll_abe_x2_ck>;
		ti,max-div = <31>;
		ti,autoidle-shift = <8>;
		reg = <0x01f4>;
		ti,index-starts-at-one;
		ti,invert-autoidle-bit;
	};

	mpu_mod_ck: mpu_mod_ck@320 {
		#clock-cells = <0>;
		compatible = "ti,omap4-mod-clock";
		reg = <0x0320>;
		clocks = <&dpll_mpu_m2_ck>;
	};

	mmu_dsp_mod_ck: mmu_dsp_mod_ck@420 {
		#clock-cells = <0>;
		compatible = "ti,omap4-hw-mod-clock";
		reg = <0x0420>;
		clocks = <&dpll_iva_m4x2_ck>;
	};

	dsp_mod_ck: dsp_mod_ck@420 {
		#clock-cells = <0>;
		compatible = "ti,omap4-hw-mod-clock";
		reg = <0x0420>;
		clocks = <&dpll_iva_m4x2_ck>;
	};

	l4_abe_mod_ck: l4_abe_mod_ck@520 {
		#clock-cells = <0>;
		compatible = "ti,omap4-mod-clock";
		reg = <0x0520>;
		clocks = <&ocp_abe_iclk>;
	};

	core_hsd_byp_clk_mux_ck: core_hsd_byp_clk_mux_ck@12c {
		#clock-cells = <0>;
		compatible = "ti,mux-clock";
		clocks = <&sys_clkin_ck>, <&dpll_abe_m3x2_ck>;
		ti,bit-shift = <23>;
		reg = <0x012c>;
	};

	dpll_core_ck: dpll_core_ck@120 {
		#clock-cells = <0>;
		compatible = "ti,omap4-dpll-core-clock";
		clocks = <&sys_clkin_ck>, <&core_hsd_byp_clk_mux_ck>;
		reg = <0x0120>, <0x0124>, <0x012c>, <0x0128>;
	};

	dpll_core_x2_ck: dpll_core_x2_ck {
		#clock-cells = <0>;
		compatible = "ti,omap4-dpll-x2-clock";
		clocks = <&dpll_core_ck>;
	};

	dpll_core_m6x2_ck: dpll_core_m6x2_ck@140 {
		#clock-cells = <0>;
		compatible = "ti,divider-clock";
		clocks = <&dpll_core_x2_ck>;
		ti,max-div = <31>;
		ti,autoidle-shift = <8>;
		reg = <0x0140>;
		ti,index-starts-at-one;
		ti,invert-autoidle-bit;
	};

	dpll_core_m2_ck: dpll_core_m2_ck@130 {
		#clock-cells = <0>;
		compatible = "ti,divider-clock";
		clocks = <&dpll_core_ck>;
		ti,max-div = <31>;
		ti,autoidle-shift = <8>;
		reg = <0x0130>;
		ti,index-starts-at-one;
		ti,invert-autoidle-bit;
	};

	ddrphy_ck: ddrphy_ck {
		#clock-cells = <0>;
		compatible = "fixed-factor-clock";
		clocks = <&dpll_core_m2_ck>;
		clock-mult = <1>;
		clock-div = <2>;
	};

	dpll_core_m5x2_ck: dpll_core_m5x2_ck@13c {
		#clock-cells = <0>;
		compatible = "ti,divider-clock";
		clocks = <&dpll_core_x2_ck>;
		ti,max-div = <31>;
		ti,autoidle-shift = <8>;
		reg = <0x013c>;
		ti,index-starts-at-one;
		ti,invert-autoidle-bit;
	};

	div_core_ck: div_core_ck@100 {
		#clock-cells = <0>;
		compatible = "ti,divider-clock";
		clocks = <&dpll_core_m5x2_ck>;
		reg = <0x0100>;
		ti,max-div = <2>;
	};

	div_iva_hs_clk: div_iva_hs_clk@1dc {
		#clock-cells = <0>;
		compatible = "ti,divider-clock";
		clocks = <&dpll_core_m5x2_ck>;
		ti,max-div = <4>;
		reg = <0x01dc>;
		ti,index-power-of-two;
	};

	div_mpu_hs_clk: div_mpu_hs_clk@19c {
		#clock-cells = <0>;
		compatible = "ti,divider-clock";
		clocks = <&dpll_core_m5x2_ck>;
		ti,max-div = <4>;
		reg = <0x019c>;
		ti,index-power-of-two;
	};

	dpll_core_m4x2_ck: dpll_core_m4x2_ck@138 {
		#clock-cells = <0>;
		compatible = "ti,divider-clock";
		clocks = <&dpll_core_x2_ck>;
		ti,max-div = <31>;
		ti,autoidle-shift = <8>;
		reg = <0x0138>;
		ti,index-starts-at-one;
		ti,invert-autoidle-bit;
	};

	dll_clk_div_ck: dll_clk_div_ck {
		#clock-cells = <0>;
		compatible = "fixed-factor-clock";
		clocks = <&dpll_core_m4x2_ck>;
		clock-mult = <1>;
		clock-div = <2>;
	};

	dpll_abe_m2_ck: dpll_abe_m2_ck@1f0 {
		#clock-cells = <0>;
		compatible = "ti,divider-clock";
		clocks = <&dpll_abe_ck>;
		ti,max-div = <31>;
		reg = <0x01f0>;
		ti,index-starts-at-one;
	};

	dpll_core_m3x2_gate_ck: dpll_core_m3x2_gate_ck@134 {
		#clock-cells = <0>;
		compatible = "ti,composite-no-wait-gate-clock";
		clocks = <&dpll_core_x2_ck>;
		ti,bit-shift = <8>;
		reg = <0x0134>;
	};

	dpll_core_m3x2_div_ck: dpll_core_m3x2_div_ck@134 {
		#clock-cells = <0>;
		compatible = "ti,composite-divider-clock";
		clocks = <&dpll_core_x2_ck>;
		ti,max-div = <31>;
		reg = <0x0134>;
		ti,index-starts-at-one;
	};

	dpll_core_m3x2_ck: dpll_core_m3x2_ck {
		#clock-cells = <0>;
		compatible = "ti,composite-clock";
		clocks = <&dpll_core_m3x2_gate_ck>, <&dpll_core_m3x2_div_ck>;
	};

	dpll_core_m7x2_ck: dpll_core_m7x2_ck@144 {
		#clock-cells = <0>;
		compatible = "ti,divider-clock";
		clocks = <&dpll_core_x2_ck>;
		ti,max-div = <31>;
		ti,autoidle-shift = <8>;
		reg = <0x0144>;
		ti,index-starts-at-one;
		ti,invert-autoidle-bit;
	};

	iva_hsd_byp_clk_mux_ck: iva_hsd_byp_clk_mux_ck@1ac {
		#clock-cells = <0>;
		compatible = "ti,mux-clock";
		clocks = <&sys_clkin_ck>, <&div_iva_hs_clk>;
		ti,bit-shift = <23>;
		reg = <0x01ac>;
	};

	dpll_iva_ck: dpll_iva_ck@1a0 {
		#clock-cells = <0>;
		compatible = "ti,omap4-dpll-clock";
		clocks = <&sys_clkin_ck>, <&iva_hsd_byp_clk_mux_ck>;
		reg = <0x01a0>, <0x01a4>, <0x01ac>, <0x01a8>;
	};

	dpll_iva_x2_ck: dpll_iva_x2_ck {
		#clock-cells = <0>;
		compatible = "ti,omap4-dpll-x2-clock";
		clocks = <&dpll_iva_ck>;
	};

	dpll_iva_m4x2_ck: dpll_iva_m4x2_ck@1b8 {
		#clock-cells = <0>;
		compatible = "ti,divider-clock";
		clocks = <&dpll_iva_x2_ck>;
		ti,max-div = <31>;
		ti,autoidle-shift = <8>;
		reg = <0x01b8>;
		ti,index-starts-at-one;
		ti,invert-autoidle-bit;
	};

	dpll_iva_m5x2_ck: dpll_iva_m5x2_ck@1bc {
		#clock-cells = <0>;
		compatible = "ti,divider-clock";
		clocks = <&dpll_iva_x2_ck>;
		ti,max-div = <31>;
		ti,autoidle-shift = <8>;
		reg = <0x01bc>;
		ti,index-starts-at-one;
		ti,invert-autoidle-bit;
	};

	dpll_mpu_ck: dpll_mpu_ck@160 {
		#clock-cells = <0>;
		compatible = "ti,omap4-dpll-clock";
		clocks = <&sys_clkin_ck>, <&div_mpu_hs_clk>;
		reg = <0x0160>, <0x0164>, <0x016c>, <0x0168>;
	};

	dpll_mpu_m2_ck: dpll_mpu_m2_ck@170 {
		#clock-cells = <0>;
		compatible = "ti,divider-clock";
		clocks = <&dpll_mpu_ck>;
		ti,max-div = <31>;
		ti,autoidle-shift = <8>;
		reg = <0x0170>;
		ti,index-starts-at-one;
		ti,invert-autoidle-bit;
	};

	per_hs_clk_div_ck: per_hs_clk_div_ck {
		#clock-cells = <0>;
		compatible = "fixed-factor-clock";
		clocks = <&dpll_abe_m3x2_ck>;
		clock-mult = <1>;
		clock-div = <2>;
	};

	usb_hs_clk_div_ck: usb_hs_clk_div_ck {
		#clock-cells = <0>;
		compatible = "fixed-factor-clock";
		clocks = <&dpll_abe_m3x2_ck>;
		clock-mult = <1>;
		clock-div = <3>;
	};

	l3_div_ck: l3_div_ck@100 {
		#clock-cells = <0>;
		compatible = "ti,divider-clock";
		clocks = <&div_core_ck>;
		ti,bit-shift = <4>;
		ti,max-div = <2>;
		reg = <0x0100>;
	};

	l4_div_ck: l4_div_ck@100 {
		#clock-cells = <0>;
		compatible = "ti,divider-clock";
		clocks = <&l3_div_ck>;
		ti,bit-shift = <8>;
		ti,max-div = <2>;
		reg = <0x0100>;
	};

	lp_clk_div_ck: lp_clk_div_ck {
		#clock-cells = <0>;
		compatible = "fixed-factor-clock";
		clocks = <&dpll_abe_m2x2_ck>;
		clock-mult = <1>;
		clock-div = <16>;
	};

	mpu_periphclk: mpu_periphclk {
		#clock-cells = <0>;
		compatible = "fixed-factor-clock";
		clocks = <&dpll_mpu_ck>;
		clock-mult = <1>;
		clock-div = <2>;
	};

	ocp_abe_iclk: ocp_abe_iclk@528 {
		#clock-cells = <0>;
		compatible = "ti,divider-clock";
		clocks = <&aess_fclk>;
		ti,bit-shift = <24>;
		reg = <0x0528>;
		ti,dividers = <2>, <1>;
	};

	per_abe_24m_fclk: per_abe_24m_fclk {
		#clock-cells = <0>;
		compatible = "fixed-factor-clock";
		clocks = <&dpll_abe_m2_ck>;
		clock-mult = <1>;
		clock-div = <4>;
	};

	dmic_sync_mux_ck: dmic_sync_mux_ck@538 {
		#clock-cells = <0>;
		compatible = "ti,mux-clock";
		clocks = <&abe_24m_fclk>, <&syc_clk_div_ck>, <&func_24m_clk>;
		ti,bit-shift = <25>;
		reg = <0x0538>;
	};

	dmic_mod_ck: dmic_mod_ck@538 {
		#clock-cells = <0>;
		compatible = "ti,omap4-sw-mod-clock";
		reg = <0x0538>;
		clocks = <&func_dmic_abe_gfclk>;
	};

	func_dmic_abe_gfclk: func_dmic_abe_gfclk@538 {
		#clock-cells = <0>;
		compatible = "ti,mux-clock";
		clocks = <&dmic_sync_mux_ck>, <&pad_clks_ck>, <&slimbus_clk>;
		ti,bit-shift = <24>;
		reg = <0x0538>;
	};

	mcasp_sync_mux_ck: mcasp_sync_mux_ck@540 {
		#clock-cells = <0>;
		compatible = "ti,mux-clock";
		clocks = <&abe_24m_fclk>, <&syc_clk_div_ck>, <&func_24m_clk>;
		ti,bit-shift = <25>;
		reg = <0x0540>;
	};

	mcasp_mod_ck: mcasp_mod_ck@540 {
		#clock-cells = <0>;
		compatible = "ti,omap4-sw-mod-clock";
		reg = <0x0540>;
		clocks = <&func_mcasp_abe_gfclk>;
	};

	func_mcasp_abe_gfclk: func_mcasp_abe_gfclk@540 {
		#clock-cells = <0>;
		compatible = "ti,mux-clock";
		clocks = <&mcasp_sync_mux_ck>, <&pad_clks_ck>, <&slimbus_clk>;
		ti,bit-shift = <24>;
		reg = <0x0540>;
	};

	mcbsp1_sync_mux_ck: mcbsp1_sync_mux_ck@548 {
		#clock-cells = <0>;
		compatible = "ti,mux-clock";
		clocks = <&abe_24m_fclk>, <&syc_clk_div_ck>, <&func_24m_clk>;
		ti,bit-shift = <25>;
		reg = <0x0548>;
	};

	func_mcbsp1_gfclk: func_mcbsp1_gfclk@548 {
		#clock-cells = <0>;
		compatible = "ti,mux-clock";
		clocks = <&mcbsp1_sync_mux_ck>, <&pad_clks_ck>, <&slimbus_clk>;
		ti,bit-shift = <24>;
		reg = <0x0548>;
	};

	mcbsp1_mod_ck: mcbsp1_mod_ck@548 {
		#clock-cells = <0>;
		compatible = "ti,omap4-sw-mod-clock";
		reg = <0x0548>;
		clocks = <&func_mcbsp1_gfclk>;
	};

	mcbsp2_sync_mux_ck: mcbsp2_sync_mux_ck@550 {
		#clock-cells = <0>;
		compatible = "ti,mux-clock";
		clocks = <&abe_24m_fclk>, <&syc_clk_div_ck>, <&func_24m_clk>;
		ti,bit-shift = <25>;
		reg = <0x0550>;
	};

	func_mcbsp2_gfclk: func_mcbsp2_gfclk@550 {
		#clock-cells = <0>;
		compatible = "ti,mux-clock";
		clocks = <&mcbsp2_sync_mux_ck>, <&pad_clks_ck>, <&slimbus_clk>;
		ti,bit-shift = <24>;
		reg = <0x0550>;
	};

	mcbsp2_mod_ck: mcbsp2_mod_ck@550 {
		#clock-cells = <0>;
		compatible = "ti,omap4-sw-mod-clock";
		reg = <0x0550>;
		clocks = <&func_mcbsp2_gfclk>;
	};

	mcbsp3_sync_mux_ck: mcbsp3_sync_mux_ck@558 {
		#clock-cells = <0>;
		compatible = "ti,mux-clock";
		clocks = <&abe_24m_fclk>, <&syc_clk_div_ck>, <&func_24m_clk>;
		ti,bit-shift = <25>;
		reg = <0x0558>;
	};

	func_mcbsp3_gfclk: func_mcbsp3_gfclk@558 {
		#clock-cells = <0>;
		compatible = "ti,mux-clock";
		clocks = <&mcbsp3_sync_mux_ck>, <&pad_clks_ck>, <&slimbus_clk>;
		ti,bit-shift = <24>;
		reg = <0x0558>;
	};

	mcbsp3_mod_ck: mcbsp3_mod_ck@558 {
		#clock-cells = <0>;
		compatible = "ti,omap4-sw-mod-clock";
		reg = <0x0558>;
		clocks = <&func_mcbsp3_gfclk>;
	};

	slimbus1_fclk_1: slimbus1_fclk_1@560 {
		#clock-cells = <0>;
		compatible = "ti,gate-clock";
		clocks = <&func_24m_clk>;
		ti,bit-shift = <9>;
		reg = <0x0560>;
	};

	slimbus1_fclk_0: slimbus1_fclk_0@560 {
		#clock-cells = <0>;
		compatible = "ti,gate-clock";
		clocks = <&abe_24m_fclk>;
		ti,bit-shift = <8>;
		reg = <0x0560>;
	};

	slimbus1_mod_ck: slimbus1_mod_ck@560 {
		#clock-cells = <0>;
		compatible = "ti,omap4-sw-mod-clock";
		reg = <0x0560>;
		clocks = <&slimbus1_fclk_0>;
	};

	timer5_mod_ck: timer5_mod_ck@568 {
		#clock-cells = <0>;
		compatible = "ti,omap4-sw-mux-mod-clock";
		reg = <0x0568>, <0x0568>;
		clocks = <&syc_clk_div_ck>, <&sys_32k_ck>;
		ti,bit-shift = <24>;
	};

	timer6_mod_ck: timer6_mod_ck@570 {
		#clock-cells = <0>;
		compatible = "ti,omap4-sw-mux-mod-clock";
		reg = <0x0570>, <0x0570>;
		clocks = <&syc_clk_div_ck>, <&sys_32k_ck>;
		ti,bit-shift = <24>;
	};

	timer7_mod_ck: timer7_mod_ck@578 {
		#clock-cells = <0>;
		compatible = "ti,omap4-sw-mux-mod-clock";
		reg = <0x0578>, <0x0578>;
		clocks = <&syc_clk_div_ck>, <&sys_32k_ck>;
		ti,bit-shift = <24>;
	};

	timer8_mod_ck: timer8_mod_ck@580 {
		#clock-cells = <0>;
		compatible = "ti,omap4-sw-mux-mod-clock";
		reg = <0x0580>, <0x0580>;
		clocks = <&syc_clk_div_ck>, <&sys_32k_ck>;
		ti,bit-shift = <24>;
	};

	wd_timer3_mod_ck: wd_timer3_mod_ck@588 {
		#clock-cells = <0>;
		compatible = "ti,omap4-sw-mod-clock";
		reg = <0x0588>;
		clocks = <&sys_32k_ck>;
	};

	slimbus1_fclk_2: slimbus1_fclk_2@560 {
		#clock-cells = <0>;
		compatible = "ti,gate-clock";
		clocks = <&pad_clks_ck>;
		ti,bit-shift = <10>;
		reg = <0x0560>;
	};

	slimbus1_slimbus_clk: slimbus1_slimbus_clk@560 {
		#clock-cells = <0>;
		compatible = "ti,gate-clock";
		clocks = <&slimbus_clk>;
		ti,bit-shift = <11>;
		reg = <0x0560>;
	};

	dummy_ck: dummy_ck {
		#clock-cells = <0>;
		compatible = "fixed-clock";
		clock-frequency = <0>;
	};
};
&prm_clocks {
	sys_clkin_ck: sys_clkin_ck@110 {
		#clock-cells = <0>;
		compatible = "ti,mux-clock";
		clocks = <&virt_12000000_ck>, <&virt_13000000_ck>, <&virt_16800000_ck>, <&virt_19200000_ck>, <&virt_26000000_ck>, <&virt_27000000_ck>, <&virt_38400000_ck>;
		reg = <0x0110>;
		ti,index-starts-at-one;
	};

	l4_wkup_mod_ck: l4_wkup_mod_ck@1820 {
		#clock-cells = <0>;
		compatible = "ti,omap4-mod-clock";
		reg = <0x1820>;
		clocks = <&l4_wkup_clk_mux_ck>;
	};

	wd_timer2_mod_ck: wd_timer2_mod_ck@1830 {
		#clock-cells = <0>;
		compatible = "ti,omap4-sw-mod-clock";
		reg = <0x1830>;
		clocks = <&sys_32k_ck>;
	};

	abe_dpll_bypass_clk_mux_ck: abe_dpll_bypass_clk_mux_ck@108 {
		#clock-cells = <0>;
		compatible = "ti,mux-clock";
		clocks = <&sys_clkin_ck>, <&sys_32k_ck>;
		ti,bit-shift = <24>;
		reg = <0x0108>;
	};

	abe_dpll_refclk_mux_ck: abe_dpll_refclk_mux_ck@10c {
		#clock-cells = <0>;
		compatible = "ti,mux-clock";
		clocks = <&sys_clkin_ck>, <&sys_32k_ck>;
		reg = <0x010c>;
	};

	dbgclk_mux_ck: dbgclk_mux_ck {
		#clock-cells = <0>;
		compatible = "fixed-factor-clock";
		clocks = <&sys_clkin_ck>;
		clock-mult = <1>;
		clock-div = <1>;
	};

	l4_wkup_clk_mux_ck: l4_wkup_clk_mux_ck@108 {
		#clock-cells = <0>;
		compatible = "ti,mux-clock";
		clocks = <&sys_clkin_ck>, <&lp_clk_div_ck>;
		reg = <0x0108>;
	};

	syc_clk_div_ck: syc_clk_div_ck@100 {
		#clock-cells = <0>;
		compatible = "ti,divider-clock";
		clocks = <&sys_clkin_ck>;
		reg = <0x0100>;
		ti,max-div = <2>;
	};

	gpio1_dbclk: gpio1_dbclk@1838 {
		#clock-cells = <0>;
		compatible = "ti,gate-clock";
		clocks = <&sys_32k_ck>;
		ti,bit-shift = <8>;
		reg = <0x1838>;
	};

	gpio1_mod_ck: gpio1_mod_ck@1838 {
		#clock-cells = <0>;
		compatible = "ti,omap4-hw-mod-clock";
		reg = <0x1838>;
		clocks = <&l4_wkup_clk_mux_ck>;
	};

	timer1_mod_ck: timer1_mod_ck@1840 {
		#clock-cells = <0>;
		compatible = "ti,omap4-sw-mux-mod-clock";
		reg = <0x1840>, <0x1840>;
		clocks = <&sys_clkin_ck>, <&sys_32k_ck>;
		ti,bit-shift = <24>;
	};

	counter_32k_mod_ck: counter_32k_mod_ck@1850 {
		#clock-cells = <0>;
		compatible = "ti,omap4-mod-clock";
		reg = <0x1850>;
		clocks = <&sys_32k_ck>;
	};

	usim_ck: usim_ck@1858 {
		#clock-cells = <0>;
		compatible = "ti,divider-clock";
		clocks = <&dpll_per_m4x2_ck>;
		ti,bit-shift = <24>;
		reg = <0x1858>;
		ti,dividers = <14>, <18>;
	};

	kbd_mod_ck: kbd_mod_ck@1878 {
		#clock-cells = <0>;
		compatible = "ti,omap4-sw-mod-clock";
		reg = <0x1878>;
		clocks = <&sys_32k_ck>;
	};

	usim_fclk: usim_fclk@1858 {
		#clock-cells = <0>;
		compatible = "ti,gate-clock";
		clocks = <&usim_ck>;
		ti,bit-shift = <8>;
		reg = <0x1858>;
	};

	pmd_stm_clock_mux_ck: pmd_stm_clock_mux_ck@1a20 {
		#clock-cells = <0>;
		compatible = "ti,mux-clock";
		clocks = <&sys_clkin_ck>, <&dpll_core_m6x2_ck>, <&tie_low_clock_ck>;
		ti,bit-shift = <20>;
		reg = <0x1a20>;
	};

	pmd_trace_clk_mux_ck: pmd_trace_clk_mux_ck@1a20 {
		#clock-cells = <0>;
		compatible = "ti,mux-clock";
		clocks = <&sys_clkin_ck>, <&dpll_core_m6x2_ck>, <&tie_low_clock_ck>;
		ti,bit-shift = <22>;
		reg = <0x1a20>;
	};

	stm_clk_div_ck: stm_clk_div_ck@1a20 {
		#clock-cells = <0>;
		compatible = "ti,divider-clock";
		clocks = <&pmd_stm_clock_mux_ck>;
		ti,bit-shift = <27>;
		ti,max-div = <64>;
		reg = <0x1a20>;
		ti,index-power-of-two;
	};

	trace_clk_div_div_ck: trace_clk_div_div_ck@1a20 {
		#clock-cells = <0>;
		compatible = "ti,divider-clock";
		clocks = <&pmd_trace_clk_mux_ck>;
		ti,bit-shift = <24>;
		reg = <0x1a20>;
		ti,dividers = <0>, <1>, <2>, <0>, <4>;
	};

	debugss_mod_ck: debugss_mod_ck@1a20 {
		#clock-cells = <0>;
		compatible = "ti,omap4-mod-clock";
		reg = <0x1a20>;
		clocks = <&trace_clk_div_ck>;
	};

	trace_clk_div_ck: trace_clk_div_ck {
		#clock-cells = <0>;
		compatible = "ti,clkdm-gate-clock";
		clocks = <&trace_clk_div_div_ck>;
	};
};

&prm_clockdomains {
	emu_sys_clkdm: emu_sys_clkdm {
		compatible = "ti,clockdomain";
		clocks = <&debugss_mod_ck>, <&trace_clk_div_ck>;
	};

	l4_wkup_clkdm: l4_wkup_clkdm {
		compatible = "ti,clockdomain";
		clocks = <&timer1_mod_ck>, <&l4_wkup_mod_ck>, <&gpio1_mod_ck>,
			 <&wd_timer2_mod_ck>, <&counter_32k_mod_ck>,
			 <&kbd_mod_ck>;
	};
};

&cm2_clocks {
	per_hsd_byp_clk_mux_ck: per_hsd_byp_clk_mux_ck@14c {
		#clock-cells = <0>;
		compatible = "ti,mux-clock";
		clocks = <&sys_clkin_ck>, <&per_hs_clk_div_ck>;
		ti,bit-shift = <23>;
		reg = <0x014c>;
	};

	dpll_per_ck: dpll_per_ck@140 {
		#clock-cells = <0>;
		compatible = "ti,omap4-dpll-clock";
		clocks = <&sys_clkin_ck>, <&per_hsd_byp_clk_mux_ck>;
		reg = <0x0140>, <0x0144>, <0x014c>, <0x0148>;
	};

	dpll_per_m2_ck: dpll_per_m2_ck@150 {
		#clock-cells = <0>;
		compatible = "ti,divider-clock";
		clocks = <&dpll_per_ck>;
		ti,max-div = <31>;
		reg = <0x0150>;
		ti,index-starts-at-one;
	};

	dpll_per_x2_ck: dpll_per_x2_ck@150 {
		#clock-cells = <0>;
		compatible = "ti,omap4-dpll-x2-clock";
		clocks = <&dpll_per_ck>;
		reg = <0x0150>;
	};

	dpll_per_m2x2_ck: dpll_per_m2x2_ck@150 {
		#clock-cells = <0>;
		compatible = "ti,divider-clock";
		clocks = <&dpll_per_x2_ck>;
		ti,max-div = <31>;
		ti,autoidle-shift = <8>;
		reg = <0x0150>;
		ti,index-starts-at-one;
		ti,invert-autoidle-bit;
	};

	dpll_per_m3x2_gate_ck: dpll_per_m3x2_gate_ck@154 {
		#clock-cells = <0>;
		compatible = "ti,composite-no-wait-gate-clock";
		clocks = <&dpll_per_x2_ck>;
		ti,bit-shift = <8>;
		reg = <0x0154>;
	};

	dpll_per_m3x2_div_ck: dpll_per_m3x2_div_ck@154 {
		#clock-cells = <0>;
		compatible = "ti,composite-divider-clock";
		clocks = <&dpll_per_x2_ck>;
		ti,max-div = <31>;
		reg = <0x0154>;
		ti,index-starts-at-one;
	};

	dpll_per_m3x2_ck: dpll_per_m3x2_ck {
		#clock-cells = <0>;
		compatible = "ti,composite-clock";
		clocks = <&dpll_per_m3x2_gate_ck>, <&dpll_per_m3x2_div_ck>;
	};

	dpll_per_m4x2_ck: dpll_per_m4x2_ck@158 {
		#clock-cells = <0>;
		compatible = "ti,divider-clock";
		clocks = <&dpll_per_x2_ck>;
		ti,max-div = <31>;
		ti,autoidle-shift = <8>;
		reg = <0x0158>;
		ti,index-starts-at-one;
		ti,invert-autoidle-bit;
	};

	dpll_per_m5x2_ck: dpll_per_m5x2_ck@15c {
		#clock-cells = <0>;
		compatible = "ti,divider-clock";
		clocks = <&dpll_per_x2_ck>;
		ti,max-div = <31>;
		ti,autoidle-shift = <8>;
		reg = <0x015c>;
		ti,index-starts-at-one;
		ti,invert-autoidle-bit;
	};

	dpll_per_m6x2_ck: dpll_per_m6x2_ck@160 {
		#clock-cells = <0>;
		compatible = "ti,divider-clock";
		clocks = <&dpll_per_x2_ck>;
		ti,max-div = <31>;
		ti,autoidle-shift = <8>;
		reg = <0x0160>;
		ti,index-starts-at-one;
		ti,invert-autoidle-bit;
	};

	dpll_per_m7x2_ck: dpll_per_m7x2_ck@164 {
		#clock-cells = <0>;
		compatible = "ti,divider-clock";
		clocks = <&dpll_per_x2_ck>;
		ti,max-div = <31>;
		ti,autoidle-shift = <8>;
		reg = <0x0164>;
		ti,index-starts-at-one;
		ti,invert-autoidle-bit;
	};

	dpll_usb_ck: dpll_usb_ck@180 {
		#clock-cells = <0>;
		compatible = "ti,omap4-dpll-j-type-clock";
		clocks = <&sys_clkin_ck>, <&usb_hs_clk_div_ck>;
		reg = <0x0180>, <0x0184>, <0x018c>, <0x0188>;
	};

	dpll_usb_clkdcoldo_ck: dpll_usb_clkdcoldo_ck@1b4 {
		#clock-cells = <0>;
		compatible = "ti,fixed-factor-clock";
		clocks = <&dpll_usb_ck>;
		ti,clock-div = <1>;
		ti,autoidle-shift = <8>;
		reg = <0x01b4>;
		ti,clock-mult = <1>;
		ti,invert-autoidle-bit;
	};

	dpll_usb_m2_ck: dpll_usb_m2_ck@190 {
		#clock-cells = <0>;
		compatible = "ti,divider-clock";
		clocks = <&dpll_usb_ck>;
		ti,max-div = <127>;
		ti,autoidle-shift = <8>;
		reg = <0x0190>;
		ti,index-starts-at-one;
		ti,invert-autoidle-bit;
	};

	ducati_clk_mux_ck: ducati_clk_mux_ck@100 {
		#clock-cells = <0>;
		compatible = "ti,mux-clock";
		clocks = <&div_core_ck>, <&dpll_per_m6x2_ck>;
		reg = <0x0100>;
	};

	func_12m_fclk: func_12m_fclk {
		#clock-cells = <0>;
		compatible = "fixed-factor-clock";
		clocks = <&dpll_per_m2x2_ck>;
		clock-mult = <1>;
		clock-div = <16>;
	};

	func_24m_clk: func_24m_clk {
		#clock-cells = <0>;
		compatible = "fixed-factor-clock";
		clocks = <&dpll_per_m2_ck>;
		clock-mult = <1>;
		clock-div = <4>;
	};

	func_24mc_fclk: func_24mc_fclk {
		#clock-cells = <0>;
		compatible = "fixed-factor-clock";
		clocks = <&dpll_per_m2x2_ck>;
		clock-mult = <1>;
		clock-div = <8>;
	};

	func_48m_fclk: func_48m_fclk@108 {
		#clock-cells = <0>;
		compatible = "ti,divider-clock";
		clocks = <&dpll_per_m2x2_ck>;
		reg = <0x0108>;
		ti,dividers = <4>, <8>;
	};

	func_48mc_fclk: func_48mc_fclk {
		#clock-cells = <0>;
		compatible = "fixed-factor-clock";
		clocks = <&dpll_per_m2x2_ck>;
		clock-mult = <1>;
		clock-div = <4>;
	};

	func_64m_fclk: func_64m_fclk@108 {
		#clock-cells = <0>;
		compatible = "ti,divider-clock";
		clocks = <&dpll_per_m4x2_ck>;
		reg = <0x0108>;
		ti,dividers = <2>, <4>;
	};

	func_96m_fclk: func_96m_fclk@108 {
		#clock-cells = <0>;
		compatible = "ti,divider-clock";
		clocks = <&dpll_per_m2x2_ck>;
		reg = <0x0108>;
		ti,dividers = <2>, <4>;
	};

	init_60m_fclk: init_60m_fclk@104 {
		#clock-cells = <0>;
		compatible = "ti,divider-clock";
		clocks = <&dpll_usb_m2_ck>;
		reg = <0x0104>;
		ti,dividers = <1>, <8>;
	};

	per_abe_nc_fclk: per_abe_nc_fclk@108 {
		#clock-cells = <0>;
		compatible = "ti,divider-clock";
		clocks = <&dpll_abe_m2_ck>;
		reg = <0x0108>;
		ti,max-div = <2>;
	};

	aes1_fck: aes1_fck@15a0 {
		#clock-cells = <0>;
		compatible = "ti,gate-clock";
		clocks = <&l3_div_ck>;
		ti,bit-shift = <1>;
		reg = <0x15a0>;
	};

	aes2_fck: aes2_fck@15a8 {
		#clock-cells = <0>;
		compatible = "ti,gate-clock";
		clocks = <&l3_div_ck>;
		ti,bit-shift = <1>;
		reg = <0x15a8>;
	};

	dss_sys_clk: dss_sys_clk@1120 {
		#clock-cells = <0>;
		compatible = "ti,gate-clock";
		clocks = <&syc_clk_div_ck>;
		ti,bit-shift = <10>;
		reg = <0x1120>;
	};

	dss_venc_mod_ck: dss_venc_mod_ck@1120 {
		#clock-cells = <0>;
		compatible = "ti,omap4-mod-clock";
		reg = <0x1120>;
		clocks = <&dss_tv_clk>;
	};

	dss_dispc_mod_ck: dss_dispc_mod_ck@1120 {
		#clock-cells = <0>;
		compatible = "ti,omap4-mod-clock";
		reg = <0x1120>;
		clocks = <&dss_dss_clk>;
	};

	dss_dsi1_mod_ck: dss_dsi1_mod_ck@1120 {
		#clock-cells = <0>;
		compatible = "ti,omap4-mod-clock";
		reg = <0x1120>;
		clocks = <&dss_dss_clk>;
	};

	dss_dsi2_mod_ck: dss_dsi2_mod_ck@1120 {
		#clock-cells = <0>;
		compatible = "ti,omap4-mod-clock";
		reg = <0x1120>;
		clocks = <&dss_dss_clk>;
	};

	dss_core_mod_ck: dss_core_mod_ck@1120 {
		#clock-cells = <0>;
		compatible = "ti,omap4-sw-mod-clock";
		reg = <0x1120>;
		clocks = <&dss_dss_clk>;
	};

	dss_rfbi_mod_ck: dss_rfbi_mod_ck@1120 {
		#clock-cells = <0>;
		compatible = "ti,omap4-mod-clock";
		reg = <0x1120>;
		clocks = <&dss_dss_clk>;
	};

	dss_hdmi_mod_ck: dss_hdmi_mod_ck@1120 {
		#clock-cells = <0>;
		compatible = "ti,omap4-mod-clock";
		reg = <0x1120>;
		clocks = <&dss_48mhz_clk>;
	};

	dss_tv_clk: dss_tv_clk@1120 {
		#clock-cells = <0>;
		compatible = "ti,gate-clock";
		clocks = <&extalt_clkin_ck>;
		ti,bit-shift = <11>;
		reg = <0x1120>;
	};

	dss_dss_clk: dss_dss_clk@1120 {
		#clock-cells = <0>;
		compatible = "ti,gate-clock";
		clocks = <&dpll_per_m5x2_ck>;
		ti,bit-shift = <8>;
		reg = <0x1120>;
		ti,set-rate-parent;
	};

	dss_48mhz_clk: dss_48mhz_clk@1120 {
		#clock-cells = <0>;
		compatible = "ti,gate-clock";
		clocks = <&func_48mc_fclk>;
		ti,bit-shift = <9>;
		reg = <0x1120>;
	};

	fdif_fck: fdif_fck@1028 {
		#clock-cells = <0>;
		compatible = "ti,divider-clock";
		clocks = <&dpll_per_m4x2_ck>;
		ti,bit-shift = <24>;
		ti,max-div = <4>;
		reg = <0x1028>;
		ti,index-power-of-two;
	};

	fdif_mod_ck: fdif_mod_ck@1028 {
		#clock-cells = <0>;
		compatible = "ti,omap4-sw-mod-clock";
		reg = <0x1028>;
		clocks = <&fdif_fck>;
	};

	gpio2_dbclk: gpio2_dbclk@1460 {
		#clock-cells = <0>;
		compatible = "ti,gate-clock";
		clocks = <&sys_32k_ck>;
		ti,bit-shift = <8>;
		reg = <0x1460>;
	};

	gpio2_mod_ck: gpio2_mod_ck@1460 {
		#clock-cells = <0>;
		compatible = "ti,omap4-hw-mod-clock";
		reg = <0x1460>;
		clocks = <&l4_div_ck>;
	};

	gpio3_dbclk: gpio3_dbclk@1468 {
		#clock-cells = <0>;
		compatible = "ti,gate-clock";
		clocks = <&sys_32k_ck>;
		ti,bit-shift = <8>;
		reg = <0x1468>;
	};

	gpio3_mod_ck: gpio3_mod_ck@1468 {
		#clock-cells = <0>;
		compatible = "ti,omap4-hw-mod-clock";
		reg = <0x1468>;
		clocks = <&l4_div_ck>;
	};

	gpio4_dbclk: gpio4_dbclk@1470 {
		#clock-cells = <0>;
		compatible = "ti,gate-clock";
		clocks = <&sys_32k_ck>;
		ti,bit-shift = <8>;
		reg = <0x1470>;
	};

	gpio4_mod_ck: gpio4_mod_ck@1470 {
		#clock-cells = <0>;
		compatible = "ti,omap4-hw-mod-clock";
		reg = <0x1470>;
		clocks = <&l4_div_ck>;
	};

	gpio5_dbclk: gpio5_dbclk@1478 {
		#clock-cells = <0>;
		compatible = "ti,gate-clock";
		clocks = <&sys_32k_ck>;
		ti,bit-shift = <8>;
		reg = <0x1478>;
	};

	gpio5_mod_ck: gpio5_mod_ck@1478 {
		#clock-cells = <0>;
		compatible = "ti,omap4-hw-mod-clock";
		reg = <0x1478>;
		clocks = <&l4_div_ck>;
	};

	gpio6_dbclk: gpio6_dbclk@1480 {
		#clock-cells = <0>;
		compatible = "ti,gate-clock";
		clocks = <&sys_32k_ck>;
		ti,bit-shift = <8>;
		reg = <0x1480>;
	};

	gpio6_mod_ck: gpio6_mod_ck@1480 {
		#clock-cells = <0>;
		compatible = "ti,omap4-hw-mod-clock";
		reg = <0x1480>;
		clocks = <&l4_div_ck>;
	};

	hdq1w_mod_ck: hdq1w_mod_ck@1488 {
		#clock-cells = <0>;
		compatible = "ti,omap4-sw-mod-clock";
		reg = <0x1488>;
		clocks = <&func_12m_fclk>;
	};

	i2c1_mod_ck: i2c1_mod_ck@14a0 {
		#clock-cells = <0>;
		compatible = "ti,omap4-sw-mod-clock";
		reg = <0x14a0>;
		clocks = <&func_96m_fclk>;
	};

	i2c2_mod_ck: i2c2_mod_ck@14a8 {
		#clock-cells = <0>;
		compatible = "ti,omap4-sw-mod-clock";
		reg = <0x14a8>;
		clocks = <&func_96m_fclk>;
	};

	i2c3_mod_ck: i2c3_mod_ck@14b0 {
		#clock-cells = <0>;
		compatible = "ti,omap4-sw-mod-clock";
		reg = <0x14b0>;
		clocks = <&func_96m_fclk>;
	};

	i2c4_mod_ck: i2c4_mod_ck@14b8 {
		#clock-cells = <0>;
		compatible = "ti,omap4-sw-mod-clock";
		reg = <0x14b8>;
		clocks = <&func_96m_fclk>;
	};

	l4_per_mod_ck: l4_per_mod_ck@14c0 {
		#clock-cells = <0>;
		compatible = "ti,omap4-mod-clock";
		reg = <0x14c0>;
		clocks = <&l4_div_ck>;
	};

	sgx_clk_mux: sgx_clk_mux@1220 {
		#clock-cells = <0>;
		compatible = "ti,mux-clock";
		clocks = <&dpll_core_m7x2_ck>, <&dpll_per_m7x2_ck>;
		ti,bit-shift = <24>;
		reg = <0x1220>;
	};

	gpu_mod_ck: gpu_mod_ck@1220 {
		#clock-cells = <0>;
		compatible = "ti,omap4-sw-mod-clock";
		reg = <0x1220>;
		clocks = <&sgx_clk_mux>;
	};

	hsi_fck: hsi_fck@1338 {
		#clock-cells = <0>;
		compatible = "ti,divider-clock";
		clocks = <&dpll_per_m2x2_ck>;
		ti,bit-shift = <24>;
		ti,max-div = <4>;
		reg = <0x1338>;
		ti,index-power-of-two;
	};

	hsi_mod_ck: hsi_mod_ck@1338 {
		#clock-cells = <0>;
		compatible = "ti,omap4-hw-mod-clock";
		reg = <0x1338>;
		clocks = <&hsi_fck>;
	};

	iss_ctrlclk: iss_ctrlclk@1020 {
		#clock-cells = <0>;
		compatible = "ti,gate-clock";
		clocks = <&func_96m_fclk>;
		ti,bit-shift = <8>;
		reg = <0x1020>;
	};

	iss_mod_ck: iss_mod_ck@1020 {
		#clock-cells = <0>;
		compatible = "ti,omap4-sw-mod-clock";
		reg = <0x1020>;
		clocks = <&ducati_clk_mux_ck>;
	};

	mcbsp4_sync_mux_ck: mcbsp4_sync_mux_ck@14e0 {
		#clock-cells = <0>;
		compatible = "ti,mux-clock";
		clocks = <&func_96m_fclk>, <&per_abe_nc_fclk>;
		ti,bit-shift = <25>;
		reg = <0x14e0>;
	};

	mcbsp4_mod_ck: mcbsp4_mod_ck@14e0 {
		#clock-cells = <0>;
		compatible = "ti,omap4-sw-mod-clock";
		reg = <0x14e0>;
		clocks = <&per_mcbsp4_gfclk>;
	};

	mcspi1_mod_ck: mcspi1_mod_ck@14f0 {
		#clock-cells = <0>;
		compatible = "ti,omap4-sw-mod-clock";
		reg = <0x14f0>;
		clocks = <&func_48m_fclk>;
	};

	mcspi2_mod_ck: mcspi2_mod_ck@14f8 {
		#clock-cells = <0>;
		compatible = "ti,omap4-sw-mod-clock";
		reg = <0x14f8>;
		clocks = <&func_48m_fclk>;
	};

	mcspi3_mod_ck: mcspi3_mod_ck@1500 {
		#clock-cells = <0>;
		compatible = "ti,omap4-sw-mod-clock";
		reg = <0x1500>;
		clocks = <&func_48m_fclk>;
	};

	mcspi4_mod_ck: mcspi4_mod_ck@1508 {
		#clock-cells = <0>;
		compatible = "ti,omap4-sw-mod-clock";
		reg = <0x1508>;
		clocks = <&func_48m_fclk>;
	};

	mmc3_mod_ck: mmc3_mod_ck@1520 {
		#clock-cells = <0>;
		compatible = "ti,omap4-sw-mod-clock";
		reg = <0x1520>;
		clocks = <&func_48m_fclk>;
	};

	mmc4_mod_ck: mmc4_mod_ck@1528 {
		#clock-cells = <0>;
		compatible = "ti,omap4-sw-mod-clock";
		reg = <0x1528>;
		clocks = <&func_48m_fclk>;
	};

	per_mcbsp4_gfclk: per_mcbsp4_gfclk@14e0 {
		#clock-cells = <0>;
		compatible = "ti,mux-clock";
		clocks = <&mcbsp4_sync_mux_ck>, <&pad_clks_ck>;
		ti,bit-shift = <24>;
		reg = <0x14e0>;
	};

	hsmmc1_fclk: hsmmc1_fclk@1328 {
		#clock-cells = <0>;
		compatible = "ti,mux-clock";
		clocks = <&func_64m_fclk>, <&func_96m_fclk>;
		ti,bit-shift = <24>;
		reg = <0x1328>;
	};

	mmc1_mod_ck: mmc1_mod_ck@1328 {
		#clock-cells = <0>;
		compatible = "ti,omap4-sw-mod-clock";
		reg = <0x1328>;
		clocks = <&hsmmc1_fclk>;
	};

	hsmmc2_fclk: hsmmc2_fclk@1330 {
		#clock-cells = <0>;
		compatible = "ti,mux-clock";
		clocks = <&func_64m_fclk>, <&func_96m_fclk>;
		ti,bit-shift = <24>;
		reg = <0x1330>;
	};

	mmc2_mod_ck: mmc2_mod_ck@1330 {
		#clock-cells = <0>;
		compatible = "ti,omap4-sw-mod-clock";
		reg = <0x1330>;
		clocks = <&hsmmc2_fclk>;
	};

	ocp2scp_usb_phy_phy_48m: ocp2scp_usb_phy_phy_48m@13e0 {
		#clock-cells = <0>;
		compatible = "ti,gate-clock";
		clocks = <&func_48m_fclk>;
		ti,bit-shift = <8>;
		reg = <0x13e0>;
	};

	ocp2scp_usb_phy_mod_ck: ocp2scp_usb_phy_mod_ck@13e0 {
		#clock-cells = <0>;
		compatible = "ti,omap4-hw-mod-clock";
		reg = <0x13e0>;
		clocks = <&ocp2scp_usb_phy_phy_48m>;
	};

	timer10_mod_ck: timer10_mod_ck@1428 {
		#clock-cells = <0>;
		compatible = "ti,omap4-sw-mux-mod-clock";
		reg = <0x1428>, <0x1428>;
		clocks = <&sys_clkin_ck>, <&sys_32k_ck>;
		ti,bit-shift = <24>;
	};

	timer11_mod_ck: timer11_mod_ck@1430 {
		#clock-cells = <0>;
		compatible = "ti,omap4-sw-mux-mod-clock";
		reg = <0x1430>, <0x1430>;
		clocks = <&sys_clkin_ck>, <&sys_32k_ck>;
		ti,bit-shift = <24>;
	};

	timer2_mod_ck: timer2_mod_ck@1438 {
		#clock-cells = <0>;
		compatible = "ti,omap4-sw-mux-mod-clock";
		reg = <0x1438>, <0x1438>;
		clocks = <&sys_clkin_ck>, <&sys_32k_ck>;
		ti,bit-shift = <24>;
	};

	timer3_mod_ck: timer3_mod_ck@1440 {
		#clock-cells = <0>;
		compatible = "ti,omap4-sw-mux-mod-clock";
		reg = <0x1440>, <0x1440>;
		clocks = <&sys_clkin_ck>, <&sys_32k_ck>;
		ti,bit-shift = <24>;
	};

	timer4_mod_ck: timer4_mod_ck@1448 {
		#clock-cells = <0>;
		compatible = "ti,omap4-sw-mux-mod-clock";
		reg = <0x1448>, <0x1448>;
		clocks = <&sys_clkin_ck>, <&sys_32k_ck>;
		ti,bit-shift = <24>;
	};

	timer9_mod_ck: timer9_mod_ck@1450 {
		#clock-cells = <0>;
		compatible = "ti,omap4-sw-mux-mod-clock";
		reg = <0x1450>, <0x1450>;
		clocks = <&sys_clkin_ck>, <&sys_32k_ck>;
		ti,bit-shift = <24>;
	};

	elm_mod_ck: elm_mod_ck@1458 {
		#clock-cells = <0>;
		compatible = "ti,omap4-mod-clock";
		reg = <0x1458>;
		clocks = <&l4_div_ck>;
	};

	sha2md5_fck: sha2md5_fck@15c8 {
		#clock-cells = <0>;
		compatible = "ti,gate-clock";
		clocks = <&l3_div_ck>;
		ti,bit-shift = <1>;
		reg = <0x15c8>;
	};

	slimbus2_fclk_1: slimbus2_fclk_1@1538 {
		#clock-cells = <0>;
		compatible = "ti,gate-clock";
		clocks = <&per_abe_24m_fclk>;
		ti,bit-shift = <9>;
		reg = <0x1538>;
	};

	slimbus2_fclk_0: slimbus2_fclk_0@1538 {
		#clock-cells = <0>;
		compatible = "ti,gate-clock";
		clocks = <&func_24mc_fclk>;
		ti,bit-shift = <8>;
		reg = <0x1538>;
	};

	slimbus2_slimbus_clk: slimbus2_slimbus_clk@1538 {
		#clock-cells = <0>;
		compatible = "ti,gate-clock";
		clocks = <&pad_slimbus_core_clks_ck>;
		ti,bit-shift = <10>;
		reg = <0x1538>;
	};

	slimbus2_mod_ck: slimbus2_mod_ck@1538 {
		#clock-cells = <0>;
		compatible = "ti,omap4-sw-mod-clock";
		reg = <0x1538>;
		clocks = <&slimbus2_fclk_0>;
	};

	uart1_mod_ck: uart1_mod_ck@1540 {
		#clock-cells = <0>;
		compatible = "ti,omap4-sw-mod-clock";
		reg = <0x1540>;
		clocks = <&func_48m_fclk>;
	};

	uart2_mod_ck: uart2_mod_ck@1548 {
		#clock-cells = <0>;
		compatible = "ti,omap4-sw-mod-clock";
		reg = <0x1548>;
		clocks = <&func_48m_fclk>;
	};

	uart3_mod_ck: uart3_mod_ck@1550 {
		#clock-cells = <0>;
		compatible = "ti,omap4-sw-mod-clock";
		reg = <0x1550>;
		clocks = <&func_48m_fclk>;
	};

	uart4_mod_ck: uart4_mod_ck@1558 {
		#clock-cells = <0>;
		compatible = "ti,omap4-sw-mod-clock";
		reg = <0x1558>;
		clocks = <&func_48m_fclk>;
	};

	mmc5_mod_ck: mmc5_mod_ck@1560 {
		#clock-cells = <0>;
		compatible = "ti,omap4-sw-mod-clock";
		reg = <0x1560>;
		clocks = <&func_48m_fclk>;
	};

	smartreflex_core_fck: smartreflex_core_fck@638 {
		#clock-cells = <0>;
		compatible = "ti,gate-clock";
		clocks = <&l4_wkup_clk_mux_ck>;
		ti,bit-shift = <1>;
		reg = <0x0638>;
	};

	smartreflex_core_mod_ck: smartreflex_core_mod_ck@638 {
		#clock-cells = <0>;
		compatible = "ti,omap4-sw-mod-clock";
		reg = <0x0638>;
		clocks = <&smartreflex_core_fck>;
	};

	smartreflex_iva_fck: smartreflex_iva_fck@630 {
		#clock-cells = <0>;
		compatible = "ti,gate-clock";
		clocks = <&l4_wkup_clk_mux_ck>;
		ti,bit-shift = <1>;
		reg = <0x0630>;
	};

	smartreflex_iva_mod_ck: smartreflex_iva_mod_ck@630 {
		#clock-cells = <0>;
		compatible = "ti,omap4-sw-mod-clock";
		reg = <0x0630>;
		clocks = <&smartreflex_iva_fck>;
	};

	smartreflex_mpu_fck: smartreflex_mpu_fck@628 {
		#clock-cells = <0>;
		compatible = "ti,gate-clock";
		clocks = <&l4_wkup_clk_mux_ck>;
		ti,bit-shift = <1>;
		reg = <0x0628>;
	};

	smartreflex_mpu_mod_ck: smartreflex_mpu_mod_ck@628 {
		#clock-cells = <0>;
		compatible = "ti,omap4-sw-mod-clock";
		reg = <0x0628>;
		clocks = <&smartreflex_mpu_fck>;
	};

	usb_host_fs_fck: usb_host_fs_fck@13d0 {
		#clock-cells = <0>;
		compatible = "ti,gate-clock";
		clocks = <&func_48mc_fclk>;
		ti,bit-shift = <1>;
		reg = <0x13d0>;
	};

	usb_host_fs_mod_ck: usb_host_fs_mod_ck@13d0 {
		#clock-cells = <0>;
		compatible = "ti,omap4-sw-mod-clock";
		reg = <0x13d0>;
		clocks = <&usb_host_fs_fck>;
	};

	utmi_p1_gfclk: utmi_p1_gfclk@1358 {
		#clock-cells = <0>;
		compatible = "ti,mux-clock";
		clocks = <&init_60m_fclk>, <&xclk60mhsp1_ck>;
		ti,bit-shift = <24>;
		reg = <0x1358>;
	};

	usb_host_hs_utmi_p1_clk: usb_host_hs_utmi_p1_clk@1358 {
		#clock-cells = <0>;
		compatible = "ti,gate-clock";
		clocks = <&utmi_p1_gfclk>;
		ti,bit-shift = <8>;
		reg = <0x1358>;
	};

	usb_host_hs_mod_ck: usb_host_hs_mod_ck@1358 {
		#clock-cells = <0>;
		compatible = "ti,omap4-sw-mod-clock";
		reg = <0x1358>;
		clocks = <&usb_host_hs_fck>;
	};

	utmi_p2_gfclk: utmi_p2_gfclk@1358 {
		#clock-cells = <0>;
		compatible = "ti,mux-clock";
		clocks = <&init_60m_fclk>, <&xclk60mhsp2_ck>;
		ti,bit-shift = <25>;
		reg = <0x1358>;
	};

	usb_host_hs_utmi_p2_clk: usb_host_hs_utmi_p2_clk@1358 {
		#clock-cells = <0>;
		compatible = "ti,gate-clock";
		clocks = <&utmi_p2_gfclk>;
		ti,bit-shift = <9>;
		reg = <0x1358>;
	};

	usb_host_hs_utmi_p3_clk: usb_host_hs_utmi_p3_clk@1358 {
		#clock-cells = <0>;
		compatible = "ti,gate-clock";
		clocks = <&init_60m_fclk>;
		ti,bit-shift = <10>;
		reg = <0x1358>;
	};

	usb_host_hs_hsic480m_p1_clk: usb_host_hs_hsic480m_p1_clk@1358 {
		#clock-cells = <0>;
		compatible = "ti,gate-clock";
		clocks = <&dpll_usb_m2_ck>;
		ti,bit-shift = <13>;
		reg = <0x1358>;
	};

	usb_host_hs_hsic60m_p1_clk: usb_host_hs_hsic60m_p1_clk@1358 {
		#clock-cells = <0>;
		compatible = "ti,gate-clock";
		clocks = <&init_60m_fclk>;
		ti,bit-shift = <11>;
		reg = <0x1358>;
	};

	usb_host_hs_hsic60m_p2_clk: usb_host_hs_hsic60m_p2_clk@1358 {
		#clock-cells = <0>;
		compatible = "ti,gate-clock";
		clocks = <&init_60m_fclk>;
		ti,bit-shift = <12>;
		reg = <0x1358>;
	};

	usb_host_hs_hsic480m_p2_clk: usb_host_hs_hsic480m_p2_clk@1358 {
		#clock-cells = <0>;
		compatible = "ti,gate-clock";
		clocks = <&dpll_usb_m2_ck>;
		ti,bit-shift = <14>;
		reg = <0x1358>;
	};

	usb_host_hs_func48mclk: usb_host_hs_func48mclk@1358 {
		#clock-cells = <0>;
		compatible = "ti,gate-clock";
		clocks = <&func_48mc_fclk>;
		ti,bit-shift = <15>;
		reg = <0x1358>;
	};

	usb_host_hs_fck: usb_host_hs_fck@1358 {
		#clock-cells = <0>;
		compatible = "ti,gate-clock";
		clocks = <&init_60m_fclk>;
		ti,bit-shift = <1>;
		reg = <0x1358>;
	};

	otg_60m_gfclk: otg_60m_gfclk@1360 {
		#clock-cells = <0>;
		compatible = "ti,mux-clock";
		clocks = <&utmi_phy_clkout_ck>, <&xclk60motg_ck>;
		ti,bit-shift = <24>;
		reg = <0x1360>;
	};

	usb_otg_hs_mod_ck: usb_otg_hs_mod_ck@1360 {
		#clock-cells = <0>;
		compatible = "ti,omap4-hw-mod-clock";
		reg = <0x1360>;
		clocks = <&usb_otg_hs_ick>;
	};

	usb_otg_hs_xclk: usb_otg_hs_xclk@1360 {
		#clock-cells = <0>;
		compatible = "ti,gate-clock";
		clocks = <&otg_60m_gfclk>;
		ti,bit-shift = <8>;
		reg = <0x1360>;
	};

	usb_otg_hs_ick: usb_otg_hs_ick@1360 {
		#clock-cells = <0>;
		compatible = "ti,gate-clock";
		clocks = <&l3_div_ck>;
		ti,bit-shift = <0>;
		reg = <0x1360>;
	};

	usb_phy_cm_clk32k: usb_phy_cm_clk32k@640 {
		#clock-cells = <0>;
		compatible = "ti,gate-clock";
		clocks = <&sys_32k_ck>;
		ti,bit-shift = <8>;
		reg = <0x0640>;
	};

	l3_main_1_mod_ck: l3_main_1_mod_ck@720 {
		#clock-cells = <0>;
		compatible = "ti,omap4-mod-clock";
		reg = <0x0720>;
		clocks = <&l3_div_ck>;
	};

	l3_main_2_mod_ck: l3_main_2_mod_ck@820 {
		#clock-cells = <0>;
		compatible = "ti,omap4-mod-clock";
		reg = <0x0820>;
		clocks = <&l3_div_ck>;
	};

	gpmc_mod_ck: gpmc_mod_ck@828 {
		#clock-cells = <0>;
		compatible = "ti,omap4-hw-mod-clock";
		reg = <0x0828>;
		clocks = <&l3_div_ck>;
	};

	ocmc_ram_mod_ck: ocmc_ram_mod_ck@830 {
		#clock-cells = <0>;
		compatible = "ti,omap4-mod-clock";
		reg = <0x0830>;
		clocks = <&l3_div_ck>;
	};

	ipu_mod_ck: ipu_mod_ck@920 {
		#clock-cells = <0>;
		compatible = "ti,omap4-hw-mod-clock";
		reg = <0x0920>;
		clocks = <&ducati_clk_mux_ck>;
	};

	mmu_ipu_mod_ck: mmu_ipu_mod_ck@920 {
		#clock-cells = <0>;
		compatible = "ti,omap4-hw-mod-clock";
		reg = <0x0920>;
		clocks = <&ducati_clk_mux_ck>;
	};

	dma_system_mod_ck: dma_system_mod_ck@a20 {
		#clock-cells = <0>;
		compatible = "ti,omap4-mod-clock";
		reg = <0x0a20>;
		clocks = <&l3_div_ck>;
	};

	dmm_mod_ck: dmm_mod_ck@b20 {
		#clock-cells = <0>;
		compatible = "ti,omap4-mod-clock";
		reg = <0x0b20>;
		clocks = <&l3_div_ck>;
	};

	emif1_mod_ck: emif1_mod_ck@b30 {
		#clock-cells = <0>;
		compatible = "ti,omap4-hw-mod-clock";
		reg = <0x0b30>;
		clocks = <&ddrphy_ck>;
	};

	emif2_mod_ck: emif2_mod_ck@b38 {
		#clock-cells = <0>;
		compatible = "ti,omap4-hw-mod-clock";
		reg = <0x0b38>;
		clocks = <&ddrphy_ck>;
	};

	c2c_mod_ck: c2c_mod_ck@c20 {
		#clock-cells = <0>;
		compatible = "ti,omap4-mod-clock";
		reg = <0x0c20>;
		clocks = <&div_core_ck>;
	};

	l4_cfg_mod_ck: l4_cfg_mod_ck@d20 {
		#clock-cells = <0>;
		compatible = "ti,omap4-mod-clock";
		reg = <0x0d20>;
		clocks = <&l4_div_ck>;
	};

	spinlock_mod_ck: spinlock_mod_ck@d28 {
		#clock-cells = <0>;
		compatible = "ti,omap4-mod-clock";
		reg = <0x0d28>;
		clocks = <&l4_div_ck>;
	};

	mailbox_mod_ck: mailbox_mod_ck@d30 {
		#clock-cells = <0>;
		compatible = "ti,omap4-mod-clock";
		reg = <0x0d30>;
		clocks = <&l4_div_ck>;
	};

	l3_main_3_mod_ck: l3_main_3_mod_ck@e20 {
		#clock-cells = <0>;
		compatible = "ti,omap4-hw-mod-clock";
		reg = <0x0e20>;
		clocks = <&l3_div_ck>;
	};

	l3_instr_mod_ck: l3_instr_mod_ck@e28 {
		#clock-cells = <0>;
		compatible = "ti,omap4-hw-mod-clock";
		reg = <0x0e28>;
		clocks = <&l3_div_ck>;
	};

	ocp_wp_noc_mod_ck: ocp_wp_noc_mod_ck@e40 {
		#clock-cells = <0>;
		compatible = "ti,omap4-hw-mod-clock";
		reg = <0x0e40>;
		clocks = <&l3_div_ck>;
	};

	iva_mod_ck: iva_mod_ck@f20 {
		#clock-cells = <0>;
		compatible = "ti,omap4-hw-mod-clock";
		reg = <0x0f20>;
		clocks = <&dpll_iva_m5x2_ck>;
	};

	sl2if_mod_ck: sl2if_mod_ck@f28 {
		#clock-cells = <0>;
		compatible = "ti,omap4-hw-mod-clock";
		reg = <0x0f28>;
		clocks = <&dpll_iva_m5x2_ck>;
	};

	usb_tll_hs_usb_ch2_clk: usb_tll_hs_usb_ch2_clk@1368 {
		#clock-cells = <0>;
		compatible = "ti,gate-clock";
		clocks = <&init_60m_fclk>;
		ti,bit-shift = <10>;
		reg = <0x1368>;
	};

	usb_tll_hs_usb_ch0_clk: usb_tll_hs_usb_ch0_clk@1368 {
		#clock-cells = <0>;
		compatible = "ti,gate-clock";
		clocks = <&init_60m_fclk>;
		ti,bit-shift = <8>;
		reg = <0x1368>;
	};

	usb_tll_hs_usb_ch1_clk: usb_tll_hs_usb_ch1_clk@1368 {
		#clock-cells = <0>;
		compatible = "ti,gate-clock";
		clocks = <&init_60m_fclk>;
		ti,bit-shift = <9>;
		reg = <0x1368>;
	};

	usb_tll_hs_ick: usb_tll_hs_ick@1368 {
		#clock-cells = <0>;
		compatible = "ti,gate-clock";
		clocks = <&l4_div_ck>;
		ti,bit-shift = <0>;
		reg = <0x1368>;
	};

	usb_tll_hs_mod_ck: usb_tll_hs_mod_ck@1368 {
		#clock-cells = <0>;
		compatible = "ti,omap4-hw-mod-clock";
		reg = <0x1368>;
		clocks = <&usb_tll_hs_ick>;
	};
};

&cm2_clockdomains {
	l3_init_clkdm: l3_init_clkdm {
		compatible = "ti,clockdomain";
		clocks = <&mmc2_mod_ck>, <&usb_otg_hs_mod_ck>,
			 <&usb_host_fs_mod_ck>, <&usb_tll_hs_mod_ck>,
			 <&usb_host_hs_mod_ck>, <&mmc1_mod_ck>, <&hsi_mod_ck>,
			 <&ocp2scp_usb_phy_mod_ck>, <&dpll_usb_ck>,
			 <&usb_host_fs_fck>;
	};

	l3_gfx_clkdm: l3_gfx_clkdm {
		compatible = "ti,clockdomain";
		clocks = <&gpu_mod_ck>;
	};

	l4_per_clkdm: l4_per_clkdm {
		compatible = "ti,clockdomain";
		clocks = <&l4_per_mod_ck>, <&uart2_mod_ck>, <&uart1_mod_ck>,
			 <&timer10_mod_ck>, <&gpio2_mod_ck>, <&mcspi3_mod_ck>,
			 <&uart4_mod_ck>, <&gpio5_mod_ck>, <&hdq1w_mod_ck>,
			 <&mcbsp4_mod_ck>, <&i2c1_mod_ck>, <&i2c3_mod_ck>,
			 <&mcspi2_mod_ck>, <&timer9_mod_ck>, <&i2c4_mod_ck>,
			 <&timer2_mod_ck>, <&timer4_mod_ck>, <&mcspi4_mod_ck>,
			 <&timer11_mod_ck>, <&mcspi1_mod_ck>, <&timer3_mod_ck>,
			 <&mmc3_mod_ck>, <&mmc5_mod_ck>, <&gpio4_mod_ck>,
			 <&gpio6_mod_ck>, <&uart3_mod_ck>, <&slimbus2_mod_ck>,
			 <&gpio3_mod_ck>, <&i2c2_mod_ck>, <&mmc4_mod_ck>,
			 <&elm_mod_ck>;
	};

	ivahd_clkdm: ivahd_clkdm {
		compatible = "ti,clockdomain";
		clocks = <&sl2if_mod_ck>, <&iva_mod_ck>;
	};

	l4_cfg_clkdm: l4_cfg_clkdm {
		compatible = "ti,clockdomain";
		clocks = <&spinlock_mod_ck>, <&mailbox_mod_ck>,
			 <&l4_cfg_mod_ck>;
	};

	l3_instr_clkdm: l3_instr_clkdm {
		compatible = "ti,clockdomain";
		clocks = <&ocp_wp_noc_mod_ck>, <&l3_main_3_mod_ck>,
			 <&l3_instr_mod_ck>;
	};

	iss_clkdm: iss_clkdm {
		compatible = "ti,clockdomain";
		clocks = <&fdif_mod_ck>, <&iss_mod_ck>;
	};

	l3_emif_clkdm: l3_emif_clkdm {
		compatible = "ti,clockdomain";
		clocks = <&emif2_mod_ck>, <&emif1_mod_ck>, <&dmm_mod_ck>;
	};

	ducati_clkdm: ducati_clkdm {
		compatible = "ti,clockdomain";
		clocks = <&ipu_mod_ck>, <&mmu_ipu_mod_ck>;
	};

	l3_dma_clkdm: l3_dma_clkdm {
		compatible = "ti,clockdomain";
		clocks = <&dma_system_mod_ck>;
	};

	l3_2_clkdm: l3_2_clkdm {
		compatible = "ti,clockdomain";
		clocks = <&gpmc_mod_ck>, <&l3_main_2_mod_ck>,
			 <&ocmc_ram_mod_ck>;
	};

	l3_dss_clkdm: l3_dss_clkdm {
		compatible = "ti,clockdomain";
		clocks = <&dss_venc_mod_ck>, <&dss_hdmi_mod_ck>,
			 <&dss_dsi2_mod_ck>, <&dss_core_mod_ck>,
			 <&dss_dsi1_mod_ck>, <&dss_rfbi_mod_ck>,
			 <&dss_dispc_mod_ck>;
	};

	l4_ao_clkdm: l4_ao_clkdm {
		compatible = "ti,clockdomain";
		clocks = <&smartreflex_core_mod_ck>, <&smartreflex_mpu_mod_ck>,
			 <&smartreflex_iva_mod_ck>;
	};

	d2d_clkdm: d2d_clkdm {
		compatible = "ti,clockdomain";
		clocks = <&c2c_mod_ck>;
	};

	l3_1_clkdm: l3_1_clkdm {
		compatible = "ti,clockdomain";
		clocks = <&l3_main_1_mod_ck>;
	};
};

&scrm_clocks {
	auxclk0_src_gate_ck: auxclk0_src_gate_ck@310 {
		#clock-cells = <0>;
		compatible = "ti,composite-no-wait-gate-clock";
		clocks = <&dpll_core_m3x2_ck>;
		ti,bit-shift = <8>;
		reg = <0x0310>;
	};

	auxclk0_src_mux_ck: auxclk0_src_mux_ck@310 {
		#clock-cells = <0>;
		compatible = "ti,composite-mux-clock";
		clocks = <&sys_clkin_ck>, <&dpll_core_m3x2_ck>, <&dpll_per_m3x2_ck>;
		ti,bit-shift = <1>;
		reg = <0x0310>;
	};

	auxclk0_src_ck: auxclk0_src_ck {
		#clock-cells = <0>;
		compatible = "ti,composite-clock";
		clocks = <&auxclk0_src_gate_ck>, <&auxclk0_src_mux_ck>;
	};

	auxclk0_ck: auxclk0_ck@310 {
		#clock-cells = <0>;
		compatible = "ti,divider-clock";
		clocks = <&auxclk0_src_ck>;
		ti,bit-shift = <16>;
		ti,max-div = <16>;
		reg = <0x0310>;
	};

	auxclk1_src_gate_ck: auxclk1_src_gate_ck@314 {
		#clock-cells = <0>;
		compatible = "ti,composite-no-wait-gate-clock";
		clocks = <&dpll_core_m3x2_ck>;
		ti,bit-shift = <8>;
		reg = <0x0314>;
	};

	auxclk1_src_mux_ck: auxclk1_src_mux_ck@314 {
		#clock-cells = <0>;
		compatible = "ti,composite-mux-clock";
		clocks = <&sys_clkin_ck>, <&dpll_core_m3x2_ck>, <&dpll_per_m3x2_ck>;
		ti,bit-shift = <1>;
		reg = <0x0314>;
	};

	auxclk1_src_ck: auxclk1_src_ck {
		#clock-cells = <0>;
		compatible = "ti,composite-clock";
		clocks = <&auxclk1_src_gate_ck>, <&auxclk1_src_mux_ck>;
	};

	auxclk1_ck: auxclk1_ck@314 {
		#clock-cells = <0>;
		compatible = "ti,divider-clock";
		clocks = <&auxclk1_src_ck>;
		ti,bit-shift = <16>;
		ti,max-div = <16>;
		reg = <0x0314>;
	};

	auxclk2_src_gate_ck: auxclk2_src_gate_ck@318 {
		#clock-cells = <0>;
		compatible = "ti,composite-no-wait-gate-clock";
		clocks = <&dpll_core_m3x2_ck>;
		ti,bit-shift = <8>;
		reg = <0x0318>;
	};

	auxclk2_src_mux_ck: auxclk2_src_mux_ck@318 {
		#clock-cells = <0>;
		compatible = "ti,composite-mux-clock";
		clocks = <&sys_clkin_ck>, <&dpll_core_m3x2_ck>, <&dpll_per_m3x2_ck>;
		ti,bit-shift = <1>;
		reg = <0x0318>;
	};

	auxclk2_src_ck: auxclk2_src_ck {
		#clock-cells = <0>;
		compatible = "ti,composite-clock";
		clocks = <&auxclk2_src_gate_ck>, <&auxclk2_src_mux_ck>;
	};

	auxclk2_ck: auxclk2_ck@318 {
		#clock-cells = <0>;
		compatible = "ti,divider-clock";
		clocks = <&auxclk2_src_ck>;
		ti,bit-shift = <16>;
		ti,max-div = <16>;
		reg = <0x0318>;
	};

	auxclk3_src_gate_ck: auxclk3_src_gate_ck@31c {
		#clock-cells = <0>;
		compatible = "ti,composite-no-wait-gate-clock";
		clocks = <&dpll_core_m3x2_ck>;
		ti,bit-shift = <8>;
		reg = <0x031c>;
	};

	auxclk3_src_mux_ck: auxclk3_src_mux_ck@31c {
		#clock-cells = <0>;
		compatible = "ti,composite-mux-clock";
		clocks = <&sys_clkin_ck>, <&dpll_core_m3x2_ck>, <&dpll_per_m3x2_ck>;
		ti,bit-shift = <1>;
		reg = <0x031c>;
	};

	auxclk3_src_ck: auxclk3_src_ck {
		#clock-cells = <0>;
		compatible = "ti,composite-clock";
		clocks = <&auxclk3_src_gate_ck>, <&auxclk3_src_mux_ck>;
	};

	auxclk3_ck: auxclk3_ck@31c {
		#clock-cells = <0>;
		compatible = "ti,divider-clock";
		clocks = <&auxclk3_src_ck>;
		ti,bit-shift = <16>;
		ti,max-div = <16>;
		reg = <0x031c>;
	};

	auxclk4_src_gate_ck: auxclk4_src_gate_ck@320 {
		#clock-cells = <0>;
		compatible = "ti,composite-no-wait-gate-clock";
		clocks = <&dpll_core_m3x2_ck>;
		ti,bit-shift = <8>;
		reg = <0x0320>;
	};

	auxclk4_src_mux_ck: auxclk4_src_mux_ck@320 {
		#clock-cells = <0>;
		compatible = "ti,composite-mux-clock";
		clocks = <&sys_clkin_ck>, <&dpll_core_m3x2_ck>, <&dpll_per_m3x2_ck>;
		ti,bit-shift = <1>;
		reg = <0x0320>;
	};

	auxclk4_src_ck: auxclk4_src_ck {
		#clock-cells = <0>;
		compatible = "ti,composite-clock";
		clocks = <&auxclk4_src_gate_ck>, <&auxclk4_src_mux_ck>;
	};

	auxclk4_ck: auxclk4_ck@320 {
		#clock-cells = <0>;
		compatible = "ti,divider-clock";
		clocks = <&auxclk4_src_ck>;
		ti,bit-shift = <16>;
		ti,max-div = <16>;
		reg = <0x0320>;
	};

	auxclk5_src_gate_ck: auxclk5_src_gate_ck@324 {
		#clock-cells = <0>;
		compatible = "ti,composite-no-wait-gate-clock";
		clocks = <&dpll_core_m3x2_ck>;
		ti,bit-shift = <8>;
		reg = <0x0324>;
	};

	auxclk5_src_mux_ck: auxclk5_src_mux_ck@324 {
		#clock-cells = <0>;
		compatible = "ti,composite-mux-clock";
		clocks = <&sys_clkin_ck>, <&dpll_core_m3x2_ck>, <&dpll_per_m3x2_ck>;
		ti,bit-shift = <1>;
		reg = <0x0324>;
	};

	auxclk5_src_ck: auxclk5_src_ck {
		#clock-cells = <0>;
		compatible = "ti,composite-clock";
		clocks = <&auxclk5_src_gate_ck>, <&auxclk5_src_mux_ck>;
	};

	auxclk5_ck: auxclk5_ck@324 {
		#clock-cells = <0>;
		compatible = "ti,divider-clock";
		clocks = <&auxclk5_src_ck>;
		ti,bit-shift = <16>;
		ti,max-div = <16>;
		reg = <0x0324>;
	};

	auxclkreq0_ck: auxclkreq0_ck@210 {
		#clock-cells = <0>;
		compatible = "ti,mux-clock";
		clocks = <&auxclk0_ck>, <&auxclk1_ck>, <&auxclk2_ck>, <&auxclk3_ck>, <&auxclk4_ck>, <&auxclk5_ck>;
		ti,bit-shift = <2>;
		reg = <0x0210>;
	};

	auxclkreq1_ck: auxclkreq1_ck@214 {
		#clock-cells = <0>;
		compatible = "ti,mux-clock";
		clocks = <&auxclk0_ck>, <&auxclk1_ck>, <&auxclk2_ck>, <&auxclk3_ck>, <&auxclk4_ck>, <&auxclk5_ck>;
		ti,bit-shift = <2>;
		reg = <0x0214>;
	};

	auxclkreq2_ck: auxclkreq2_ck@218 {
		#clock-cells = <0>;
		compatible = "ti,mux-clock";
		clocks = <&auxclk0_ck>, <&auxclk1_ck>, <&auxclk2_ck>, <&auxclk3_ck>, <&auxclk4_ck>, <&auxclk5_ck>;
		ti,bit-shift = <2>;
		reg = <0x0218>;
	};

	auxclkreq3_ck: auxclkreq3_ck@21c {
		#clock-cells = <0>;
		compatible = "ti,mux-clock";
		clocks = <&auxclk0_ck>, <&auxclk1_ck>, <&auxclk2_ck>, <&auxclk3_ck>, <&auxclk4_ck>, <&auxclk5_ck>;
		ti,bit-shift = <2>;
		reg = <0x021c>;
	};

	auxclkreq4_ck: auxclkreq4_ck@220 {
		#clock-cells = <0>;
		compatible = "ti,mux-clock";
		clocks = <&auxclk0_ck>, <&auxclk1_ck>, <&auxclk2_ck>, <&auxclk3_ck>, <&auxclk4_ck>, <&auxclk5_ck>;
		ti,bit-shift = <2>;
		reg = <0x0220>;
	};

	auxclkreq5_ck: auxclkreq5_ck@224 {
		#clock-cells = <0>;
		compatible = "ti,mux-clock";
		clocks = <&auxclk0_ck>, <&auxclk1_ck>, <&auxclk2_ck>, <&auxclk3_ck>, <&auxclk4_ck>, <&auxclk5_ck>;
		ti,bit-shift = <2>;
		reg = <0x0224>;
	};
};

&cm1_clockdomains {
	mpuss_clkdm: mpuss_clkdm {
		compatible = "ti,clockdomain";
		clocks = <&mpu_mod_ck>;
	};

	tesla_clkdm: tesla_clkdm {
		compatible = "ti,clockdomain";
		clocks = <&mmu_dsp_mod_ck>, <&dsp_mod_ck>;
	};

	abe_clkdm: abe_clkdm {
		compatible = "ti,clockdomain";
		clocks = <&mcpdm_mod_ck>, <&l4_abe_mod_ck>, <&wd_timer3_mod_ck>,
			 <&timer7_mod_ck>, <&timer5_mod_ck>, <&mcbsp3_mod_ck>,
			 <&mcbsp2_mod_ck>, <&timer6_mod_ck>, <&mcbsp1_mod_ck>,
			 <&timer8_mod_ck>, <&mcasp_mod_ck>, <&dmic_mod_ck>,
			 <&aess_mod_ck>, <&slimbus1_mod_ck>;
	};
};
