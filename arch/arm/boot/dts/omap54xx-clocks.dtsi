/*
 * Device Tree Source for OMAP5 clock data
 *
 * Copyright (C) 2013 Texas Instruments, Inc.
 *
 * This program is free software; you can redistribute it and/or modify
 * it under the terms of the GNU General Public License version 2 as
 * published by the Free Software Foundation.
 */
&cm_core_aon_clocks {
	pad_clks_src_ck: pad_clks_src_ck {
		#clock-cells = <0>;
		compatible = "fixed-clock";
		clock-frequency = <12000000>;
	};

	pad_clks_ck: pad_clks_ck@108 {
		#clock-cells = <0>;
		compatible = "ti,gate-clock";
		clocks = <&pad_clks_src_ck>;
		ti,bit-shift = <8>;
		reg = <0x0108>;
	};

	secure_32k_clk_src_ck: secure_32k_clk_src_ck {
		#clock-cells = <0>;
		compatible = "fixed-clock";
		clock-frequency = <32768>;
	};

	slimbus_src_clk: slimbus_src_clk {
		#clock-cells = <0>;
		compatible = "fixed-clock";
		clock-frequency = <12000000>;
	};

	slimbus_clk: slimbus_clk@108 {
		#clock-cells = <0>;
		compatible = "ti,gate-clock";
		clocks = <&slimbus_src_clk>;
		ti,bit-shift = <10>;
		reg = <0x0108>;
	};

	sys_32k_ck: sys_32k_ck {
		#clock-cells = <0>;
		compatible = "fixed-clock";
		clock-frequency = <32768>;
	};

	virt_12000000_ck: virt_12000000_ck {
		#clock-cells = <0>;
		compatible = "fixed-clock";
		clock-frequency = <12000000>;
	};

	virt_13000000_ck: virt_13000000_ck {
		#clock-cells = <0>;
		compatible = "fixed-clock";
		clock-frequency = <13000000>;
	};

	virt_16800000_ck: virt_16800000_ck {
		#clock-cells = <0>;
		compatible = "fixed-clock";
		clock-frequency = <16800000>;
	};

	virt_19200000_ck: virt_19200000_ck {
		#clock-cells = <0>;
		compatible = "fixed-clock";
		clock-frequency = <19200000>;
	};

	virt_26000000_ck: virt_26000000_ck {
		#clock-cells = <0>;
		compatible = "fixed-clock";
		clock-frequency = <26000000>;
	};

	virt_27000000_ck: virt_27000000_ck {
		#clock-cells = <0>;
		compatible = "fixed-clock";
		clock-frequency = <27000000>;
	};

	virt_38400000_ck: virt_38400000_ck {
		#clock-cells = <0>;
		compatible = "fixed-clock";
		clock-frequency = <38400000>;
	};

	xclk60mhsp1_ck: xclk60mhsp1_ck {
		#clock-cells = <0>;
		compatible = "fixed-clock";
		clock-frequency = <60000000>;
	};

	xclk60mhsp2_ck: xclk60mhsp2_ck {
		#clock-cells = <0>;
		compatible = "fixed-clock";
		clock-frequency = <60000000>;
	};

	dpll_abe_ck: dpll_abe_ck@1e0 {
		#clock-cells = <0>;
		compatible = "ti,omap4-dpll-m4xen-clock";
		clocks = <&abe_dpll_clk_mux>, <&abe_dpll_bypass_clk_mux>;
		reg = <0x01e0>, <0x01e4>, <0x01ec>, <0x01e8>;
	};

	dpll_abe_x2_ck: dpll_abe_x2_ck {
		#clock-cells = <0>;
		compatible = "ti,omap4-dpll-x2-clock";
		clocks = <&dpll_abe_ck>;
	};

	dpll_abe_m2x2_ck: dpll_abe_m2x2_ck@1f0 {
		#clock-cells = <0>;
		compatible = "ti,divider-clock";
		clocks = <&dpll_abe_x2_ck>;
		ti,max-div = <31>;
		reg = <0x01f0>;
		ti,index-starts-at-one;
	};

	abe_24m_fclk: abe_24m_fclk {
		#clock-cells = <0>;
		compatible = "fixed-factor-clock";
		clocks = <&dpll_abe_m2x2_ck>;
		clock-mult = <1>;
		clock-div = <8>;
	};

	abe_clk: abe_clk@108 {
		#clock-cells = <0>;
		compatible = "ti,divider-clock";
		clocks = <&dpll_abe_m2x2_ck>;
		ti,max-div = <4>;
		reg = <0x0108>;
		ti,index-power-of-two;
	};

	abe_iclk: abe_iclk@528 {
		#clock-cells = <0>;
		compatible = "ti,divider-clock";
		clocks = <&aess_fclk>;
		ti,bit-shift = <24>;
		reg = <0x0528>;
		ti,dividers = <2>, <1>;
	};

	abe_lp_clk_div: abe_lp_clk_div {
		#clock-cells = <0>;
		compatible = "fixed-factor-clock";
		clocks = <&dpll_abe_m2x2_ck>;
		clock-mult = <1>;
		clock-div = <16>;
	};

	dpll_abe_m3x2_ck: dpll_abe_m3x2_ck@1f4 {
		#clock-cells = <0>;
		compatible = "ti,divider-clock";
		clocks = <&dpll_abe_x2_ck>;
		ti,max-div = <31>;
		reg = <0x01f4>;
		ti,index-starts-at-one;
	};

	mpu_mod_ck: mpu_mod_ck@320 {
		#clock-cells = <0>;
		compatible = "ti,omap4-mod-clock";
		reg = <0x0320>;
		clocks = <&dpll_mpu_m2_ck>;
	};

	mmu_dsp_mod_ck: mmu_dsp_mod_ck@420 {
		#clock-cells = <0>;
		compatible = "ti,omap4-hw-mod-clock";
		reg = <0x0420>;
		clocks = <&dpll_iva_h11x2_ck>;
	};

	l4_abe_mod_ck: l4_abe_mod_ck@520 {
		#clock-cells = <0>;
		compatible = "ti,omap4-mod-clock";
		reg = <0x0520>;
		clocks = <&abe_iclk>;
	};

	dpll_core_byp_mux: dpll_core_byp_mux@12c {
		#clock-cells = <0>;
		compatible = "ti,mux-clock";
		clocks = <&sys_clkin>, <&dpll_abe_m3x2_ck>;
		ti,bit-shift = <23>;
		reg = <0x012c>;
	};

	dpll_core_ck: dpll_core_ck@120 {
		#clock-cells = <0>;
		compatible = "ti,omap4-dpll-core-clock";
		clocks = <&sys_clkin>, <&dpll_core_byp_mux>;
		reg = <0x0120>, <0x0124>, <0x012c>, <0x0128>;
	};

	dpll_core_x2_ck: dpll_core_x2_ck {
		#clock-cells = <0>;
		compatible = "ti,omap4-dpll-x2-clock";
		clocks = <&dpll_core_ck>;
	};

	dpll_core_h21x2_ck: dpll_core_h21x2_ck@150 {
		#clock-cells = <0>;
		compatible = "ti,divider-clock";
		clocks = <&dpll_core_x2_ck>;
		ti,max-div = <63>;
		reg = <0x0150>;
		ti,index-starts-at-one;
	};

	c2c_fclk: c2c_fclk {
		#clock-cells = <0>;
		compatible = "fixed-factor-clock";
		clocks = <&dpll_core_h21x2_ck>;
		clock-mult = <1>;
		clock-div = <1>;
	};

	c2c_iclk: c2c_iclk {
		#clock-cells = <0>;
		compatible = "fixed-factor-clock";
		clocks = <&c2c_fclk>;
		clock-mult = <1>;
		clock-div = <2>;
	};

	dpll_core_h11x2_ck: dpll_core_h11x2_ck@138 {
		#clock-cells = <0>;
		compatible = "ti,divider-clock";
		clocks = <&dpll_core_x2_ck>;
		ti,max-div = <63>;
		reg = <0x0138>;
		ti,index-starts-at-one;
	};

	dpll_core_h12x2_ck: dpll_core_h12x2_ck@13c {
		#clock-cells = <0>;
		compatible = "ti,divider-clock";
		clocks = <&dpll_core_x2_ck>;
		ti,max-div = <63>;
		reg = <0x013c>;
		ti,index-starts-at-one;
	};

	dpll_core_h13x2_ck: dpll_core_h13x2_ck@140 {
		#clock-cells = <0>;
		compatible = "ti,divider-clock";
		clocks = <&dpll_core_x2_ck>;
		ti,max-div = <63>;
		reg = <0x0140>;
		ti,index-starts-at-one;
	};

	dpll_core_h14x2_ck: dpll_core_h14x2_ck@144 {
		#clock-cells = <0>;
		compatible = "ti,divider-clock";
		clocks = <&dpll_core_x2_ck>;
		ti,max-div = <63>;
		reg = <0x0144>;
		ti,index-starts-at-one;
	};

	dpll_core_h22x2_ck: dpll_core_h22x2_ck@154 {
		#clock-cells = <0>;
		compatible = "ti,divider-clock";
		clocks = <&dpll_core_x2_ck>;
		ti,max-div = <63>;
		reg = <0x0154>;
		ti,index-starts-at-one;
	};

	dpll_core_h23x2_ck: dpll_core_h23x2_ck@158 {
		#clock-cells = <0>;
		compatible = "ti,divider-clock";
		clocks = <&dpll_core_x2_ck>;
		ti,max-div = <63>;
		reg = <0x0158>;
		ti,index-starts-at-one;
	};

	dpll_core_h24x2_ck: dpll_core_h24x2_ck@15c {
		#clock-cells = <0>;
		compatible = "ti,divider-clock";
		clocks = <&dpll_core_x2_ck>;
		ti,max-div = <63>;
		reg = <0x015c>;
		ti,index-starts-at-one;
	};

	dpll_core_m2_ck: dpll_core_m2_ck@130 {
		#clock-cells = <0>;
		compatible = "ti,divider-clock";
		clocks = <&dpll_core_ck>;
		ti,max-div = <31>;
		reg = <0x0130>;
		ti,index-starts-at-one;
	};

	dpll_core_m3x2_ck: dpll_core_m3x2_ck@134 {
		#clock-cells = <0>;
		compatible = "ti,divider-clock";
		clocks = <&dpll_core_x2_ck>;
		ti,max-div = <31>;
		reg = <0x0134>;
		ti,index-starts-at-one;
	};

	iva_dpll_hs_clk_div: iva_dpll_hs_clk_div {
		#clock-cells = <0>;
		compatible = "fixed-factor-clock";
		clocks = <&dpll_core_h12x2_ck>;
		clock-mult = <1>;
		clock-div = <1>;
	};

	dpll_iva_byp_mux: dpll_iva_byp_mux@1ac {
		#clock-cells = <0>;
		compatible = "ti,mux-clock";
		clocks = <&sys_clkin>, <&iva_dpll_hs_clk_div>;
		ti,bit-shift = <23>;
		reg = <0x01ac>;
	};

	dpll_iva_ck: dpll_iva_ck@1a0 {
		#clock-cells = <0>;
		compatible = "ti,omap4-dpll-clock";
		clocks = <&sys_clkin>, <&dpll_iva_byp_mux>;
		reg = <0x01a0>, <0x01a4>, <0x01ac>, <0x01a8>;
	};

	dpll_iva_x2_ck: dpll_iva_x2_ck {
		#clock-cells = <0>;
		compatible = "ti,omap4-dpll-x2-clock";
		clocks = <&dpll_iva_ck>;
	};

	dpll_iva_h11x2_ck: dpll_iva_h11x2_ck@1b8 {
		#clock-cells = <0>;
		compatible = "ti,divider-clock";
		clocks = <&dpll_iva_x2_ck>;
		ti,max-div = <63>;
		reg = <0x01b8>;
		ti,index-starts-at-one;
	};

	dpll_iva_h12x2_ck: dpll_iva_h12x2_ck@1bc {
		#clock-cells = <0>;
		compatible = "ti,divider-clock";
		clocks = <&dpll_iva_x2_ck>;
		ti,max-div = <63>;
		reg = <0x01bc>;
		ti,index-starts-at-one;
	};

	mpu_dpll_hs_clk_div: mpu_dpll_hs_clk_div {
		#clock-cells = <0>;
		compatible = "fixed-factor-clock";
		clocks = <&dpll_core_h12x2_ck>;
		clock-mult = <1>;
		clock-div = <1>;
	};

	dpll_mpu_ck: dpll_mpu_ck@160 {
		#clock-cells = <0>;
		compatible = "ti,omap5-mpu-dpll-clock";
		clocks = <&sys_clkin>, <&mpu_dpll_hs_clk_div>;
		reg = <0x0160>, <0x0164>, <0x016c>, <0x0168>;
	};

	dpll_mpu_m2_ck: dpll_mpu_m2_ck@170 {
		#clock-cells = <0>;
		compatible = "ti,divider-clock";
		clocks = <&dpll_mpu_ck>;
		ti,max-div = <31>;
		reg = <0x0170>;
		ti,index-starts-at-one;
	};

	per_dpll_hs_clk_div: per_dpll_hs_clk_div {
		#clock-cells = <0>;
		compatible = "fixed-factor-clock";
		clocks = <&dpll_abe_m3x2_ck>;
		clock-mult = <1>;
		clock-div = <2>;
	};

	usb_dpll_hs_clk_div: usb_dpll_hs_clk_div {
		#clock-cells = <0>;
		compatible = "fixed-factor-clock";
		clocks = <&dpll_abe_m3x2_ck>;
		clock-mult = <1>;
		clock-div = <3>;
	};

	l3_iclk_div: l3_iclk_div@100 {
		#clock-cells = <0>;
		compatible = "ti,divider-clock";
		ti,max-div = <2>;
		ti,bit-shift = <4>;
		reg = <0x100>;
		clocks = <&dpll_core_h12x2_ck>;
		ti,index-power-of-two;
	};

	gpu_l3_iclk: gpu_l3_iclk {
		#clock-cells = <0>;
		compatible = "fixed-factor-clock";
		clocks = <&l3_iclk_div>;
		clock-mult = <1>;
		clock-div = <1>;
	};

	l4_root_clk_div: l4_root_clk_div@100 {
		#clock-cells = <0>;
		compatible = "ti,divider-clock";
		ti,max-div = <2>;
		ti,bit-shift = <8>;
		reg = <0x100>;
		clocks = <&l3_iclk_div>;
		ti,index-power-of-two;
	};

	slimbus1_slimbus_clk: slimbus1_slimbus_clk@560 {
		#clock-cells = <0>;
		compatible = "ti,gate-clock";
		clocks = <&slimbus_clk>;
		ti,bit-shift = <11>;
		reg = <0x0560>;
	};

	timer5_mod_ck: timer5_mod_ck@568 {
		#clock-cells = <0>;
		compatible = "ti,omap4-sw-mux-mod-clock";
		reg = <0x0568>, <0x0568>;
		clocks = <&dss_syc_gfclk_div>, <&sys_32k_ck>;
		ti,bit-shift = <24>;
	};

	timer6_mod_ck: timer6_mod_ck@570 {
		#clock-cells = <0>;
		compatible = "ti,omap4-sw-mux-mod-clock";
		reg = <0x0570>, <0x0570>;
		clocks = <&dss_syc_gfclk_div>, <&sys_32k_ck>;
		ti,bit-shift = <24>;
	};

	timer7_mod_ck: timer7_mod_ck@578 {
		#clock-cells = <0>;
		compatible = "ti,omap4-sw-mux-mod-clock";
		reg = <0x0578>, <0x0578>;
		clocks = <&dss_syc_gfclk_div>, <&sys_32k_ck>;
		ti,bit-shift = <24>;
	};

	timer8_mod_ck: timer8_mod_ck@580 {
		#clock-cells = <0>;
		compatible = "ti,omap4-sw-mux-mod-clock";
		reg = <0x0580>, <0x0580>;
		clocks = <&dss_syc_gfclk_div>, <&sys_32k_ck>;
		ti,bit-shift = <24>;
	};

	aess_fclk: aess_fclk@528 {
		#clock-cells = <0>;
		compatible = "ti,divider-clock";
		clocks = <&abe_clk>;
		ti,bit-shift = <24>;
		ti,max-div = <2>;
		reg = <0x0528>;
	};

	mcpdm_mod_ck: mcpdm_mod_ck@530 {
		#clock-cells = <0>;
		compatible = "ti,omap4-sw-mod-clock";
		reg = <0x0530>;
		clocks = <&pad_clks_ck>;
	};

	dmic_sync_mux_ck: dmic_sync_mux_ck@538 {
		#clock-cells = <0>;
		compatible = "ti,mux-clock";
		clocks = <&abe_24m_fclk>, <&dss_syc_gfclk_div>, <&func_24m_clk>;
		ti,bit-shift = <26>;
		reg = <0x0538>;
	};

	dmic_gfclk: dmic_gfclk@538 {
		#clock-cells = <0>;
		compatible = "ti,mux-clock";
		clocks = <&dmic_sync_mux_ck>, <&pad_clks_ck>, <&slimbus_clk>;
		ti,bit-shift = <24>;
		reg = <0x0538>;
	};

	dmic_mod_ck: dmic_mod_ck@538 {
		#clock-cells = <0>;
		compatible = "ti,omap4-sw-mod-clock";
		reg = <0x0538>;
		clocks = <&dmic_gfclk>;
	};

	mcasp_sync_mux_ck: mcasp_sync_mux_ck@540 {
		#clock-cells = <0>;
		compatible = "ti,mux-clock";
		clocks = <&abe_24m_fclk>, <&dss_syc_gfclk_div>, <&func_24m_clk>;
		ti,bit-shift = <26>;
		reg = <0x0540>;
	};

	mcasp_gfclk: mcasp_gfclk@540 {
		#clock-cells = <0>;
		compatible = "ti,mux-clock";
		clocks = <&mcasp_sync_mux_ck>, <&pad_clks_ck>, <&slimbus_clk>;
		ti,bit-shift = <24>;
		reg = <0x0540>;
	};

	mcbsp1_sync_mux_ck: mcbsp1_sync_mux_ck@548 {
		#clock-cells = <0>;
		compatible = "ti,mux-clock";
		clocks = <&abe_24m_fclk>, <&dss_syc_gfclk_div>, <&func_24m_clk>;
		ti,bit-shift = <26>;
		reg = <0x0548>;
	};

	mcbsp1_mod_ck: mcbsp1_mod_ck@548 {
		#clock-cells = <0>;
		compatible = "ti,omap4-sw-mod-clock";
		reg = <0x0548>;
		clocks = <&mcbsp1_gfclk>;
	};

	mcbsp1_gfclk: mcbsp1_gfclk@548 {
		#clock-cells = <0>;
		compatible = "ti,mux-clock";
		clocks = <&mcbsp1_sync_mux_ck>, <&pad_clks_ck>, <&slimbus_clk>;
		ti,bit-shift = <24>;
		reg = <0x0548>;
	};

	mcbsp2_sync_mux_ck: mcbsp2_sync_mux_ck@550 {
		#clock-cells = <0>;
		compatible = "ti,mux-clock";
		clocks = <&abe_24m_fclk>, <&dss_syc_gfclk_div>, <&func_24m_clk>;
		ti,bit-shift = <26>;
		reg = <0x0550>;
	};

	mcbsp2_mod_ck: mcbsp2_mod_ck@550 {
		#clock-cells = <0>;
		compatible = "ti,omap4-sw-mod-clock";
		reg = <0x0550>;
		clocks = <&mcbsp2_gfclk>;
	};

	mcbsp2_gfclk: mcbsp2_gfclk@550 {
		#clock-cells = <0>;
		compatible = "ti,mux-clock";
		clocks = <&mcbsp2_sync_mux_ck>, <&pad_clks_ck>, <&slimbus_clk>;
		ti,bit-shift = <24>;
		reg = <0x0550>;
	};

	mcbsp3_sync_mux_ck: mcbsp3_sync_mux_ck@558 {
		#clock-cells = <0>;
		compatible = "ti,mux-clock";
		clocks = <&abe_24m_fclk>, <&dss_syc_gfclk_div>, <&func_24m_clk>;
		ti,bit-shift = <26>;
		reg = <0x0558>;
	};

	mcbsp3_gfclk: mcbsp3_gfclk@558 {
		#clock-cells = <0>;
		compatible = "ti,mux-clock";
		clocks = <&mcbsp3_sync_mux_ck>, <&pad_clks_ck>, <&slimbus_clk>;
		ti,bit-shift = <24>;
		reg = <0x0558>;
	};

	mcbsp3_mod_ck: mcbsp3_mod_ck@558 {
		#clock-cells = <0>;
		compatible = "ti,omap4-sw-mod-clock";
		reg = <0x0558>;
		clocks = <&mcbsp3_gfclk>;
	};

	dummy_ck: dummy_ck {
		#clock-cells = <0>;
		compatible = "fixed-clock";
		clock-frequency = <0>;
	};
};
&prm_clocks {
	sys_clkin: sys_clkin@110 {
		#clock-cells = <0>;
		compatible = "ti,mux-clock";
		clocks = <&virt_12000000_ck>, <&virt_13000000_ck>, <&virt_16800000_ck>, <&virt_19200000_ck>, <&virt_26000000_ck>, <&virt_27000000_ck>, <&virt_38400000_ck>;
		reg = <0x0110>;
		ti,index-starts-at-one;
	};

	l4_wkup_mod_ck: l4_wkup_mod_ck@1920 {
		#clock-cells = <0>;
		compatible = "ti,omap4-mod-clock";
		reg = <0x1920>;
		clocks = <&wkupaon_iclk_mux>;
	};

	wd_timer2_mod_ck: wd_timer2_mod_ck@1930 {
		#clock-cells = <0>;
		compatible = "ti,omap4-sw-mod-clock";
		reg = <0x1930>;
		clocks = <&sys_32k_ck>;
	};

	abe_dpll_bypass_clk_mux: abe_dpll_bypass_clk_mux@108 {
		#clock-cells = <0>;
		compatible = "ti,mux-clock";
		clocks = <&sys_clkin>, <&sys_32k_ck>;
		reg = <0x0108>;
	};

	abe_dpll_clk_mux: abe_dpll_clk_mux@10c {
		#clock-cells = <0>;
		compatible = "ti,mux-clock";
		clocks = <&sys_clkin>, <&sys_32k_ck>;
		reg = <0x010c>;
	};

	custefuse_sys_gfclk_div: custefuse_sys_gfclk_div {
		#clock-cells = <0>;
		compatible = "fixed-factor-clock";
		clocks = <&sys_clkin>;
		clock-mult = <1>;
		clock-div = <2>;
	};

	dss_syc_gfclk_div: dss_syc_gfclk_div {
		#clock-cells = <0>;
		compatible = "fixed-factor-clock";
		clocks = <&sys_clkin>;
		clock-mult = <1>;
		clock-div = <1>;
	};

	wkupaon_iclk_mux: wkupaon_iclk_mux@108 {
		#clock-cells = <0>;
		compatible = "ti,mux-clock";
		clocks = <&sys_clkin>, <&abe_lp_clk_div>;
		reg = <0x0108>;
	};

	l3instr_ts_gclk_div: l3instr_ts_gclk_div {
		#clock-cells = <0>;
		compatible = "fixed-factor-clock";
		clocks = <&wkupaon_iclk_mux>;
		clock-mult = <1>;
		clock-div = <1>;
	};

	gpio1_dbclk: gpio1_dbclk@1938 {
		#clock-cells = <0>;
		compatible = "ti,gate-clock";
		clocks = <&sys_32k_ck>;
		ti,bit-shift = <8>;
		reg = <0x1938>;
	};

	gpio1_mod_ck: gpio1_mod_ck@1938 {
		#clock-cells = <0>;
		compatible = "ti,omap4-hw-mod-clock";
		reg = <0x1938>;
		clocks = <&wkupaon_iclk_mux>;
	};

	timer1_mod_ck: timer1_mod_ck@1940 {
		#clock-cells = <0>;
		compatible = "ti,omap4-sw-mux-mod-clock";
		reg = <0x1940>, <0x1940>;
		clocks = <&sys_clkin>, <&sys_32k_ck>;
		ti,bit-shift = <24>;
	};

	counter_32k_mod_ck: counter_32k_mod_ck@1950 {
		#clock-cells = <0>;
		compatible = "ti,omap4-mod-clock";
		reg = <0x1950>;
		clocks = <&wkupaon_iclk_mux>;
	};

	kbd_mod_ck: kbd_mod_ck@1978 {
		#clock-cells = <0>;
		compatible = "ti,omap4-sw-mod-clock";
		reg = <0x1978>;
		clocks = <&sys_32k_ck>;
	};

};
&cm_core_clocks {

	dpll_per_byp_mux: dpll_per_byp_mux@14c {
		#clock-cells = <0>;
		compatible = "ti,mux-clock";
		clocks = <&sys_clkin>, <&per_dpll_hs_clk_div>;
		ti,bit-shift = <23>;
		reg = <0x014c>;
	};

	dpll_per_ck: dpll_per_ck@140 {
		#clock-cells = <0>;
		compatible = "ti,omap4-dpll-clock";
		clocks = <&sys_clkin>, <&dpll_per_byp_mux>;
		reg = <0x0140>, <0x0144>, <0x014c>, <0x0148>;
	};

	dpll_per_x2_ck: dpll_per_x2_ck {
		#clock-cells = <0>;
		compatible = "ti,omap4-dpll-x2-clock";
		clocks = <&dpll_per_ck>;
	};

	dpll_per_h11x2_ck: dpll_per_h11x2_ck@158 {
		#clock-cells = <0>;
		compatible = "ti,divider-clock";
		clocks = <&dpll_per_x2_ck>;
		ti,max-div = <63>;
		reg = <0x0158>;
		ti,index-starts-at-one;
	};

	dpll_per_h12x2_ck: dpll_per_h12x2_ck@15c {
		#clock-cells = <0>;
		compatible = "ti,divider-clock";
		clocks = <&dpll_per_x2_ck>;
		ti,max-div = <63>;
		reg = <0x015c>;
		ti,index-starts-at-one;
	};

	dpll_per_h14x2_ck: dpll_per_h14x2_ck@164 {
		#clock-cells = <0>;
		compatible = "ti,divider-clock";
		clocks = <&dpll_per_x2_ck>;
		ti,max-div = <63>;
		reg = <0x0164>;
		ti,index-starts-at-one;
	};

	dpll_per_m2_ck: dpll_per_m2_ck@150 {
		#clock-cells = <0>;
		compatible = "ti,divider-clock";
		clocks = <&dpll_per_ck>;
		ti,max-div = <31>;
		reg = <0x0150>;
		ti,index-starts-at-one;
	};

	dpll_per_m2x2_ck: dpll_per_m2x2_ck@150 {
		#clock-cells = <0>;
		compatible = "ti,divider-clock";
		clocks = <&dpll_per_x2_ck>;
		ti,max-div = <31>;
		reg = <0x0150>;
		ti,index-starts-at-one;
	};

	dpll_per_m3x2_ck: dpll_per_m3x2_ck@154 {
		#clock-cells = <0>;
		compatible = "ti,divider-clock";
		clocks = <&dpll_per_x2_ck>;
		ti,max-div = <31>;
		reg = <0x0154>;
		ti,index-starts-at-one;
	};

	dpll_unipro1_ck: dpll_unipro1_ck@200 {
		#clock-cells = <0>;
		compatible = "ti,omap4-dpll-clock";
		clocks = <&sys_clkin>, <&sys_clkin>;
		reg = <0x0200>, <0x0204>, <0x020c>, <0x0208>;
	};

	dpll_unipro1_clkdcoldo: dpll_unipro1_clkdcoldo {
		#clock-cells = <0>;
		compatible = "fixed-factor-clock";
		clocks = <&dpll_unipro1_ck>;
		clock-mult = <1>;
		clock-div = <1>;
	};

	dpll_unipro1_m2_ck: dpll_unipro1_m2_ck@210 {
		#clock-cells = <0>;
		compatible = "ti,divider-clock";
		clocks = <&dpll_unipro1_ck>;
		ti,max-div = <127>;
		reg = <0x0210>;
		ti,index-starts-at-one;
	};

	dpll_unipro2_ck: dpll_unipro2_ck@1c0 {
		#clock-cells = <0>;
		compatible = "ti,omap4-dpll-clock";
		clocks = <&sys_clkin>, <&sys_clkin>;
		reg = <0x01c0>, <0x01c4>, <0x01cc>, <0x01c8>;
	};

	dpll_unipro2_clkdcoldo: dpll_unipro2_clkdcoldo {
		#clock-cells = <0>;
		compatible = "fixed-factor-clock";
		clocks = <&dpll_unipro2_ck>;
		clock-mult = <1>;
		clock-div = <1>;
	};

	dpll_unipro2_m2_ck: dpll_unipro2_m2_ck@1d0 {
		#clock-cells = <0>;
		compatible = "ti,divider-clock";
		clocks = <&dpll_unipro2_ck>;
		ti,max-div = <127>;
		reg = <0x01d0>;
		ti,index-starts-at-one;
	};

	dpll_usb_byp_mux: dpll_usb_byp_mux@18c {
		#clock-cells = <0>;
		compatible = "ti,mux-clock";
		clocks = <&sys_clkin>, <&usb_dpll_hs_clk_div>;
		ti,bit-shift = <23>;
		reg = <0x018c>;
	};

	dpll_usb_ck: dpll_usb_ck@180 {
		#clock-cells = <0>;
		compatible = "ti,omap4-dpll-j-type-clock";
		clocks = <&sys_clkin>, <&dpll_usb_byp_mux>;
		reg = <0x0180>, <0x0184>, <0x018c>, <0x0188>;
	};

	dpll_usb_clkdcoldo: dpll_usb_clkdcoldo {
		#clock-cells = <0>;
		compatible = "fixed-factor-clock";
		clocks = <&dpll_usb_ck>;
		clock-mult = <1>;
		clock-div = <1>;
	};

	dpll_usb_m2_ck: dpll_usb_m2_ck@190 {
		#clock-cells = <0>;
		compatible = "ti,divider-clock";
		clocks = <&dpll_usb_ck>;
		ti,max-div = <127>;
		reg = <0x0190>;
		ti,index-starts-at-one;
	};

	func_128m_clk: func_128m_clk {
		#clock-cells = <0>;
		compatible = "fixed-factor-clock";
		clocks = <&dpll_per_h11x2_ck>;
		clock-mult = <1>;
		clock-div = <2>;
	};

	func_12m_fclk: func_12m_fclk {
		#clock-cells = <0>;
		compatible = "fixed-factor-clock";
		clocks = <&dpll_per_m2x2_ck>;
		clock-mult = <1>;
		clock-div = <16>;
	};

	func_24m_clk: func_24m_clk {
		#clock-cells = <0>;
		compatible = "fixed-factor-clock";
		clocks = <&dpll_per_m2_ck>;
		clock-mult = <1>;
		clock-div = <4>;
	};

	func_48m_fclk: func_48m_fclk {
		#clock-cells = <0>;
		compatible = "fixed-factor-clock";
		clocks = <&dpll_per_m2x2_ck>;
		clock-mult = <1>;
		clock-div = <4>;
	};

	func_96m_fclk: func_96m_fclk {
		#clock-cells = <0>;
		compatible = "fixed-factor-clock";
		clocks = <&dpll_per_m2x2_ck>;
		clock-mult = <1>;
		clock-div = <2>;
	};

	l3init_60m_fclk: l3init_60m_fclk@104 {
		#clock-cells = <0>;
		compatible = "ti,divider-clock";
		clocks = <&dpll_usb_m2_ck>;
		reg = <0x0104>;
		ti,dividers = <1>, <8>;
	};

	dss_32khz_clk: dss_32khz_clk@1420 {
		#clock-cells = <0>;
		compatible = "ti,gate-clock";
		clocks = <&sys_32k_ck>;
		ti,bit-shift = <11>;
		reg = <0x1420>;
	};

	dss_48mhz_clk: dss_48mhz_clk@1420 {
		#clock-cells = <0>;
		compatible = "ti,gate-clock";
		clocks = <&func_48m_fclk>;
		ti,bit-shift = <9>;
		reg = <0x1420>;
	};

	dss_dss_clk: dss_dss_clk@1420 {
		#clock-cells = <0>;
		compatible = "ti,gate-clock";
		clocks = <&dpll_per_h12x2_ck>;
		ti,bit-shift = <8>;
		reg = <0x1420>;
		ti,set-rate-parent;
	};

	dss_sys_clk: dss_sys_clk@1420 {
		#clock-cells = <0>;
		compatible = "ti,gate-clock";
		clocks = <&dss_syc_gfclk_div>;
		ti,bit-shift = <10>;
		reg = <0x1420>;
	};

	dss_dispc_mod_ck: dss_dispc_mod_ck@1420 {
		#clock-cells = <0>;
		compatible = "ti,omap4-mod-clock";
		reg = <0x1420>;
		clocks = <&dss_dss_clk>;
	};

	dss_dsi1_mod_ck: dss_dsi1_mod_ck@1420 {
		#clock-cells = <0>;
		compatible = "ti,omap4-mod-clock";
		reg = <0x1420>;
		clocks = <&dss_dss_clk>;
	};

	dss_dsi2_mod_ck: dss_dsi2_mod_ck@1420 {
		#clock-cells = <0>;
		compatible = "ti,omap4-mod-clock";
		reg = <0x1420>;
		clocks = <&dss_dss_clk>;
	};

	dss_core_mod_ck: dss_core_mod_ck@1420 {
		#clock-cells = <0>;
		compatible = "ti,omap4-sw-mod-clock";
		reg = <0x1420>;
		clocks = <&dss_dss_clk>;
	};

	dss_rfbi_mod_ck: dss_rfbi_mod_ck@1420 {
		#clock-cells = <0>;
		compatible = "ti,omap4-mod-clock";
		reg = <0x1420>;
		clocks = <&l3_iclk_div>;
	};

	dss_hdmi_mod_ck: dss_hdmi_mod_ck@1420 {
		#clock-cells = <0>;
		compatible = "ti,omap4-mod-clock";
		reg = <0x1420>;
		clocks = <&dss_48mhz_clk>;
	};

	gpio2_dbclk: gpio2_dbclk@1060 {
		#clock-cells = <0>;
		compatible = "ti,gate-clock";
		clocks = <&sys_32k_ck>;
		ti,bit-shift = <8>;
		reg = <0x1060>;
	};

	gpio2_mod_ck: gpio2_mod_ck@1060 {
		#clock-cells = <0>;
		compatible = "ti,omap4-hw-mod-clock";
		reg = <0x1060>;
		clocks = <&l4_root_clk_div>;
	};

	gpio3_dbclk: gpio3_dbclk@1068 {
		#clock-cells = <0>;
		compatible = "ti,gate-clock";
		clocks = <&sys_32k_ck>;
		ti,bit-shift = <8>;
		reg = <0x1068>;
	};

	gpio3_mod_ck: gpio3_mod_ck@1068 {
		#clock-cells = <0>;
		compatible = "ti,omap4-hw-mod-clock";
		reg = <0x1068>;
		clocks = <&l4_root_clk_div>;
	};

	gpio4_dbclk: gpio4_dbclk@1070 {
		#clock-cells = <0>;
		compatible = "ti,gate-clock";
		clocks = <&sys_32k_ck>;
		ti,bit-shift = <8>;
		reg = <0x1070>;
	};

	gpio4_mod_ck: gpio4_mod_ck@1070 {
		#clock-cells = <0>;
		compatible = "ti,omap4-hw-mod-clock";
		reg = <0x1070>;
		clocks = <&l4_root_clk_div>;
	};

	gpio5_dbclk: gpio5_dbclk@1078 {
		#clock-cells = <0>;
		compatible = "ti,gate-clock";
		clocks = <&sys_32k_ck>;
		ti,bit-shift = <8>;
		reg = <0x1078>;
	};

	gpio5_mod_ck: gpio5_mod_ck@1078 {
		#clock-cells = <0>;
		compatible = "ti,omap4-hw-mod-clock";
		reg = <0x1078>;
		clocks = <&l4_root_clk_div>;
	};

	gpio6_dbclk: gpio6_dbclk@1080 {
		#clock-cells = <0>;
		compatible = "ti,gate-clock";
		clocks = <&sys_32k_ck>;
		ti,bit-shift = <8>;
		reg = <0x1080>;
	};

	gpio6_mod_ck: gpio6_mod_ck@1080 {
		#clock-cells = <0>;
		compatible = "ti,omap4-hw-mod-clock";
		reg = <0x1080>;
		clocks = <&l4_root_clk_div>;
	};

	i2c1_mod_ck: i2c1_mod_ck@10a0 {
		#clock-cells = <0>;
		compatible = "ti,omap4-sw-mod-clock";
		reg = <0x10a0>;
		clocks = <&func_96m_fclk>;
	};

	i2c2_mod_ck: i2c2_mod_ck@10a8 {
		#clock-cells = <0>;
		compatible = "ti,omap4-sw-mod-clock";
		reg = <0x10a8>;
		clocks = <&func_96m_fclk>;
	};

	i2c3_mod_ck: i2c3_mod_ck@10b0 {
		#clock-cells = <0>;
		compatible = "ti,omap4-sw-mod-clock";
		reg = <0x10b0>;
		clocks = <&func_96m_fclk>;
	};

	i2c4_mod_ck: i2c4_mod_ck@10b8 {
		#clock-cells = <0>;
		compatible = "ti,omap4-sw-mod-clock";
		reg = <0x10b8>;
		clocks = <&func_96m_fclk>;
	};

	l4_per_mod_ck: l4_per_mod_ck@10c0 {
		#clock-cells = <0>;
		compatible = "ti,omap4-mod-clock";
		reg = <0x10c0>;
		clocks = <&l4_root_clk_div>;
	};

	mcspi1_mod_ck: mcspi1_mod_ck@10f0 {
		#clock-cells = <0>;
		compatible = "ti,omap4-sw-mod-clock";
		reg = <0x10f0>;
		clocks = <&func_48m_fclk>;
	};

	mcspi2_mod_ck: mcspi2_mod_ck@10f8 {
		#clock-cells = <0>;
		compatible = "ti,omap4-sw-mod-clock";
		reg = <0x10f8>;
		clocks = <&func_48m_fclk>;
	};

	mcspi3_mod_ck: mcspi3_mod_ck@1100 {
		#clock-cells = <0>;
		compatible = "ti,omap4-sw-mod-clock";
		reg = <0x1100>;
		clocks = <&func_48m_fclk>;
	};

	mcspi4_mod_ck: mcspi4_mod_ck@1108 {
		#clock-cells = <0>;
		compatible = "ti,omap4-sw-mod-clock";
		reg = <0x1108>;
		clocks = <&func_48m_fclk>;
	};

	gpio7_dbclk: gpio7_dbclk@1110 {
		#clock-cells = <0>;
		compatible = "ti,gate-clock";
		clocks = <&sys_32k_ck>;
		ti,bit-shift = <8>;
		reg = <0x1110>;
	};

	gpio7_mod_ck: gpio7_mod_ck@1110 {
		#clock-cells = <0>;
		compatible = "ti,omap4-hw-mod-clock";
		reg = <0x1110>;
		clocks = <&l4_root_clk_div>;
	};

	gpio8_dbclk: gpio8_dbclk@1118 {
		#clock-cells = <0>;
		compatible = "ti,gate-clock";
		clocks = <&sys_32k_ck>;
		ti,bit-shift = <8>;
		reg = <0x1118>;
	};

	gpio8_mod_ck: gpio8_mod_ck@1118 {
		#clock-cells = <0>;
		compatible = "ti,omap4-hw-mod-clock";
		reg = <0x1118>;
		clocks = <&l4_root_clk_div>;
	};

	mmc3_mod_ck: mmc3_mod_ck@1120 {
		#clock-cells = <0>;
		compatible = "ti,omap4-sw-mod-clock";
		reg = <0x1120>;
		clocks = <&func_48m_fclk>;
	};

	mmc4_mod_ck: mmc4_mod_ck@1128 {
		#clock-cells = <0>;
		compatible = "ti,omap4-sw-mod-clock";
		reg = <0x1128>;
		clocks = <&func_48m_fclk>;
	};

	uart1_mod_ck: uart1_mod_ck@1140 {
		#clock-cells = <0>;
		compatible = "ti,omap4-sw-mod-clock";
		reg = <0x1140>;
		clocks = <&func_48m_fclk>;
	};

	uart2_mod_ck: uart2_mod_ck@1148 {
		#clock-cells = <0>;
		compatible = "ti,omap4-sw-mod-clock";
		reg = <0x1148>;
		clocks = <&func_48m_fclk>;
	};

	uart3_mod_ck: uart3_mod_ck@1150 {
		#clock-cells = <0>;
		compatible = "ti,omap4-sw-mod-clock";
		reg = <0x1150>;
		clocks = <&func_48m_fclk>;
	};

	uart4_mod_ck: uart4_mod_ck@1158 {
		#clock-cells = <0>;
		compatible = "ti,omap4-sw-mod-clock";
		reg = <0x1158>;
		clocks = <&func_48m_fclk>;
	};

	mmc5_mod_ck: mmc5_mod_ck@1160 {
		#clock-cells = <0>;
		compatible = "ti,omap4-sw-mod-clock";
		reg = <0x1160>;
		clocks = <&func_96m_fclk>;
	};

	i2c5_mod_ck: i2c5_mod_ck@1168 {
		#clock-cells = <0>;
		compatible = "ti,omap4-sw-mod-clock";
		reg = <0x1168>;
		clocks = <&func_96m_fclk>;
	};

	uart5_mod_ck: uart5_mod_ck@1170 {
		#clock-cells = <0>;
		compatible = "ti,omap4-sw-mod-clock";
		reg = <0x1170>;
		clocks = <&func_48m_fclk>;
	};

	uart6_mod_ck: uart6_mod_ck@1178 {
		#clock-cells = <0>;
		compatible = "ti,omap4-sw-mod-clock";
		reg = <0x1178>;
		clocks = <&func_48m_fclk>;
	};

	iss_ctrlclk: iss_ctrlclk@1320 {
		#clock-cells = <0>;
		compatible = "ti,gate-clock";
		clocks = <&func_96m_fclk>;
		ti,bit-shift = <8>;
		reg = <0x1320>;
	};

	lli_txphy_clk: lli_txphy_clk@f20 {
		#clock-cells = <0>;
		compatible = "ti,gate-clock";
		clocks = <&dpll_unipro1_clkdcoldo>;
		ti,bit-shift = <8>;
		reg = <0x0f20>;
	};

	lli_txphy_ls_clk: lli_txphy_ls_clk@f20 {
		#clock-cells = <0>;
		compatible = "ti,gate-clock";
		clocks = <&dpll_unipro1_m2_ck>;
		ti,bit-shift = <9>;
		reg = <0x0f20>;
	};

	timer10_mod_ck: timer10_mod_ck@1028 {
		#clock-cells = <0>;
		compatible = "ti,omap4-sw-mux-mod-clock";
		reg = <0x1028>, <0x1028>;
		clocks = <&sys_clkin>, <&sys_32k_ck>;
		ti,bit-shift = <24>;
	};

	timer11_mod_ck: timer11_mod_ck@1030 {
		#clock-cells = <0>;
		compatible = "ti,omap4-sw-mux-mod-clock";
		reg = <0x1030>, <0x1030>;
		clocks = <&sys_clkin>, <&sys_32k_ck>;
		ti,bit-shift = <24>;
	};

	timer2_mod_ck: timer2_mod_ck@1038 {
		#clock-cells = <0>;
		compatible = "ti,omap4-sw-mux-mod-clock";
		reg = <0x1038>, <0x1038>;
		clocks = <&sys_clkin>, <&sys_32k_ck>;
		ti,bit-shift = <24>;
	};

	timer3_mod_ck: timer3_mod_ck@1040 {
		#clock-cells = <0>;
		compatible = "ti,omap4-sw-mux-mod-clock";
		reg = <0x1040>, <0x1040>;
		clocks = <&sys_clkin>, <&sys_32k_ck>;
		ti,bit-shift = <24>;
	};

	timer4_mod_ck: timer4_mod_ck@1048 {
		#clock-cells = <0>;
		compatible = "ti,omap4-sw-mux-mod-clock";
		reg = <0x1048>, <0x1048>;
		clocks = <&sys_clkin>, <&sys_32k_ck>;
		ti,bit-shift = <24>;
	};

	timer9_mod_ck: timer9_mod_ck@1050 {
		#clock-cells = <0>;
		compatible = "ti,omap4-sw-mux-mod-clock";
		reg = <0x1050>, <0x1050>;
		clocks = <&sys_clkin>, <&sys_32k_ck>;
		ti,bit-shift = <24>;
	};

	mmc1_32khz_clk: mmc1_32khz_clk@1628 {
		#clock-cells = <0>;
		compatible = "ti,gate-clock";
		clocks = <&sys_32k_ck>;
		ti,bit-shift = <8>;
		reg = <0x1628>;
	};

	sata_ref_clk: sata_ref_clk@1688 {
		#clock-cells = <0>;
		compatible = "ti,gate-clock";
		clocks = <&sys_clkin>;
		ti,bit-shift = <8>;
		reg = <0x1688>;
	};

	sata_mod_ck: sata_mod_ck@1688 {
		#clock-cells = <0>;
		compatible = "ti,omap4-sw-mod-clock";
		reg = <0x1688>;
		clocks = <&func_48m_fclk>;
	};

	ocp2scp1_mod_ck: ocp2scp1_mod_ck@16e0 {
		#clock-cells = <0>;
		compatible = "ti,omap4-hw-mod-clock";
		reg = <0x16e0>;
		clocks = <&l4_root_clk_div>;
	};

	ocp2scp3_mod_ck: ocp2scp3_mod_ck@16e8 {
		#clock-cells = <0>;
		compatible = "ti,omap4-hw-mod-clock";
		reg = <0x16e8>;
		clocks = <&l4_root_clk_div>;
	};

	usb_host_hs_hsic480m_p1_clk: usb_host_hs_hsic480m_p1_clk@1658 {
		#clock-cells = <0>;
		compatible = "ti,gate-clock";
		clocks = <&dpll_usb_m2_ck>;
		ti,bit-shift = <13>;
		reg = <0x1658>;
	};

	usb_host_hs_hsic480m_p2_clk: usb_host_hs_hsic480m_p2_clk@1658 {
		#clock-cells = <0>;
		compatible = "ti,gate-clock";
		clocks = <&dpll_usb_m2_ck>;
		ti,bit-shift = <14>;
		reg = <0x1658>;
	};

	usb_host_hs_hsic480m_p3_clk: usb_host_hs_hsic480m_p3_clk@1658 {
		#clock-cells = <0>;
		compatible = "ti,gate-clock";
		clocks = <&dpll_usb_m2_ck>;
		ti,bit-shift = <7>;
		reg = <0x1658>;
	};

	usb_host_hs_hsic60m_p1_clk: usb_host_hs_hsic60m_p1_clk@1658 {
		#clock-cells = <0>;
		compatible = "ti,gate-clock";
		clocks = <&l3init_60m_fclk>;
		ti,bit-shift = <11>;
		reg = <0x1658>;
	};

	usb_host_hs_hsic60m_p2_clk: usb_host_hs_hsic60m_p2_clk@1658 {
		#clock-cells = <0>;
		compatible = "ti,gate-clock";
		clocks = <&l3init_60m_fclk>;
		ti,bit-shift = <12>;
		reg = <0x1658>;
	};

	usb_host_hs_hsic60m_p3_clk: usb_host_hs_hsic60m_p3_clk@1658 {
		#clock-cells = <0>;
		compatible = "ti,gate-clock";
		clocks = <&l3init_60m_fclk>;
		ti,bit-shift = <6>;
		reg = <0x1658>;
	};

	utmi_p1_gfclk: utmi_p1_gfclk@1658 {
		#clock-cells = <0>;
		compatible = "ti,mux-clock";
		clocks = <&l3init_60m_fclk>, <&xclk60mhsp1_ck>;
		ti,bit-shift = <24>;
		reg = <0x1658>;
	};

	usb_host_hs_utmi_p1_clk: usb_host_hs_utmi_p1_clk@1658 {
		#clock-cells = <0>;
		compatible = "ti,gate-clock";
		clocks = <&utmi_p1_gfclk>;
		ti,bit-shift = <8>;
		reg = <0x1658>;
	};

	usb_host_hs_mod_ck: usb_host_hs_mod_ck@1658 {
		#clock-cells = <0>;
		compatible = "ti,omap4-sw-mod-clock";
		reg = <0x1658>;
		clocks = <&l3init_60m_fclk>;
	};

	utmi_p2_gfclk: utmi_p2_gfclk@1658 {
		#clock-cells = <0>;
		compatible = "ti,mux-clock";
		clocks = <&l3init_60m_fclk>, <&xclk60mhsp2_ck>;
		ti,bit-shift = <25>;
		reg = <0x1658>;
	};

	usb_host_hs_utmi_p2_clk: usb_host_hs_utmi_p2_clk@1658 {
		#clock-cells = <0>;
		compatible = "ti,gate-clock";
		clocks = <&utmi_p2_gfclk>;
		ti,bit-shift = <9>;
		reg = <0x1658>;
	};

	usb_host_hs_utmi_p3_clk: usb_host_hs_utmi_p3_clk@1658 {
		#clock-cells = <0>;
		compatible = "ti,gate-clock";
		clocks = <&l3init_60m_fclk>;
		ti,bit-shift = <10>;
		reg = <0x1658>;
	};

	usb_otg_ss_refclk960m: usb_otg_ss_refclk960m@16f0 {
		#clock-cells = <0>;
		compatible = "ti,gate-clock";
		clocks = <&dpll_usb_clkdcoldo>;
		ti,bit-shift = <8>;
		reg = <0x16f0>;
	};

	usb_otg_ss_mod_ck: usb_otg_ss_mod_ck@16f0 {
		#clock-cells = <0>;
		compatible = "ti,omap4-hw-mod-clock";
		reg = <0x16f0>;
		clocks = <&dpll_core_h13x2_ck>;
	};

	usb_phy_cm_clk32k: usb_phy_cm_clk32k@640 {
		#clock-cells = <0>;
		compatible = "ti,gate-clock";
		clocks = <&sys_32k_ck>;
		ti,bit-shift = <8>;
		reg = <0x0640>;
	};

	l3_main_1_mod_ck: l3_main_1_mod_ck@720 {
		#clock-cells = <0>;
		compatible = "ti,omap4-mod-clock";
		reg = <0x0720>;
		clocks = <&l3_iclk_div>;
	};

	l3_main_2_mod_ck: l3_main_2_mod_ck@820 {
		#clock-cells = <0>;
		compatible = "ti,omap4-mod-clock";
		reg = <0x0820>;
		clocks = <&l3_iclk_div>;
	};

	mmu_ipu_mod_ck: mmu_ipu_mod_ck@920 {
		#clock-cells = <0>;
		compatible = "ti,omap4-hw-mod-clock";
		reg = <0x0920>;
		clocks = <&dpll_core_h22x2_ck>;
	};

	dma_system_mod_ck: dma_system_mod_ck@a20 {
		#clock-cells = <0>;
		compatible = "ti,omap4-mod-clock";
		reg = <0x0a20>;
		clocks = <&l3_iclk_div>;
	};

	dmm_mod_ck: dmm_mod_ck@b20 {
		#clock-cells = <0>;
		compatible = "ti,omap4-mod-clock";
		reg = <0x0b20>;
		clocks = <&l3_iclk_div>;
	};

	emif1_mod_ck: emif1_mod_ck@b30 {
		#clock-cells = <0>;
		compatible = "ti,omap4-hw-mod-clock";
		reg = <0x0b30>;
		clocks = <&dpll_core_h11x2_ck>;
	};

	emif2_mod_ck: emif2_mod_ck@b38 {
		#clock-cells = <0>;
		compatible = "ti,omap4-hw-mod-clock";
		reg = <0x0b38>;
		clocks = <&dpll_core_h11x2_ck>;
	};

	l4_cfg_mod_ck: l4_cfg_mod_ck@d20 {
		#clock-cells = <0>;
		compatible = "ti,omap4-mod-clock";
		reg = <0x0d20>;
		clocks = <&l4_root_clk_div>;
	};

	spinlock_mod_ck: spinlock_mod_ck@d28 {
		#clock-cells = <0>;
		compatible = "ti,omap4-mod-clock";
		reg = <0x0d28>;
		clocks = <&l4_root_clk_div>;
	};

	mailbox_mod_ck: mailbox_mod_ck@d30 {
		#clock-cells = <0>;
		compatible = "ti,omap4-mod-clock";
		reg = <0x0d30>;
		clocks = <&l4_root_clk_div>;
	};

	l3_main_3_mod_ck: l3_main_3_mod_ck@e20 {
		#clock-cells = <0>;
		compatible = "ti,omap4-hw-mod-clock";
		reg = <0x0e20>;
		clocks = <&l3_iclk_div>;
	};

	l3_instr_mod_ck: l3_instr_mod_ck@e28 {
		#clock-cells = <0>;
		compatible = "ti,omap4-hw-mod-clock";
		reg = <0x0e28>;
		clocks = <&l3_iclk_div>;
	};

	usb_tll_hs_usb_ch0_clk: usb_tll_hs_usb_ch0_clk@1668 {
		#clock-cells = <0>;
		compatible = "ti,gate-clock";
		clocks = <&l3init_60m_fclk>;
		ti,bit-shift = <8>;
		reg = <0x1668>;
	};

	usb_tll_hs_mod_ck: usb_tll_hs_mod_ck@1668 {
		#clock-cells = <0>;
		compatible = "ti,omap4-hw-mod-clock";
		reg = <0x1668>;
		clocks = <&l4_root_clk_div>;
	};

	usb_tll_hs_usb_ch1_clk: usb_tll_hs_usb_ch1_clk@1668 {
		#clock-cells = <0>;
		compatible = "ti,gate-clock";
		clocks = <&l3init_60m_fclk>;
		ti,bit-shift = <9>;
		reg = <0x1668>;
	};

	usb_tll_hs_usb_ch2_clk: usb_tll_hs_usb_ch2_clk@1668 {
		#clock-cells = <0>;
		compatible = "ti,gate-clock";
		clocks = <&l3init_60m_fclk>;
		ti,bit-shift = <10>;
		reg = <0x1668>;
	};

	fdif_fclk: fdif_fclk@1328 {
		#clock-cells = <0>;
		compatible = "ti,divider-clock";
		clocks = <&dpll_per_h11x2_ck>;
		ti,bit-shift = <24>;
		ti,max-div = <2>;
		reg = <0x1328>;
	};

	gpu_core_gclk_mux: gpu_core_gclk_mux@1520 {
		#clock-cells = <0>;
		compatible = "ti,mux-clock";
		clocks = <&dpll_core_h14x2_ck>, <&dpll_per_h14x2_ck>;
		ti,bit-shift = <24>;
		reg = <0x1520>;
	};

	gpu_hyd_gclk_mux: gpu_hyd_gclk_mux@1520 {
		#clock-cells = <0>;
		compatible = "ti,mux-clock";
		clocks = <&dpll_core_h14x2_ck>, <&dpll_per_h14x2_ck>;
		ti,bit-shift = <25>;
		reg = <0x1520>;
	};

	hsi_fclk: hsi_fclk@1638 {
		#clock-cells = <0>;
		compatible = "ti,divider-clock";
		clocks = <&dpll_per_m2x2_ck>;
		ti,bit-shift = <24>;
		ti,max-div = <2>;
		reg = <0x1638>;
	};

	mmc1_fclk_mux: mmc1_fclk_mux@1628 {
		#clock-cells = <0>;
		compatible = "ti,mux-clock";
		clocks = <&func_128m_clk>, <&dpll_per_m2x2_ck>;
		ti,bit-shift = <24>;
		reg = <0x1628>;
	};

	mmc1_fclk: mmc1_fclk@1628 {
		#clock-cells = <0>;
		compatible = "ti,divider-clock";
		clocks = <&mmc1_fclk_mux>;
		ti,bit-shift = <25>;
		ti,max-div = <2>;
		reg = <0x1628>;
	};

	mmc1_mod_ck: mmc1_mod_ck@1628 {
		#clock-cells = <0>;
		compatible = "ti,omap4-sw-mod-clock";
		reg = <0x1628>;
		clocks = <&mmc1_fclk>;
	};

	mmc2_fclk_mux: mmc2_fclk_mux@1630 {
		#clock-cells = <0>;
		compatible = "ti,mux-clock";
		clocks = <&func_128m_clk>, <&dpll_per_m2x2_ck>;
		ti,bit-shift = <24>;
		reg = <0x1630>;
	};

	mmc2_fclk: mmc2_fclk@1630 {
		#clock-cells = <0>;
		compatible = "ti,divider-clock";
		clocks = <&mmc2_fclk_mux>;
		ti,bit-shift = <25>;
		ti,max-div = <2>;
		reg = <0x1630>;
	};

	mmc2_mod_ck: mmc2_mod_ck@1630 {
		#clock-cells = <0>;
		compatible = "ti,omap4-sw-mod-clock";
		reg = <0x1630>;
		clocks = <&mmc2_fclk>;
	};

};

&cm_core_clockdomains {
	l3init_clkdm: l3init_clkdm {
		compatible = "ti,clockdomain";
		clocks = <&usb_tll_hs_mod_ck>, <&usb_host_hs_mod_ck>,
			 <&sata_mod_ck>, <&ocp2scp1_mod_ck>, <&mmc1_mod_ck>,
			 <&mmc2_mod_ck>, <&usb_otg_ss_mod_ck>,
			 <&ocp2scp3_mod_ck>, <&dpll_usb_ck>;
	};

	dss_clkdm: dss_clkdm {
		compatible = "ti,clockdomain";
		clocks = <&dss_dsi2_mod_ck>, <&dss_rfbi_mod_ck>,
			 <&dss_hdmi_mod_ck>, <&dss_dispc_mod_ck>,
			 <&dss_dsi1_mod_ck>, <&dss_core_mod_ck>;
	};

	emif_clkdm: emif_clkdm {
		compatible = "ti,clockdomain";
		clocks = <&emif1_mod_ck>, <&dmm_mod_ck>, <&emif2_mod_ck>;
	};

	l3main1_clkdm: l3main1_clkdm {
		compatible = "ti,clockdomain";
		clocks = <&l3_main_1_mod_ck>;
	};

	l4cfg_clkdm: l4cfg_clkdm {
		compatible = "ti,clockdomain";
		clocks = <&spinlock_mod_ck>, <&l4_cfg_mod_ck>,
			 <&mailbox_mod_ck>;
	};

	dma_clkdm: dma_clkdm {
		compatible = "ti,clockdomain";
		clocks = <&dma_system_mod_ck>;
	};

	l3main2_clkdm: l3main2_clkdm {
		compatible = "ti,clockdomain";
		clocks = <&l3_main_2_mod_ck>;
	};

	ipu_clkdm: ipu_clkdm {
		compatible = "ti,clockdomain";
		clocks = <&mmu_ipu_mod_ck>;
	};

	l3instr_clkdm: l3instr_clkdm {
		compatible = "ti,clockdomain";
		clocks = <&l3_main_3_mod_ck>, <&l3_instr_mod_ck>;
	};

	l4per_clkdm: l4per_clkdm {
		compatible = "ti,clockdomain";
		clocks = <&l4_per_mod_ck>, <&uart6_mod_ck>, <&i2c4_mod_ck>,
			 <&gpio8_mod_ck>, <&uart5_mod_ck>, <&gpio4_mod_ck>,
			 <&timer4_mod_ck>, <&mcspi2_mod_ck>, <&mmc3_mod_ck>,
			 <&mmc5_mod_ck>, <&timer9_mod_ck>, <&gpio7_mod_ck>,
			 <&mcspi3_mod_ck>, <&uart4_mod_ck>, <&uart2_mod_ck>,
			 <&i2c3_mod_ck>, <&timer11_mod_ck>, <&mmc4_mod_ck>,
			 <&i2c5_mod_ck>, <&gpio2_mod_ck>, <&gpio3_mod_ck>,
			 <&uart3_mod_ck>, <&i2c2_mod_ck>, <&mcspi1_mod_ck>,
			 <&timer2_mod_ck>, <&gpio5_mod_ck>, <&uart1_mod_ck>,
			 <&timer10_mod_ck>, <&gpio6_mod_ck>, <&timer3_mod_ck>,
			 <&mcspi4_mod_ck>, <&i2c1_mod_ck>;
	};
};

&scrm_clocks {
	auxclk0_src_gate_ck: auxclk0_src_gate_ck@310 {
		#clock-cells = <0>;
		compatible = "ti,composite-no-wait-gate-clock";
		clocks = <&dpll_core_m3x2_ck>;
		ti,bit-shift = <8>;
		reg = <0x0310>;
	};

	auxclk0_src_mux_ck: auxclk0_src_mux_ck@310 {
		#clock-cells = <0>;
		compatible = "ti,composite-mux-clock";
		clocks = <&sys_clkin>, <&dpll_core_m3x2_ck>, <&dpll_per_m3x2_ck>;
		ti,bit-shift = <1>;
		reg = <0x0310>;
	};

	auxclk0_src_ck: auxclk0_src_ck {
		#clock-cells = <0>;
		compatible = "ti,composite-clock";
		clocks = <&auxclk0_src_gate_ck>, <&auxclk0_src_mux_ck>;
	};

	auxclk0_ck: auxclk0_ck@310 {
		#clock-cells = <0>;
		compatible = "ti,divider-clock";
		clocks = <&auxclk0_src_ck>;
		ti,bit-shift = <16>;
		ti,max-div = <16>;
		reg = <0x0310>;
	};

	auxclk1_src_gate_ck: auxclk1_src_gate_ck@314 {
		#clock-cells = <0>;
		compatible = "ti,composite-no-wait-gate-clock";
		clocks = <&dpll_core_m3x2_ck>;
		ti,bit-shift = <8>;
		reg = <0x0314>;
	};

	auxclk1_src_mux_ck: auxclk1_src_mux_ck@314 {
		#clock-cells = <0>;
		compatible = "ti,composite-mux-clock";
		clocks = <&sys_clkin>, <&dpll_core_m3x2_ck>, <&dpll_per_m3x2_ck>;
		ti,bit-shift = <1>;
		reg = <0x0314>;
	};

	auxclk1_src_ck: auxclk1_src_ck {
		#clock-cells = <0>;
		compatible = "ti,composite-clock";
		clocks = <&auxclk1_src_gate_ck>, <&auxclk1_src_mux_ck>;
	};

	auxclk1_ck: auxclk1_ck@314 {
		#clock-cells = <0>;
		compatible = "ti,divider-clock";
		clocks = <&auxclk1_src_ck>;
		ti,bit-shift = <16>;
		ti,max-div = <16>;
		reg = <0x0314>;
	};

	auxclk2_src_gate_ck: auxclk2_src_gate_ck@318 {
		#clock-cells = <0>;
		compatible = "ti,composite-no-wait-gate-clock";
		clocks = <&dpll_core_m3x2_ck>;
		ti,bit-shift = <8>;
		reg = <0x0318>;
	};

	auxclk2_src_mux_ck: auxclk2_src_mux_ck@318 {
		#clock-cells = <0>;
		compatible = "ti,composite-mux-clock";
		clocks = <&sys_clkin>, <&dpll_core_m3x2_ck>, <&dpll_per_m3x2_ck>;
		ti,bit-shift = <1>;
		reg = <0x0318>;
	};

	auxclk2_src_ck: auxclk2_src_ck {
		#clock-cells = <0>;
		compatible = "ti,composite-clock";
		clocks = <&auxclk2_src_gate_ck>, <&auxclk2_src_mux_ck>;
	};

	auxclk2_ck: auxclk2_ck@318 {
		#clock-cells = <0>;
		compatible = "ti,divider-clock";
		clocks = <&auxclk2_src_ck>;
		ti,bit-shift = <16>;
		ti,max-div = <16>;
		reg = <0x0318>;
	};

	auxclk3_src_gate_ck: auxclk3_src_gate_ck@31c {
		#clock-cells = <0>;
		compatible = "ti,composite-no-wait-gate-clock";
		clocks = <&dpll_core_m3x2_ck>;
		ti,bit-shift = <8>;
		reg = <0x031c>;
	};

	auxclk3_src_mux_ck: auxclk3_src_mux_ck@31c {
		#clock-cells = <0>;
		compatible = "ti,composite-mux-clock";
		clocks = <&sys_clkin>, <&dpll_core_m3x2_ck>, <&dpll_per_m3x2_ck>;
		ti,bit-shift = <1>;
		reg = <0x031c>;
	};

	auxclk3_src_ck: auxclk3_src_ck {
		#clock-cells = <0>;
		compatible = "ti,composite-clock";
		clocks = <&auxclk3_src_gate_ck>, <&auxclk3_src_mux_ck>;
	};

	auxclk3_ck: auxclk3_ck@31c {
		#clock-cells = <0>;
		compatible = "ti,divider-clock";
		clocks = <&auxclk3_src_ck>;
		ti,bit-shift = <16>;
		ti,max-div = <16>;
		reg = <0x031c>;
	};

	auxclk4_src_gate_ck: auxclk4_src_gate_ck@320 {
		#clock-cells = <0>;
		compatible = "ti,composite-no-wait-gate-clock";
		clocks = <&dpll_core_m3x2_ck>;
		ti,bit-shift = <8>;
		reg = <0x0320>;
	};

	auxclk4_src_mux_ck: auxclk4_src_mux_ck@320 {
		#clock-cells = <0>;
		compatible = "ti,composite-mux-clock";
		clocks = <&sys_clkin>, <&dpll_core_m3x2_ck>, <&dpll_per_m3x2_ck>;
		ti,bit-shift = <1>;
		reg = <0x0320>;
	};

	auxclk4_src_ck: auxclk4_src_ck {
		#clock-cells = <0>;
		compatible = "ti,composite-clock";
		clocks = <&auxclk4_src_gate_ck>, <&auxclk4_src_mux_ck>;
	};

	auxclk4_ck: auxclk4_ck@320 {
		#clock-cells = <0>;
		compatible = "ti,divider-clock";
		clocks = <&auxclk4_src_ck>;
		ti,bit-shift = <16>;
		ti,max-div = <16>;
		reg = <0x0320>;
	};

	auxclkreq0_ck: auxclkreq0_ck@210 {
		#clock-cells = <0>;
		compatible = "ti,mux-clock";
		clocks = <&auxclk0_ck>, <&auxclk1_ck>, <&auxclk2_ck>, <&auxclk3_ck>, <&auxclk4_ck>;
		ti,bit-shift = <2>;
		reg = <0x0210>;
	};

	auxclkreq1_ck: auxclkreq1_ck@214 {
		#clock-cells = <0>;
		compatible = "ti,mux-clock";
		clocks = <&auxclk0_ck>, <&auxclk1_ck>, <&auxclk2_ck>, <&auxclk3_ck>, <&auxclk4_ck>;
		ti,bit-shift = <2>;
		reg = <0x0214>;
	};

	auxclkreq2_ck: auxclkreq2_ck@218 {
		#clock-cells = <0>;
		compatible = "ti,mux-clock";
		clocks = <&auxclk0_ck>, <&auxclk1_ck>, <&auxclk2_ck>, <&auxclk3_ck>, <&auxclk4_ck>;
		ti,bit-shift = <2>;
		reg = <0x0218>;
	};

	auxclkreq3_ck: auxclkreq3_ck@21c {
		#clock-cells = <0>;
		compatible = "ti,mux-clock";
		clocks = <&auxclk0_ck>, <&auxclk1_ck>, <&auxclk2_ck>, <&auxclk3_ck>, <&auxclk4_ck>;
		ti,bit-shift = <2>;
		reg = <0x021c>;
	};
};

&prm_clockdomains {
	wkupaon_clkdm: wkupaon_clkdm {
		compatible = "ti,clockdomain";
		clocks = <&kbd_mod_ck>, <&gpio1_mod_ck>, <&counter_32k_mod_ck>,
			 <&timer1_mod_ck>, <&wd_timer2_mod_ck>,
			 <&l4_wkup_mod_ck>;
	};
};

&cm_core_aon_clockdomains {
	mpu_clkdm: mpu_clkdm {
		compatible = "ti,clockdomain";
		clocks = <&mpu_mod_ck>;
	};

	dsp_clkdm: dsp_clkdm {
		compatible = "ti,clockdomain";
		clocks = <&mmu_dsp_mod_ck>;
	};

	abe_clkdm: abe_clkdm {
		compatible = "ti,clockdomain";
		clocks = <&timer5_mod_ck>, <&timer7_mod_ck>, <&mcbsp2_mod_ck>,
			 <&mcbsp1_mod_ck>, <&dmic_mod_ck>, <&timer6_mod_ck>,
			 <&mcbsp3_mod_ck>, <&mcpdm_mod_ck>, <&l4_abe_mod_ck>,
			 <&timer8_mod_ck>;
	};
};
