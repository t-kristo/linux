/*
 * Device Tree Source for AM43xx clock data
 *
 * Copyright (C) 2013 Texas Instruments, Inc.
 *
 * This program is free software; you can redistribute it and/or modify
 * it under the terms of the GNU General Public License version 2 as
 * published by the Free Software Foundation.
 */
&scm_clocks {
	sys_clkin_ck: sys_clkin_ck@40 {
		#clock-cells = <0>;
		compatible = "ti,mux-clock";
		clocks = <&sysboot_freq_sel_ck>, <&crystal_freq_sel_ck>;
		ti,bit-shift = <31>;
		reg = <0x0040>;
	};

	crystal_freq_sel_ck: crystal_freq_sel_ck@40 {
		#clock-cells = <0>;
		compatible = "ti,mux-clock";
		clocks = <&virt_19200000_ck>, <&virt_24000000_ck>, <&virt_25000000_ck>, <&virt_26000000_ck>;
		ti,bit-shift = <29>;
		reg = <0x0040>;
	};

	sysboot_freq_sel_ck: sysboot_freq_sel_ck@44e10040 {
		#clock-cells = <0>;
		compatible = "ti,mux-clock";
		clocks = <&virt_19200000_ck>, <&virt_24000000_ck>, <&virt_25000000_ck>, <&virt_26000000_ck>;
		ti,bit-shift = <22>;
		reg = <0x0040>;
	};

	adc_tsc_fck: adc_tsc_fck {
		#clock-cells = <0>;
		compatible = "fixed-factor-clock";
		clocks = <&sys_clkin_ck>;
		clock-mult = <1>;
		clock-div = <1>;
	};

	dcan0_fck: dcan0_fck {
		#clock-cells = <0>;
		compatible = "fixed-factor-clock";
		clocks = <&sys_clkin_ck>;
		clock-mult = <1>;
		clock-div = <1>;
	};

	dcan1_fck: dcan1_fck {
		#clock-cells = <0>;
		compatible = "fixed-factor-clock";
		clocks = <&sys_clkin_ck>;
		clock-mult = <1>;
		clock-div = <1>;
	};

	mcasp0_fck: mcasp0_fck {
		#clock-cells = <0>;
		compatible = "fixed-factor-clock";
		clocks = <&sys_clkin_ck>;
		clock-mult = <1>;
		clock-div = <1>;
	};

	mcasp1_fck: mcasp1_fck {
		#clock-cells = <0>;
		compatible = "fixed-factor-clock";
		clocks = <&sys_clkin_ck>;
		clock-mult = <1>;
		clock-div = <1>;
	};

	smartreflex0_fck: smartreflex0_fck {
		#clock-cells = <0>;
		compatible = "fixed-factor-clock";
		clocks = <&sys_clkin_ck>;
		clock-mult = <1>;
		clock-div = <1>;
	};

	smartreflex1_fck: smartreflex1_fck {
		#clock-cells = <0>;
		compatible = "fixed-factor-clock";
		clocks = <&sys_clkin_ck>;
		clock-mult = <1>;
		clock-div = <1>;
	};

	sha0_fck: sha0_fck {
		#clock-cells = <0>;
		compatible = "fixed-factor-clock";
		clocks = <&sys_clkin_ck>;
		clock-mult = <1>;
		clock-div = <1>;
	};

	aes0_fck: aes0_fck {
		#clock-cells = <0>;
		compatible = "fixed-factor-clock";
		clocks = <&sys_clkin_ck>;
		clock-mult = <1>;
		clock-div = <1>;
	};

	ehrpwm0_tbclk: ehrpwm0_tbclk@664 {
		#clock-cells = <0>;
		compatible = "ti,gate-clock";
		clocks = <&l4ls_gclk>;
		ti,bit-shift = <0>;
		reg = <0x0664>;
	};

	ehrpwm1_tbclk: ehrpwm1_tbclk@664 {
		#clock-cells = <0>;
		compatible = "ti,gate-clock";
		clocks = <&l4ls_gclk>;
		ti,bit-shift = <1>;
		reg = <0x0664>;
	};

	ehrpwm2_tbclk: ehrpwm2_tbclk@664 {
		#clock-cells = <0>;
		compatible = "ti,gate-clock";
		clocks = <&l4ls_gclk>;
		ti,bit-shift = <2>;
		reg = <0x0664>;
	};

	ehrpwm3_tbclk: ehrpwm3_tbclk@664 {
		#clock-cells = <0>;
		compatible = "ti,gate-clock";
		clocks = <&l4ls_gclk>;
		ti,bit-shift = <4>;
		reg = <0x0664>;
	};

	ehrpwm4_tbclk: ehrpwm4_tbclk@664 {
		#clock-cells = <0>;
		compatible = "ti,gate-clock";
		clocks = <&l4ls_gclk>;
		ti,bit-shift = <5>;
		reg = <0x0664>;
	};

	ehrpwm5_tbclk: ehrpwm5_tbclk@664 {
		#clock-cells = <0>;
		compatible = "ti,gate-clock";
		clocks = <&l4ls_gclk>;
		ti,bit-shift = <6>;
		reg = <0x0664>;
	};
};
&prcm_clocks {
	clk_32768_ck: clk_32768_ck {
		#clock-cells = <0>;
		compatible = "fixed-clock";
		clock-frequency = <32768>;
	};

	clk_rc32k_ck: clk_rc32k_ck {
		#clock-cells = <0>;
		compatible = "fixed-clock";
		clock-frequency = <32768>;
	};

	virt_19200000_ck: virt_19200000_ck {
		#clock-cells = <0>;
		compatible = "fixed-clock";
		clock-frequency = <19200000>;
	};

	virt_24000000_ck: virt_24000000_ck {
		#clock-cells = <0>;
		compatible = "fixed-clock";
		clock-frequency = <24000000>;
	};

	virt_25000000_ck: virt_25000000_ck {
		#clock-cells = <0>;
		compatible = "fixed-clock";
		clock-frequency = <25000000>;
	};

	virt_26000000_ck: virt_26000000_ck {
		#clock-cells = <0>;
		compatible = "fixed-clock";
		clock-frequency = <26000000>;
	};

	tclkin_ck: tclkin_ck {
		#clock-cells = <0>;
		compatible = "fixed-clock";
		clock-frequency = <26000000>;
	};

	dpll_core_ck: dpll_core_ck@2d20 {
		#clock-cells = <0>;
		compatible = "ti,am3-dpll-core-clock";
		clocks = <&sys_clkin_ck>, <&sys_clkin_ck>;
		reg = <0x2d20>, <0x2d24>, <0x2d2c>;
	};

	dpll_core_x2_ck: dpll_core_x2_ck {
		#clock-cells = <0>;
		compatible = "ti,am3-dpll-x2-clock";
		clocks = <&dpll_core_ck>;
	};

	dpll_core_m4_ck: dpll_core_m4_ck@2d38 {
		#clock-cells = <0>;
		compatible = "ti,divider-clock";
		clocks = <&dpll_core_x2_ck>;
		ti,max-div = <31>;
		ti,autoidle-shift = <8>;
		reg = <0x2d38>;
		ti,index-starts-at-one;
		ti,invert-autoidle-bit;
	};

	dpll_core_m5_ck: dpll_core_m5_ck@2d3c {
		#clock-cells = <0>;
		compatible = "ti,divider-clock";
		clocks = <&dpll_core_x2_ck>;
		ti,max-div = <31>;
		ti,autoidle-shift = <8>;
		reg = <0x2d3c>;
		ti,index-starts-at-one;
		ti,invert-autoidle-bit;
	};

	dpll_core_m6_ck: dpll_core_m6_ck@2d40 {
		#clock-cells = <0>;
		compatible = "ti,divider-clock";
		clocks = <&dpll_core_x2_ck>;
		ti,max-div = <31>;
		ti,autoidle-shift = <8>;
		reg = <0x2d40>;
		ti,index-starts-at-one;
		ti,invert-autoidle-bit;
	};

	dpll_mpu_ck: dpll_mpu_ck@2d60 {
		#clock-cells = <0>;
		compatible = "ti,am3-dpll-clock";
		clocks = <&sys_clkin_ck>, <&sys_clkin_ck>;
		reg = <0x2d60>, <0x2d64>, <0x2d6c>;
	};

	dpll_mpu_m2_ck: dpll_mpu_m2_ck@2d70 {
		#clock-cells = <0>;
		compatible = "ti,divider-clock";
		clocks = <&dpll_mpu_ck>;
		ti,max-div = <31>;
		ti,autoidle-shift = <8>;
		reg = <0x2d70>;
		ti,index-starts-at-one;
		ti,invert-autoidle-bit;
	};

	mpu_periphclk: mpu_periphclk {
		#clock-cells = <0>;
		compatible = "fixed-factor-clock";
		clocks = <&dpll_mpu_m2_ck>;
		clock-mult = <1>;
		clock-div = <2>;
	};

	dpll_ddr_ck: dpll_ddr_ck@2da0 {
		#clock-cells = <0>;
		compatible = "ti,am3-dpll-clock";
		clocks = <&sys_clkin_ck>, <&sys_clkin_ck>;
		reg = <0x2da0>, <0x2da4>, <0x2dac>;
	};

	dpll_ddr_m2_ck: dpll_ddr_m2_ck@2db0 {
		#clock-cells = <0>;
		compatible = "ti,divider-clock";
		clocks = <&dpll_ddr_ck>;
		ti,max-div = <31>;
		ti,autoidle-shift = <8>;
		reg = <0x2db0>;
		ti,index-starts-at-one;
		ti,invert-autoidle-bit;
	};

	dpll_disp_ck: dpll_disp_ck@2e20 {
		#clock-cells = <0>;
		compatible = "ti,am3-dpll-clock";
		clocks = <&sys_clkin_ck>, <&sys_clkin_ck>;
		reg = <0x2e20>, <0x2e24>, <0x2e2c>;
	};

	dpll_disp_m2_ck: dpll_disp_m2_ck@2e30 {
		#clock-cells = <0>;
		compatible = "ti,divider-clock";
		clocks = <&dpll_disp_ck>;
		ti,max-div = <31>;
		ti,autoidle-shift = <8>;
		reg = <0x2e30>;
		ti,index-starts-at-one;
		ti,invert-autoidle-bit;
		ti,set-rate-parent;
	};

	dpll_per_ck: dpll_per_ck@2de0 {
		#clock-cells = <0>;
		compatible = "ti,am3-dpll-j-type-clock";
		clocks = <&sys_clkin_ck>, <&sys_clkin_ck>;
		reg = <0x2de0>, <0x2de4>, <0x2dec>;
	};

	dpll_per_m2_ck: dpll_per_m2_ck@2df0 {
		#clock-cells = <0>;
		compatible = "ti,divider-clock";
		clocks = <&dpll_per_ck>;
		ti,max-div = <127>;
		ti,autoidle-shift = <8>;
		reg = <0x2df0>;
		ti,index-starts-at-one;
		ti,invert-autoidle-bit;
	};

	dpll_per_m2_div4_wkupdm_ck: dpll_per_m2_div4_wkupdm_ck {
		#clock-cells = <0>;
		compatible = "fixed-factor-clock";
		clocks = <&dpll_per_m2_ck>;
		clock-mult = <1>;
		clock-div = <4>;
	};

	dpll_per_m2_div4_ck: dpll_per_m2_div4_ck {
		#clock-cells = <0>;
		compatible = "fixed-factor-clock";
		clocks = <&dpll_per_m2_ck>;
		clock-mult = <1>;
		clock-div = <4>;
	};

	clk_24mhz: clk_24mhz {
		#clock-cells = <0>;
		compatible = "fixed-factor-clock";
		clocks = <&dpll_per_m2_ck>;
		clock-mult = <1>;
		clock-div = <8>;
	};

	clkdiv32k_ck: clkdiv32k_ck {
		#clock-cells = <0>;
		compatible = "fixed-factor-clock";
		clocks = <&clk_24mhz>;
		clock-mult = <1>;
		clock-div = <732>;
	};

	clkdiv32k_ick: clkdiv32k_ick@2a38 {
		#clock-cells = <0>;
		compatible = "ti,gate-clock";
		clocks = <&clkdiv32k_ck>;
		ti,bit-shift = <8>;
		reg = <0x2a38>;
	};

	sysclk_div: sysclk_div {
		#clock-cells = <0>;
		compatible = "fixed-factor-clock";
		clocks = <&dpll_core_m4_ck>;
		clock-mult = <1>;
		clock-div = <1>;
	};

	pruss_ocp_gclk: pruss_ocp_gclk@4248 {
		#clock-cells = <0>;
		compatible = "ti,mux-clock";
		clocks = <&sysclk_div>, <&dpll_disp_m2_ck>;
		reg = <0x4248>;
	};

	clk_32k_tpm_ck: clk_32k_tpm_ck {
		#clock-cells = <0>;
		compatible = "fixed-clock";
		clock-frequency = <32768>;
	};

	wdt1_fck: wdt1_fck@422c {
		#clock-cells = <0>;
		compatible = "ti,mux-clock";
		clocks = <&clk_rc32k_ck>, <&clkdiv32k_ick>;
		reg = <0x422c>;
	};

	l3_gclk: l3_gclk {
		#clock-cells = <0>;
		compatible = "fixed-factor-clock";
		clocks = <&dpll_core_m4_ck>;
		clock-mult = <1>;
		clock-div = <1>;
	};

	dpll_core_m4_div2_ck: dpll_core_m4_div2_ck {
		#clock-cells = <0>;
		compatible = "fixed-factor-clock";
		clocks = <&sysclk_div>;
		clock-mult = <1>;
		clock-div = <2>;
	};

	l4hs_gclk: l4hs_gclk {
		#clock-cells = <0>;
		compatible = "fixed-factor-clock";
		clocks = <&dpll_core_m4_ck>;
		clock-mult = <1>;
		clock-div = <1>;
	};

	l3s_gclk: l3s_gclk {
		#clock-cells = <0>;
		compatible = "fixed-factor-clock";
		clocks = <&dpll_core_m4_div2_ck>;
		clock-mult = <1>;
		clock-div = <1>;
	};

	l4ls_gclk: l4ls_gclk {
		#clock-cells = <0>;
		compatible = "fixed-factor-clock";
		clocks = <&dpll_core_m4_div2_ck>;
		clock-mult = <1>;
		clock-div = <1>;
	};

	cpsw_125mhz_gclk: cpsw_125mhz_gclk {
		#clock-cells = <0>;
		compatible = "fixed-factor-clock";
		clocks = <&dpll_core_m5_ck>;
		clock-mult = <1>;
		clock-div = <2>;
	};

	cpsw_cpts_rft_clk: cpsw_cpts_rft_clk@4238 {
		#clock-cells = <0>;
		compatible = "ti,mux-clock";
		clocks = <&sysclk_div>, <&dpll_core_m5_ck>, <&dpll_disp_m2_ck>;
		reg = <0x4238>;
	};

	dpll_clksel_mac_clk: dpll_clksel_mac_clk@4234 {
		#clock-cells = <0>;
		compatible = "ti,divider-clock";
		clocks = <&dpll_core_m5_ck>;
		reg = <0x4234>;
		ti,bit-shift = <2>;
		ti,dividers = <2>, <5>;
	};

	clk_32k_mosc_ck: clk_32k_mosc_ck {
		#clock-cells = <0>;
		compatible = "fixed-clock";
		clock-frequency = <32768>;
	};

	gpio0_dbclk_mux_ck: gpio0_dbclk_mux_ck@4240 {
		#clock-cells = <0>;
		compatible = "ti,mux-clock";
		clocks = <&clk_rc32k_ck>, <&clk_32768_ck>, <&clkdiv32k_ick>, <&clk_32k_mosc_ck>, <&clk_32k_tpm_ck>;
		reg = <0x4240>;
	};

	gpio0_dbclk: gpio0_dbclk@2b68 {
		#clock-cells = <0>;
		compatible = "ti,gate-clock";
		clocks = <&gpio0_dbclk_mux_ck>;
		ti,bit-shift = <8>;
		reg = <0x2b68>;
	};

	gpio1_mod_ck: gpio1_mod_ck@2b68 {
		#clock-cells = <0>;
		compatible = "ti,omap4-sw-mod-clock";
		reg = <0x2b68>;
		clocks = <&sys_clkin_ck>;
	};

	gpio1_dbclk: gpio1_dbclk@8c78 {
		#clock-cells = <0>;
		compatible = "ti,gate-clock";
		clocks = <&clkdiv32k_ick>;
		ti,bit-shift = <8>;
		reg = <0x8c78>;
	};

	gpio2_mod_ck: gpio2_mod_ck@8c78 {
		#clock-cells = <0>;
		compatible = "ti,omap4-sw-mod-clock";
		reg = <0x8c78>;
		clocks = <&l4ls_gclk>;
	};

	gpio2_dbclk: gpio2_dbclk@8c80 {
		#clock-cells = <0>;
		compatible = "ti,gate-clock";
		clocks = <&clkdiv32k_ick>;
		ti,bit-shift = <8>;
		reg = <0x8c80>;
	};

	gpio3_mod_ck: gpio3_mod_ck@8c80 {
		#clock-cells = <0>;
		compatible = "ti,omap4-sw-mod-clock";
		reg = <0x8c80>;
		clocks = <&l4ls_gclk>;
	};

	gpio3_dbclk: gpio3_dbclk@8c88 {
		#clock-cells = <0>;
		compatible = "ti,gate-clock";
		clocks = <&clkdiv32k_ick>;
		ti,bit-shift = <8>;
		reg = <0x8c88>;
	};

	gpio4_mod_ck: gpio4_mod_ck@8c88 {
		#clock-cells = <0>;
		compatible = "ti,omap4-sw-mod-clock";
		reg = <0x8c88>;
		clocks = <&l4ls_gclk>;
	};

	gpio4_dbclk: gpio4_dbclk@8c90 {
		#clock-cells = <0>;
		compatible = "ti,gate-clock";
		clocks = <&clkdiv32k_ick>;
		ti,bit-shift = <8>;
		reg = <0x8c90>;
	};

	gpio5_mod_ck: gpio5_mod_ck@8c90 {
		#clock-cells = <0>;
		compatible = "ti,omap4-sw-mod-clock";
		reg = <0x8c90>;
		clocks = <&l4ls_gclk>;
	};

	gpio5_dbclk: gpio5_dbclk@8c98 {
		#clock-cells = <0>;
		compatible = "ti,gate-clock";
		clocks = <&clkdiv32k_ick>;
		ti,bit-shift = <8>;
		reg = <0x8c98>;
	};

	gpio6_mod_ck: gpio6_mod_ck@8c98 {
		#clock-cells = <0>;
		compatible = "ti,omap4-sw-mod-clock";
		reg = <0x8c98>;
		clocks = <&l4ls_gclk>;
	};

	hdq1w_mod_ck: hdq1w_mod_ck@8ca0 {
		#clock-cells = <0>;
		compatible = "ti,omap4-sw-mod-clock";
		reg = <0x8ca0>;
		clocks = <&func_12m_clk>;
	};

	i2c2_mod_ck: i2c2_mod_ck@8ca8 {
		#clock-cells = <0>;
		compatible = "ti,omap4-sw-mod-clock";
		reg = <0x8ca8>;
		clocks = <&dpll_per_m2_div4_ck>;
	};

	i2c3_mod_ck: i2c3_mod_ck@8cb0 {
		#clock-cells = <0>;
		compatible = "ti,omap4-sw-mod-clock";
		reg = <0x8cb0>;
		clocks = <&dpll_per_m2_div4_ck>;
	};

	mailbox_mod_ck: mailbox_mod_ck@8cb8 {
		#clock-cells = <0>;
		compatible = "ti,omap4-sw-mod-clock";
		reg = <0x8cb8>;
		clocks = <&l4ls_gclk>;
	};

	mmc1_mod_ck: mmc1_mod_ck@8cc0 {
		#clock-cells = <0>;
		compatible = "ti,omap4-sw-mod-clock";
		reg = <0x8cc0>;
		clocks = <&mmc_clk>;
	};

	mmc2_mod_ck: mmc2_mod_ck@8cc8 {
		#clock-cells = <0>;
		compatible = "ti,omap4-sw-mod-clock";
		reg = <0x8cc8>;
		clocks = <&mmc_clk>;
	};

	spi0_mod_ck: spi0_mod_ck@8d00 {
		#clock-cells = <0>;
		compatible = "ti,omap4-sw-mod-clock";
		reg = <0x8d00>;
		clocks = <&dpll_per_m2_div4_ck>;
	};

	spi1_mod_ck: spi1_mod_ck@8d08 {
		#clock-cells = <0>;
		compatible = "ti,omap4-sw-mod-clock";
		reg = <0x8d08>;
		clocks = <&dpll_per_m2_div4_ck>;
	};

	spi2_mod_ck: spi2_mod_ck@8d10 {
		#clock-cells = <0>;
		compatible = "ti,omap4-sw-mod-clock";
		reg = <0x8d10>;
		clocks = <&dpll_per_m2_div4_ck>;
	};

	spi3_mod_ck: spi3_mod_ck@8d18 {
		#clock-cells = <0>;
		compatible = "ti,omap4-sw-mod-clock";
		reg = <0x8d18>;
		clocks = <&dpll_per_m2_div4_ck>;
	};

	spi4_mod_ck: spi4_mod_ck@8d20 {
		#clock-cells = <0>;
		compatible = "ti,omap4-sw-mod-clock";
		reg = <0x8d20>;
		clocks = <&dpll_per_m2_div4_ck>;
	};

	spinlock_mod_ck: spinlock_mod_ck@8d28 {
		#clock-cells = <0>;
		compatible = "ti,omap4-sw-mod-clock";
		reg = <0x8d28>;
		clocks = <&l4ls_gclk>;
	};

	timer2_mod_ck: timer2_mod_ck@8d30 {
		#clock-cells = <0>;
		compatible = "ti,omap4-sw-mux-mod-clock";
		reg = <0x8d30>, <0x4204>;
		clocks = <&tclkin_ck>, <&sys_clkin_ck>, <&clkdiv32k_ick>;
	};

	timer3_mod_ck: timer3_mod_ck@8d38 {
		#clock-cells = <0>;
		compatible = "ti,omap4-sw-mux-mod-clock";
		reg = <0x8d38>, <0x4208>;
		clocks = <&tclkin_ck>, <&sys_clkin_ck>, <&clkdiv32k_ick>;
	};

	timer4_mod_ck: timer4_mod_ck@8d40 {
		#clock-cells = <0>;
		compatible = "ti,omap4-sw-mux-mod-clock";
		reg = <0x8d40>, <0x420c>;
		clocks = <&tclkin_ck>, <&sys_clkin_ck>, <&clkdiv32k_ick>;
	};

	timer5_mod_ck: timer5_mod_ck@8d48 {
		#clock-cells = <0>;
		compatible = "ti,omap4-sw-mux-mod-clock";
		reg = <0x8d48>, <0x4210>;
		clocks = <&tclkin_ck>, <&sys_clkin_ck>, <&clkdiv32k_ick>;
	};

	timer6_mod_ck: timer6_mod_ck@8d50 {
		#clock-cells = <0>;
		compatible = "ti,omap4-sw-mux-mod-clock";
		reg = <0x8d50>, <0x4214>;
		clocks = <&tclkin_ck>, <&sys_clkin_ck>, <&clkdiv32k_ick>;
	};

	timer7_mod_ck: timer7_mod_ck@8d58 {
		#clock-cells = <0>;
		compatible = "ti,omap4-sw-mux-mod-clock";
		reg = <0x8d58>, <0x4218>;
		clocks = <&tclkin_ck>, <&sys_clkin_ck>, <&clkdiv32k_ick>;
	};

	timer8_mod_ck: timer8_mod_ck@8d60 {
		#clock-cells = <0>;
		compatible = "ti,omap4-sw-mux-mod-clock";
		reg = <0x8d60>, <0x421c>;
		clocks = <&tclkin_ck>, <&sys_clkin_ck>, <&clkdiv32k_ick>,
			 <&clk_32k_tpm_ck>;
	};

	timer9_mod_ck: timer9_mod_ck@8d68 {
		#clock-cells = <0>;
		compatible = "ti,omap4-sw-mux-mod-clock";
		reg = <0x8d68>, <0x4220>;
		clocks = <&tclkin_ck>, <&sys_clkin_ck>, <&clkdiv32k_ick>,
			 <&clk_32k_tpm_ck>;
	};

	timer10_mod_ck: timer10_mod_ck@8d70 {
		#clock-cells = <0>;
		compatible = "ti,omap4-sw-mux-mod-clock";
		reg = <0x8d70>, <0x4224>;
		clocks = <&tclkin_ck>, <&sys_clkin_ck>, <&clkdiv32k_ick>,
			 <&clk_32k_tpm_ck>;
	};

	timer11_mod_ck: timer11_mod_ck@8d78 {
		#clock-cells = <0>;
		compatible = "ti,omap4-sw-mux-mod-clock";
		reg = <0x8d78>, <0x4228>;
		clocks = <&tclkin_ck>, <&sys_clkin_ck>, <&clkdiv32k_ick>,
			 <&clk_32k_tpm_ck>;
	};

	uart2_mod_ck: uart2_mod_ck@8d80 {
		#clock-cells = <0>;
		compatible = "ti,omap4-sw-mod-clock";
		reg = <0x8d80>;
		clocks = <&dpll_per_m2_div4_ck>;
	};

	uart3_mod_ck: uart3_mod_ck@8d88 {
		#clock-cells = <0>;
		compatible = "ti,omap4-sw-mod-clock";
		reg = <0x8d88>;
		clocks = <&dpll_per_m2_div4_ck>;
	};

	uart4_mod_ck: uart4_mod_ck@8d90 {
		#clock-cells = <0>;
		compatible = "ti,omap4-sw-mod-clock";
		reg = <0x8d90>;
		clocks = <&dpll_per_m2_div4_ck>;
	};

	uart5_mod_ck: uart5_mod_ck@8d98 {
		#clock-cells = <0>;
		compatible = "ti,omap4-sw-mod-clock";
		reg = <0x8d98>;
		clocks = <&dpll_per_m2_div4_ck>;
	};

	uart6_mod_ck: uart6_mod_ck@8da0 {
		#clock-cells = <0>;
		compatible = "ti,omap4-sw-mod-clock";
		reg = <0x8da0>;
		clocks = <&dpll_per_m2_div4_ck>;
	};

	ocp2scp0_mod_ck: ocp2scp0_mod_ck@8db8 {
		#clock-cells = <0>;
		compatible = "ti,omap4-sw-mod-clock";
		reg = <0x8db8>;
		clocks = <&l4ls_gclk>;
	};

	ocp2scp1_mod_ck: ocp2scp1_mod_ck@8dc0 {
		#clock-cells = <0>;
		compatible = "ti,omap4-sw-mod-clock";
		reg = <0x8dc0>;
		clocks = <&l4ls_gclk>;
	};

	emif_mod_ck: emif_mod_ck@8f20 {
		#clock-cells = <0>;
		compatible = "ti,omap4-sw-mod-clock";
		reg = <0x8f20>;
		clocks = <&dpll_ddr_m2_ck>;
	};

	dss_dispc_mod_ck: dss_dispc_mod_ck@9220 {
		#clock-cells = <0>;
		compatible = "ti,omap4-mod-clock";
		reg = <0x9220>;
		clocks = <&disp_clk>;
	};

	dss_core_mod_ck: dss_core_mod_ck@9220 {
		#clock-cells = <0>;
		compatible = "ti,omap4-sw-mod-clock";
		reg = <0x9220>;
		clocks = <&disp_clk>;
	};

	dss_rfbi_mod_ck: dss_rfbi_mod_ck@9220 {
		#clock-cells = <0>;
		compatible = "ti,omap4-mod-clock";
		reg = <0x9220>;
		clocks = <&disp_clk>;
	};

	cpgmac0_mod_ck: cpgmac0_mod_ck@9320 {
		#clock-cells = <0>;
		compatible = "ti,omap4-sw-mod-clock";
		reg = <0x9320>;
		clocks = <&cpsw_125mhz_gclk>;
	};

	mmc_clk: mmc_clk {
		#clock-cells = <0>;
		compatible = "fixed-factor-clock";
		clocks = <&dpll_per_m2_ck>;
		clock-mult = <1>;
		clock-div = <2>;
	};

	gfx_fclk_clksel_ck: gfx_fclk_clksel_ck@423c {
		#clock-cells = <0>;
		compatible = "ti,mux-clock";
		clocks = <&sysclk_div>, <&dpll_per_m2_ck>;
		ti,bit-shift = <1>;
		reg = <0x423c>;
	};

	gfx_fck_div_ck: gfx_fck_div_ck@423c {
		#clock-cells = <0>;
		compatible = "ti,divider-clock";
		clocks = <&gfx_fclk_clksel_ck>;
		reg = <0x423c>;
		ti,max-div = <2>;
	};

	disp_clk: disp_clk@4244 {
		#clock-cells = <0>;
		compatible = "ti,mux-clock";
		clocks = <&dpll_disp_m2_ck>, <&dpll_core_m5_ck>, <&dpll_per_m2_ck>;
		reg = <0x4244>;
		ti,set-rate-parent;
	};

	dpll_extdev_ck: dpll_extdev_ck@2e60 {
		#clock-cells = <0>;
		compatible = "ti,am3-dpll-clock";
		clocks = <&sys_clkin_ck>, <&sys_clkin_ck>;
		reg = <0x2e60>, <0x2e64>, <0x2e6c>;
	};

	dpll_extdev_m2_ck: dpll_extdev_m2_ck@2e70 {
		#clock-cells = <0>;
		compatible = "ti,divider-clock";
		clocks = <&dpll_extdev_ck>;
		ti,max-div = <127>;
		ti,autoidle-shift = <8>;
		reg = <0x2e70>;
		ti,index-starts-at-one;
		ti,invert-autoidle-bit;
	};

	mux_synctimer32k_ck: mux_synctimer32k_ck@4230 {
		#clock-cells = <0>;
		compatible = "ti,mux-clock";
		clocks = <&clk_32768_ck>, <&clk_32k_tpm_ck>, <&clkdiv32k_ick>;
		reg = <0x4230>;
	};

	synctimer_32kclk: synctimer_32kclk@2a30 {
		#clock-cells = <0>;
		compatible = "ti,gate-clock";
		clocks = <&mux_synctimer32k_ck>;
		ti,bit-shift = <8>;
		reg = <0x2a30>;
	};

	counter_32k_mod_ck: counter_32k_mod_ck@2a30 {
		#clock-cells = <0>;
		compatible = "ti,omap4-sw-mod-clock";
		reg = <0x2a30>;
		clocks = <&synctimer_32kclk>;
	};

	cpsw_50m_clkdiv: cpsw_50m_clkdiv {
		#clock-cells = <0>;
		compatible = "fixed-factor-clock";
		clocks = <&dpll_core_m5_ck>;
		clock-mult = <1>;
		clock-div = <1>;
	};

	adc_tsc_mod_ck: adc_tsc_mod_ck@2920 {
		#clock-cells = <0>;
		compatible = "ti,omap4-sw-mod-clock";
		reg = <0x2920>;
		clocks = <&adc_tsc_fck>;
	};

	l4_wkup_mod_ck: l4_wkup_mod_ck@2a20 {
		#clock-cells = <0>;
		compatible = "ti,omap4-sw-mod-clock";
		reg = <0x2a20>;
		clocks = <&sys_clkin_ck>;
	};

	wkup_m3_mod_ck: wkup_m3_mod_ck@2a28 {
		#clock-cells = <0>;
		compatible = "ti,omap4-sw-no-idlest-mod-clock";
		reg = <0x2a28>;
		clocks = <&sys_clkin_ck>;
	};

	cpsw_5m_clkdiv: cpsw_5m_clkdiv {
		#clock-cells = <0>;
		compatible = "fixed-factor-clock";
		clocks = <&cpsw_50m_clkdiv>;
		clock-mult = <1>;
		clock-div = <10>;
	};

	dpll_ddr_x2_ck: dpll_ddr_x2_ck {
		#clock-cells = <0>;
		compatible = "ti,am3-dpll-x2-clock";
		clocks = <&dpll_ddr_ck>;
	};

	dpll_ddr_m4_ck: dpll_ddr_m4_ck@2db8 {
		#clock-cells = <0>;
		compatible = "ti,divider-clock";
		clocks = <&dpll_ddr_x2_ck>;
		ti,max-div = <31>;
		ti,autoidle-shift = <8>;
		reg = <0x2db8>;
		ti,index-starts-at-one;
		ti,invert-autoidle-bit;
	};

	dpll_per_clkdcoldo: dpll_per_clkdcoldo@2e14 {
		#clock-cells = <0>;
		compatible = "ti,fixed-factor-clock";
		clocks = <&dpll_per_ck>;
		ti,clock-mult = <1>;
		ti,clock-div = <1>;
		ti,autoidle-shift = <8>;
		reg = <0x2e14>;
		ti,invert-autoidle-bit;
	};

	dll_aging_clk_div: dll_aging_clk_div@4250 {
		#clock-cells = <0>;
		compatible = "ti,divider-clock";
		clocks = <&sys_clkin_ck>;
		reg = <0x4250>;
		ti,dividers = <8>, <16>, <32>;
	};

	div_core_25m_ck: div_core_25m_ck {
		#clock-cells = <0>;
		compatible = "fixed-factor-clock";
		clocks = <&sysclk_div>;
		clock-mult = <1>;
		clock-div = <8>;
	};

	func_12m_clk: func_12m_clk {
		#clock-cells = <0>;
		compatible = "fixed-factor-clock";
		clocks = <&dpll_per_m2_ck>;
		clock-mult = <1>;
		clock-div = <16>;
	};

	vtp_clk_div: vtp_clk_div {
		#clock-cells = <0>;
		compatible = "fixed-factor-clock";
		clocks = <&sys_clkin_ck>;
		clock-mult = <1>;
		clock-div = <2>;
	};

	usbphy_32khz_clkmux: usbphy_32khz_clkmux@4260 {
		#clock-cells = <0>;
		compatible = "ti,mux-clock";
		clocks = <&clk_32768_ck>, <&clk_32k_tpm_ck>;
		reg = <0x4260>;
	};

	mpu_mod_ck: mpu_mod_ck@8320 {
		#clock-cells = <0>;
		compatible = "ti,omap4-sw-mod-clock";
		reg = <0x8320>;
		clocks = <&dpll_mpu_m2_ck>;
	};

	gfx_mod_ck: gfx_mod_ck@8420 {
		#clock-cells = <0>;
		compatible = "ti,omap4-sw-mod-clock";
		reg = <0x8420>;
		clocks = <&gfx_fck_div_ck>;
	};

	rtc_mod_ck: rtc_mod_ck@8520 {
		#clock-cells = <0>;
		compatible = "ti,omap4-sw-mod-clock";
		reg = <0x8520>;
		clocks = <&clk_32768_ck>;
	};

	l3_main_mod_ck: l3_main_mod_ck@8820 {
		#clock-cells = <0>;
		compatible = "ti,omap4-sw-mod-clock";
		reg = <0x8820>;
		clocks = <&l3_gclk>;
	};

	aes_mod_ck: aes_mod_ck@8828 {
		#clock-cells = <0>;
		compatible = "ti,omap4-sw-mod-clock";
		reg = <0x8828>;
		clocks = <&aes0_fck>;
	};

	l3_instr_mod_ck: l3_instr_mod_ck@8840 {
		#clock-cells = <0>;
		compatible = "ti,omap4-sw-mod-clock";
		reg = <0x8840>;
		clocks = <&l3_gclk>;
	};

	ocmcram_mod_ck: ocmcram_mod_ck@8850 {
		#clock-cells = <0>;
		compatible = "ti,omap4-sw-mod-clock";
		reg = <0x8850>;
		clocks = <&l3_gclk>;
	};

	sham_mod_ck: sham_mod_ck@8858 {
		#clock-cells = <0>;
		compatible = "ti,omap4-sw-mod-clock";
		reg = <0x8858>;
		clocks = <&l3_gclk>;
	};

	vpfe0_mod_ck: vpfe0_mod_ck@8868 {
		#clock-cells = <0>;
		compatible = "ti,omap4-sw-mod-clock";
		reg = <0x8868>;
		clocks = <&l3_gclk>;
	};

	vpfe1_mod_ck: vpfe1_mod_ck@8870 {
		#clock-cells = <0>;
		compatible = "ti,omap4-sw-mod-clock";
		reg = <0x8870>;
		clocks = <&l3_gclk>;
	};

	tpcc_mod_ck: tpcc_mod_ck@8878 {
		#clock-cells = <0>;
		compatible = "ti,omap4-sw-mod-clock";
		reg = <0x8878>;
		clocks = <&l3_gclk>;
	};

	tptc0_mod_ck: tptc0_mod_ck@8880 {
		#clock-cells = <0>;
		compatible = "ti,omap4-sw-mod-clock";
		reg = <0x8880>;
		clocks = <&l3_gclk>;
	};

	tptc1_mod_ck: tptc1_mod_ck@8888 {
		#clock-cells = <0>;
		compatible = "ti,omap4-sw-mod-clock";
		reg = <0x8888>;
		clocks = <&l3_gclk>;
	};

	tptc2_mod_ck: tptc2_mod_ck@8890 {
		#clock-cells = <0>;
		compatible = "ti,omap4-sw-mod-clock";
		reg = <0x8890>;
		clocks = <&l3_gclk>;
	};

	l4_hs_mod_ck: l4_hs_mod_ck@88a0 {
		#clock-cells = <0>;
		compatible = "ti,omap4-sw-mod-clock";
		reg = <0x88a0>;
		clocks = <&l4hs_gclk>;
	};

	gpmc_mod_ck: gpmc_mod_ck@8a20 {
		#clock-cells = <0>;
		compatible = "ti,omap4-sw-mod-clock";
		reg = <0x8a20>;
		clocks = <&l3s_gclk>;
	};

	mcasp0_mod_ck: mcasp0_mod_ck@8a38 {
		#clock-cells = <0>;
		compatible = "ti,omap4-sw-mod-clock";
		reg = <0x8a38>;
		clocks = <&mcasp0_fck>;
	};

	mcasp1_mod_ck: mcasp1_mod_ck@8a40 {
		#clock-cells = <0>;
		compatible = "ti,omap4-sw-mod-clock";
		reg = <0x8a40>;
		clocks = <&mcasp1_fck>;
	};

	mmc3_mod_ck: mmc3_mod_ck@8a48 {
		#clock-cells = <0>;
		compatible = "ti,omap4-sw-mod-clock";
		reg = <0x8a48>;
		clocks = <&mmc_clk>;
	};

	qspi_mod_ck: qspi_mod_ck@8a58 {
		#clock-cells = <0>;
		compatible = "ti,omap4-sw-mod-clock";
		reg = <0x8a58>;
		clocks = <&l3s_gclk>;
	};

	usb_phy0_always_on_clk32k: usb_phy0_always_on_clk32k@2a40 {
		#clock-cells = <0>;
		compatible = "ti,gate-clock";
		clocks = <&usbphy_32khz_clkmux>;
		ti,bit-shift = <8>;
		reg = <0x2a40>;
	};

	usb_phy1_always_on_clk32k: usb_phy1_always_on_clk32k@2a48 {
		#clock-cells = <0>;
		compatible = "ti,gate-clock";
		clocks = <&usbphy_32khz_clkmux>;
		ti,bit-shift = <8>;
		reg = <0x2a48>;
	};

	timer1_mod_ck: timer1_mod_ck@2b28 {
		#clock-cells = <0>;
		compatible = "ti,omap4-sw-mux-mod-clock";
		reg = <0x2b28>, <0x4200>;
		clocks = <&sys_clkin_ck>, <&clkdiv32k_ick>, <&tclkin_ck>,
			 <&clk_rc32k_ck>, <&clk_32768_ck>, <&clk_32k_tpm_ck>;
	};

	wd_timer2_mod_ck: wd_timer2_mod_ck@2b38 {
		#clock-cells = <0>;
		compatible = "ti,omap4-sw-mod-clock";
		reg = <0x2b38>;
		clocks = <&wdt1_fck>;
	};

	i2c1_mod_ck: i2c1_mod_ck@2b40 {
		#clock-cells = <0>;
		compatible = "ti,omap4-sw-mod-clock";
		reg = <0x2b40>;
		clocks = <&dpll_per_m2_div4_wkupdm_ck>;
	};

	uart1_mod_ck: uart1_mod_ck@2b48 {
		#clock-cells = <0>;
		compatible = "ti,omap4-sw-mod-clock";
		reg = <0x2b48>;
		clocks = <&dpll_per_m2_div4_wkupdm_ck>;
	};

	smartreflex0_mod_ck: smartreflex0_mod_ck@2b50 {
		#clock-cells = <0>;
		compatible = "ti,omap4-sw-mod-clock";
		reg = <0x2b50>;
		clocks = <&smartreflex0_fck>;
	};

	smartreflex1_mod_ck: smartreflex1_mod_ck@2b58 {
		#clock-cells = <0>;
		compatible = "ti,omap4-sw-mod-clock";
		reg = <0x2b58>;
		clocks = <&smartreflex1_fck>;
	};

	control_mod_ck: control_mod_ck@2b60 {
		#clock-cells = <0>;
		compatible = "ti,omap4-sw-mod-clock";
		reg = <0x2b60>;
		clocks = <&sys_clkin_ck>;
	};

	usb_otg_ss0_refclk960m: usb_otg_ss0_refclk960m@8a60 {
		#clock-cells = <0>;
		compatible = "ti,gate-clock";
		clocks = <&dpll_per_clkdcoldo>;
		ti,bit-shift = <8>;
		reg = <0x8a60>;
	};

	usb_otg_ss0_mod_ck: usb_otg_ss0_mod_ck@8a60 {
		#clock-cells = <0>;
		compatible = "ti,omap4-sw-mod-clock";
		reg = <0x8a60>;
		clocks = <&l3s_gclk>;
	};

	usb_otg_ss1_refclk960m: usb_otg_ss1_refclk960m@8a68 {
		#clock-cells = <0>;
		compatible = "ti,gate-clock";
		clocks = <&dpll_per_clkdcoldo>;
		ti,bit-shift = <8>;
		reg = <0x8a68>;
	};

	usb_otg_ss1_mod_ck: usb_otg_ss1_mod_ck@8a68 {
		#clock-cells = <0>;
		compatible = "ti,omap4-sw-mod-clock";
		reg = <0x8a68>;
		clocks = <&l3s_gclk>;
	};

	pruss_mod_ck: pruss_mod_ck@8b20 {
		#clock-cells = <0>;
		compatible = "ti,omap4-sw-mod-clock";
		reg = <0x8b20>;
		clocks = <&pruss_ocp_gclk>;
	};

	l4_ls_mod_ck: l4_ls_mod_ck@8c20 {
		#clock-cells = <0>;
		compatible = "ti,omap4-sw-mod-clock";
		reg = <0x8c20>;
		clocks = <&l4ls_gclk>;
	};

	d_can0_mod_ck: d_can0_mod_ck@8c28 {
		#clock-cells = <0>;
		compatible = "ti,omap4-sw-mod-clock";
		reg = <0x8c28>;
		clocks = <&dcan0_fck>;
	};

	d_can1_mod_ck: d_can1_mod_ck@8c30 {
		#clock-cells = <0>;
		compatible = "ti,omap4-sw-mod-clock";
		reg = <0x8c30>;
		clocks = <&dcan1_fck>;
	};

	epwmss0_mod_ck: epwmss0_mod_ck@8c38 {
		#clock-cells = <0>;
		compatible = "ti,omap4-sw-mod-clock";
		reg = <0x8c38>;
		clocks = <&l4ls_gclk>;
	};

	epwmss1_mod_ck: epwmss1_mod_ck@8c40 {
		#clock-cells = <0>;
		compatible = "ti,omap4-sw-mod-clock";
		reg = <0x8c40>;
		clocks = <&l4ls_gclk>;
	};

	epwmss2_mod_ck: epwmss2_mod_ck@8c48 {
		#clock-cells = <0>;
		compatible = "ti,omap4-sw-mod-clock";
		reg = <0x8c48>;
		clocks = <&l4ls_gclk>;
	};

	epwmss3_mod_ck: epwmss3_mod_ck@8c50 {
		#clock-cells = <0>;
		compatible = "ti,omap4-sw-mod-clock";
		reg = <0x8c50>;
		clocks = <&l4ls_gclk>;
	};

	epwmss4_mod_ck: epwmss4_mod_ck@8c58 {
		#clock-cells = <0>;
		compatible = "ti,omap4-sw-mod-clock";
		reg = <0x8c58>;
		clocks = <&l4ls_gclk>;
	};

	epwmss5_mod_ck: epwmss5_mod_ck@8c60 {
		#clock-cells = <0>;
		compatible = "ti,omap4-sw-mod-clock";
		reg = <0x8c60>;
		clocks = <&l4ls_gclk>;
	};

	elm_mod_ck: elm_mod_ck@8c68 {
		#clock-cells = <0>;
		compatible = "ti,omap4-sw-mod-clock";
		reg = <0x8c68>;
		clocks = <&l4ls_gclk>;
	};
};

&prcm_clockdomains {
	pruss_ocp_clkdm: pruss_ocp_clkdm {
		compatible = "ti,clockdomain";
		clocks = <&pruss_mod_ck>;
	};

	cpsw_125mhz_clkdm: cpsw_125mhz_clkdm {
		compatible = "ti,clockdomain";
		clocks = <&cpgmac0_mod_ck>;
	};

	dss_clkdm: dss_clkdm {
		compatible = "ti,clockdomain";
		clocks = <&dss_rfbi_mod_ck>, <&dss_dispc_mod_ck>,
			 <&dss_core_mod_ck>;
	};

	mpu_clkdm: mpu_clkdm {
		compatible = "ti,clockdomain";
		clocks = <&mpu_mod_ck>;
	};

	l4_rtc_clkdm: l4_rtc_clkdm {
		compatible = "ti,clockdomain";
		clocks = <&rtc_mod_ck>;
	};

	emif_clkdm: emif_clkdm {
		compatible = "ti,clockdomain";
		clocks = <&emif_mod_ck>;
	};

	l4ls_clkdm: l4ls_clkdm {
		compatible = "ti,clockdomain";
		clocks = <&gpio2_mod_ck>, <&ocp2scp0_mod_ck>, <&d_can1_mod_ck>,
			 <&d_can0_mod_ck>, <&uart2_mod_ck>, <&epwmss3_mod_ck>,
			 <&gpio4_mod_ck>, <&spi0_mod_ck>, <&timer9_mod_ck>,
			 <&i2c3_mod_ck>, <&timer5_mod_ck>, <&gpio5_mod_ck>,
			 <&timer2_mod_ck>, <&uart4_mod_ck>, <&epwmss4_mod_ck>,
			 <&spi2_mod_ck>, <&spi4_mod_ck>, <&mailbox_mod_ck>,
			 <&epwmss5_mod_ck>, <&uart6_mod_ck>, <&elm_mod_ck>,
			 <&spi3_mod_ck>, <&spi1_mod_ck>, <&epwmss1_mod_ck>,
			 <&l4_ls_mod_ck>, <&uart5_mod_ck>, <&mmc1_mod_ck>,
			 <&timer6_mod_ck>, <&timer3_mod_ck>, <&timer4_mod_ck>,
			 <&i2c2_mod_ck>, <&mmc2_mod_ck>, <&gpio3_mod_ck>,
			 <&timer10_mod_ck>, <&uart3_mod_ck>, <&timer7_mod_ck>,
			 <&gpio6_mod_ck>, <&ocp2scp1_mod_ck>, <&epwmss0_mod_ck>,
			 <&timer8_mod_ck>, <&epwmss2_mod_ck>,
			 <&spinlock_mod_ck>, <&hdq1w_mod_ck>, <&timer11_mod_ck>;
	};

	gfx_l3_clkdm: gfx_l3_clkdm {
		compatible = "ti,clockdomain";
		clocks = <&gfx_mod_ck>;
	};

	l3s_tsc_clkdm: l3s_tsc_clkdm {
		compatible = "ti,clockdomain";
		clocks = <&adc_tsc_mod_ck>;
	};

	l3s_clkdm: l3s_clkdm {
		compatible = "ti,clockdomain";
		clocks = <&qspi_mod_ck>, <&gpmc_mod_ck>, <&mcasp0_mod_ck>,
			 <&vpfe0_mod_ck>, <&mmc3_mod_ck>, <&vpfe1_mod_ck>,
			 <&usb_otg_ss1_mod_ck>, <&usb_otg_ss0_mod_ck>,
			 <&mcasp1_mod_ck>;
	};

	l4_wkup_clkdm: l4_wkup_clkdm {
		compatible = "ti,clockdomain";
		clocks = <&uart1_mod_ck>, <&smartreflex0_mod_ck>,
			 <&smartreflex1_mod_ck>, <&gpio1_mod_ck>,
			 <&l4_wkup_mod_ck>, <&control_mod_ck>, <&timer1_mod_ck>,
			 <&wd_timer2_mod_ck>, <&i2c1_mod_ck>;
	};

	l4_wkup_aon_clkdm: l4_wkup_aon_clkdm {
		compatible = "ti,clockdomain";
		clocks = <&counter_32k_mod_ck>, <&wkup_m3_mod_ck>;
	};

	l3_clkdm: l3_clkdm {
		compatible = "ti,clockdomain";
		clocks = <&l3_main_mod_ck>, <&ocmcram_mod_ck>, <&aes_mod_ck>,
			 <&sham_mod_ck>, <&l4_hs_mod_ck>, <&tpcc_mod_ck>,
			 <&tptc0_mod_ck>, <&l3_instr_mod_ck>, <&tptc2_mod_ck>,
			 <&tptc1_mod_ck>;
	};
};
