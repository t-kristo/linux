## Documentation/devicetree/bindings/arm/omap/ctrl.txt
```
OMAP Control Module bindings

Control Module contains miscellaneous features under it based on SoC type.
Pincontrol is one common feature, and typically some clock nodes are also
under control module. Syscon is used to share register level access to
drivers external to control module driver itself.

See [1] for documentation about clock/clockdomain nodes.

[1] Documentation/devicetree/bindings/clock/ti/*

Required properties:
- compatible:	Must be one of:
		"ti,am3-scrm"
		"ti,am4-scrm"
		"ti,omap2-scrm"
		"ti,omap3-scrm"
		"ti,omap4-ctrl-gen-core"
		"ti,omap4-ctrl-pad-core"
- reg:		Contains Control Module register address range
		(base address and length)

Optional properties:
- clocks:	clocks for this module
- clockdomains:	clockdomains for this module

Examples:

scrm: scrm@48002000 {
	compatible = "ti,omap3-scrm", "syscon";
	reg = <0x48002000 0x1000>;

	scrm_clocks: clocks {
		#address-cells = <1>;
		#size-cells = <0>;
	};

	scrm_clockdomains: clockdomains {
	};
}

&scrm_clocks {
	mcbsp5_mux_fck: mcbsp5_mux_fck {
		#clock-cells = <0>;
		compatible = "ti,composite-mux-clock";
		clocks = <&core_96m_fck>, <&mcbsp_clks>;
		ti,bit-shift = <4>;
		reg = <0x02d8>;
	};
};

ctrl_gen_core: ctrl_gen_core@4a002000 {
	compatible = "ti,omap4-ctrl-gen-core", "syscon";
	reg = <0x4a002000 0x1000>;
};
```

## Documentation/devicetree/bindings/clock/ti/clockdomain.txt
```
Binding for Texas Instruments clockdomain.

Binding status: Unstable - ABI compatibility may be broken in the future

This binding uses the common clock binding[1] in consumer role.
Every clock on TI SoC belongs to one clockdomain, but software
only needs this information for specific clocks which require
their parent clockdomain to be controlled when the clock is
enabled/disabled. This binding doesn't define a new clock
binding type, it is used to group existing clock nodes under
hardware hierarchy.

[1] Documentation/devicetree/bindings/clock/clock-bindings.txt

Required properties:
- compatible : shall be "ti,clockdomain"
- #clock-cells : from common clock binding; shall be set to 1 if this
		 clockdomain acts as a clock provider.

Optional properties:
- clocks : link phandles of clocks within this domain
- reg : address for the clockdomain

Examples:
	dss_clkdm: dss_clkdm {
		compatible = "ti,clockdomain";
		clocks = <&dss1_alwon_fck_3430es2>, <&dss_ick_3430es2>;
	};

	l4_per_clkdm: l4_per_clkdm {
		compatible = "ti,clockdomain";
		#clock-cells = <1>;
		reg = <0x1400 0x200>;
	};
```

## Documentation/devicetree/bindings/clock/ti/divider.txt
```
Binding for TI divider clock

Binding status: Unstable - ABI compatibility may be broken in the future

This binding uses the common clock binding[1].  It assumes a
register-mapped adjustable clock rate divider that does not gate and has
only one input clock or parent.  By default the value programmed into
the register is one less than the actual divisor value.  E.g:

register value		actual divisor value
0			1
1			2
2			3

This assumption may be modified by the following optional properties:

ti,index-starts-at-one - valid divisor values start at 1, not the default
of 0.  E.g:
register value		actual divisor value
1			1
2			2
3			3

ti,index-power-of-two - valid divisor values are powers of two.  E.g:
register value		actual divisor value
0			1
1			2
2			4

Additionally an array of valid dividers may be supplied like so:

	dividers = <4>, <8>, <0>, <16>;

Which will map the resulting values to a divisor table by their index:
register value		actual divisor value
0			4
1			8
2			<invalid divisor, skipped>
3			16

Any zero value in this array means the corresponding bit-value is invalid
and must not be used.

The binding must also provide the register to control the divider and
unless the divider array is provided, min and max dividers. Optionally
the number of bits to shift that mask, if necessary. If the shift value
is missing it is the same as supplying a zero shift.

Required properties:
- compatible : shall be "ti,divider-clock".
- #clock-cells : from common clock binding; shall be set to 0.
- clocks : link to phandle of parent clock
- reg : offset for register controlling adjustable divider

Optional properties:
- clock-output-names : from common clock binding.
- ti,dividers : array of integers defining divisors
- ti,bit-shift : number of bits to shift the divider value, defaults to 0
- ti,min-div : min divisor for dividing the input clock rate, only
  needed if the first divisor is offset from the default value (1)
- ti,max-div : max divisor for dividing the input clock rate, only needed
  if ti,dividers is not defined.
- ti,index-starts-at-one : valid divisor programming starts at 1, not zero
- ti,index-power-of-two : valid divisor programming must be a power of two
- ti,autoidle-shift : bit shift of the autoidle enable bit for the clock
- ti,autoidle-low : autoidle is enabled by setting the bit to 0
- ti,set-rate-parent : clk_set_rate is propagated to parent

Examples:
dpll_usb_m2_ck: dpll_usb_m2_ck@4a008190 {
	#clock-cells = <0>;
	compatible = "ti,divider-clock";
	clocks = <&dpll_usb_ck>;
	ti,max-div = <127>;
	reg = <0x190>;
	ti,index-starts-at-one;
};

aess_fclk: aess_fclk@4a004528 {
	#clock-cells = <0>;
	compatible = "ti,divider-clock";
	clocks = <&abe_clk>;
	ti,bit-shift = <24>;
	reg = <0x528>;
	ti,max-div = <2>;
};
```

## Documentation/devicetree/bindings/clock/ti/fixed-factor-clock.txt
```
Binding for TI fixed factor rate clock sources.

Binding status: Unstable - ABI compatibility may be broken in the future

This binding uses the common clock binding[1].

[1] Documentation/devicetree/bindings/clock/clock-bindings.txt

Required properties:
- compatible : shall be "ti,fixed-factor-clock".
- #clock-cells : from common clock binding; shall be set to 0.
- ti,clock-div: fixed divider.
- ti,clock-mult: fixed multiplier.
- clocks: parent clock.

Optional properties:
- ti,autoidle-shift: bit shift of the autoidle enable bit for the clock
- reg: base address for the autoidle register of this clock
- ti,autoidle-low: autoidle is enabled by setting the bit to 0
- ti,set-rate-parent: clk_set_rate is propagated to parent

Example:
	clock {
		compatible = "ti,fixed-factor-clock";
		clocks = <&parentclk>;
		#clock-cells = <0>;
		ti,clock-div = <2>;
		ti,clock-mult = <1>;
	};
```

## Documentation/devicetree/bindings/clock/ti/module.txt
```
Binding for Texas Instruments module clock.

Binding status: Unstable - ABI compatibility may be broken in the future

This binding uses the common clock binding[1]. This clock is
quite much similar to the basic gate-clock [2], however, internally
it controls an OMAP module clock, which effectively handles
both interface and functional clocks for a single module. In some
cases, support for mux clock [3] is composited to the same clock node,
currently only needed for proper support of timer module clocks.

[1] Documentation/devicetree/bindings/clock/clock-bindings.txt
[2] Documentation/devicetree/bindings/clock/ti/gate.txt
[3] Documentation/devicetree/bindings/clock/ti/mux.txt

Required properties:
- compatible : shall be one of:
  "ti,omap4-mod-clock" - basic module clock, no gating supported
  "ti,omap4-hw-mod-clock" - module clock with hardware gating support
  "ti,omap4-sw-mod-clock" - module clock with software forced gating support
  "ti,omap4-sw-no-idlest-mod-clock" - module clock with software forced gating
				      support, misses idlest
  "ti,omap4-mux-mod-clock" - composite clock with mux and module clocks, no
			     gating supported
  "ti,omap4-hw-mux-mod-clock" - composite clock with mux and module clocks,
				with hardware gating
  "ti,omap4-sw-mux-mod-clock" - composite clock with mux and module clocks,
				with software forced gating

- #clock-cells : from common clock binding; shall be set to 0
- clocks : link to phandle of parent clock(s)
- reg : offset for register controlling adjustable gate and optional mux

Optional properties:
- ti,bit-shift : bit shift for programming the clock mux, only needed for
		 the nodes of the mux variant

Examples:
	timer6_mod_ck: timer6_mod_ck {
		#clock-cells = <0>;
		compatible = "ti,omap4-sw-mux-mod-clock";
		reg = <0x0570>;
		clocks = <&syc_clk_div_ck>, <&sys_32k_ck>;
		ti,bit-shift = <24>;
	};

	i2c1_mod_ck: i2c1_mod_ck {
		#clock-cells = <0>;
		compatible = "ti,omap4-sw-mod-clock";
		reg = <0x14a0>;
		clocks = <&func_96m_fclk>;
	};

	hsi_mod_ck: hsi_mod_ck {
		#clock-cells = <0>;
		compatible = "ti,omap4-hw-mod-clock";
		reg = <0x1338>;
		clocks = <&hsi_fck>;
	};
```

## Documentation/devicetree/bindings/clock/ti/mux-gate.txt
```
Binding for TI mux-gate clock.

Binding status: Unstable - ABI compatibility may be broken in the future

This binding uses the common clock binding[1]. It assumes a
register-mapped composite clock with multiple different sub-types;

a multiplexer clock with multiple input clock signals or parents, one
of which can be selected as output, this behaves exactly as [2]

an adjustable clock rate divider, this behaves exactly as [3]

a gating function which can be used to enable and disable the output
clock, this behaves exactly as [4]

The binding must provide the register mapping to control the mux-gate.
"reg-names" property is used to specify which sub-function are used
for this composite clock, and to specify the corresponding control
register addresses. Optional parameters are specified according to
the sub-types used.

[1] Documentation/devicetree/bindings/clock/clock-bindings.txt
[2] Documentation/devicetree/bindings/clock/ti/mux.txt
[3] Documentation/devicetree/bindings/clock/ti/divider.txt
[4] Documentation/devicetree/bindings/clock/ti/gate.txt

Required properties:
- compatible : shall be one of:
  "ti,mux-gate-clock" : mux-gate clock which waits until clock is active
			before returning from clk_enable()
  "ti,no-wait-mux-gate-clock" : mux-gate clock which does not wait for
				clock activity
  "ti,interface-mux-gate-clock" : mux-gate interface clock which waits until
				  clock is active before returning from
				  clk_enable()
- #clock-cells : from common clock binding; shall be set to 0.
- clocks : link phandles of parent clocks
- reg : base address array for registers controlling the mux-gate
  sub-functions. Ordered according to "reg-names" property.
- reg-names : register names property, can have following values:
	"gate-reg" : base address for gate function control register
	"mux-reg" : base address for mux function control register
	"div-reg" : base address for divider function control register
  Any of these values can be left out, and the corresponding function
  will not be present in the composite clock either.

Optional properties:
- ti,gate-bit-shift : number of bits to shift the enable bit for gating
  function, defaults to 0 if not present
- ti,mux-bit-shift : number of bits to shift the bit-field for mux
  function, defaults to 0 if not present
- ti,div-index-starts-at-one : min-div is mapped to bit-value 1, default 0
- ti,max-div : maximum divider value for the divider function
- ti,min-div : minimum divider value for the divider function, defaults to
  1 if not present
- ti,dividers : array of valid divider values for the clock

Examples:

dpll_core_m3x2_ck: dpll_core_m3x2_ck@4a004134 {
	#clock-cells = <0>;
	compatible = "ti,no-wait-mux-gate-clock";
	clocks = <&dpll_core_x2_ck>;
	ti,max-div = <31>;
	reg-names = "gate-reg", "div-reg";
	reg = <0x4a004134 0x4>, <0x4a004134 0x4>;
	ti,gate-bit-shift = <8>;
	ti,div-index-starts-at-one;
};

auxclk2_src_ck: auxclk2_src_ck@4a30a318 {
	#clock-cells = <0>;
	compatible = "ti,no-wait-mux-gate-clock";
	clocks = <&sys_clkin_ck>, <&dpll_core_m3x2_ck>, <&dpll_per_m3x2_ck>;
	reg-names = "gate-reg", "mux-reg";
	reg = <0x4a30a318 0x4>, <0x4a30a318 0x4>;
	ti,gate-bit-shift = <8>;
	ti,mux-bit-shift = <1>;
};

gpt10_fck: gpt10_fck@48004a00 {
	#clock-cells = <0>;
	compatible = "ti,mux-gate-clock";
	clocks = <&omap_32k_fck>, <&sys_ck>;
	reg-names = "gate-reg", "mux-reg";
	reg = <0x48004a00 0x4>, <0x48004a40 0x4>;
	ti,gate-bit-shift = <11>;
	ti,mux-bit-shift = <6>;
};

ssi_ssr_fck_3430es1: ssi_ssr_fck_3430es1@48004a00 {
	#clock-cells = <0>;
	compatible = "ti,no-wait-mux-gate-clock";
	clocks = <&corex2_fck>;
	ti,div-bit-shift = <8>;
	ti,dividers = <0>, <1>, <2>, <3>, <4>, <0>, <6>, <0>, <8>;
	reg-names = "gate-reg", "div-reg";
	reg = <0x48004a00 0x4>, <0x48004a40 0x4>;
	ti,gate-bit-shift = <0>;
};
```
